## app/backplane/app_sensor_module/build-native-sim/Kconfig/soc/Kconfig.soc
```kconfig
# Load SoC Kconfig descriptions.
osource "/home/aaron/Development/Launch/zephyr/soc/xlnx/zynqmp/Kconfig.soc"
osource "/home/aaron/Development/Launch/zephyr/soc/xlnx/zynq7000/Kconfig.soc"
osource "/home/aaron/Development/Launch/zephyr/soc/xen/Kconfig.soc"
osource "/home/aaron/Development/Launch/zephyr/soc/ti/simplelink/Kconfig.soc"
osource "/home/aaron/Development/Launch/zephyr/soc/ti/lm3s6965/Kconfig.soc"
osource "/home/aaron/Development/Launch/zephyr/soc/ti/k3/Kconfig.soc"
osource "/home/aaron/Development/Launch/zephyr/soc/telink/tlsr/Kconfig.soc"
osource "/home/aaron/Development/Launch/zephyr/soc/starfive/jh71xx/Kconfig.soc"
osource "/home/aaron/Development/Launch/zephyr/soc/st/stm32/Kconfig.soc"
osource "/home/aaron/Development/Launch/zephyr/soc/snps/qemu_arc/Kconfig.soc"
osource "/home/aaron/Development/Launch/zephyr/soc/snps/nsim/arc_v/Kconfig.soc"
osource "/home/aaron/Development/Launch/zephyr/soc/snps/nsim/arc_classic/Kconfig.soc"
osource "/home/aaron/Development/Launch/zephyr/soc/snps/hsdk4xd/Kconfig.soc"
osource "/home/aaron/Development/Launch/zephyr/soc/snps/hsdk/Kconfig.soc"
osource "/home/aaron/Development/Launch/zephyr/soc/snps/emsk/Kconfig.soc"
osource "/home/aaron/Development/Launch/zephyr/soc/snps/emsdp/Kconfig.soc"
osource "/home/aaron/Development/Launch/zephyr/soc/snps/arc_iot/Kconfig.soc"
osource "/home/aaron/Development/Launch/zephyr/soc/silabs/Kconfig.soc"
osource "/home/aaron/Development/Launch/zephyr/soc/sifive/sifive_freedom/Kconfig.soc"
osource "/home/aaron/Development/Launch/zephyr/soc/rockchip/Kconfig.soc"
osource "/home/aaron/Development/Launch/zephyr/soc/renode/riscv_virtual/Kconfig.soc"
osource "/home/aaron/Development/Launch/zephyr/soc/renesas/smartbond/Kconfig.soc"
osource "/home/aaron/Development/Launch/zephyr/soc/renesas/rzt2m/Kconfig.soc"
osource "/home/aaron/Development/Launch/zephyr/soc/renesas/rcar/Kconfig.soc"
osource "/home/aaron/Development/Launch/zephyr/soc/renesas/ra/Kconfig.soc"
osource "/home/aaron/Development/Launch/zephyr/soc/raspberrypi/Kconfig.soc"
osource "/home/aaron/Development/Launch/zephyr/soc/quicklogic/eos_s3/Kconfig.soc"
osource "/home/aaron/Development/Launch/zephyr/soc/qemu/virt_riscv/Kconfig.soc"
osource "/home/aaron/Development/Launch/zephyr/soc/qemu/malta/Kconfig.soc"
osource "/home/aaron/Development/Launch/zephyr/soc/openisa/rv32m1/Kconfig.soc"
osource "/home/aaron/Development/Launch/zephyr/soc/nxp/s32/Kconfig.soc"
osource "/home/aaron/Development/Launch/zephyr/soc/nxp/rw/Kconfig.soc"
osource "/home/aaron/Development/Launch/zephyr/soc/nxp/mcx/Kconfig.soc"
osource "/home/aaron/Development/Launch/zephyr/soc/nxp/lpc/Kconfig.soc"
osource "/home/aaron/Development/Launch/zephyr/soc/nxp/layerscape/Kconfig.soc"
osource "/home/aaron/Development/Launch/zephyr/soc/nxp/kinetis/Kconfig.soc"
osource "/home/aaron/Development/Launch/zephyr/soc/nxp/imxrt/Kconfig.soc"
osource "/home/aaron/Development/Launch/zephyr/soc/nxp/imx/Kconfig.soc"
osource "/home/aaron/Development/Launch/zephyr/soc/nuvoton/numicro/Kconfig.soc"
osource "/home/aaron/Development/Launch/zephyr/soc/nuvoton/numaker/Kconfig.soc"
osource "/home/aaron/Development/Launch/zephyr/soc/nuvoton/npcx/Kconfig.soc"
osource "/home/aaron/Development/Launch/zephyr/soc/nordic/Kconfig.soc"
osource "/home/aaron/Development/Launch/zephyr/soc/neorv32/Kconfig.soc"
osource "/home/aaron/Development/Launch/zephyr/soc/native/inf_clock/Kconfig.soc"
osource "/home/aaron/Development/Launch/zephyr/soc/microchip/miv/Kconfig.soc"
osource "/home/aaron/Development/Launch/zephyr/soc/microchip/mec/Kconfig.soc"
osource "/home/aaron/Development/Launch/zephyr/soc/mediatek/mtk_adsp/Kconfig.soc"
osource "/home/aaron/Development/Launch/zephyr/soc/lowrisc/opentitan/Kconfig.soc"
osource "/home/aaron/Development/Launch/zephyr/soc/litex/litex_vexriscv/Kconfig.soc"
osource "/home/aaron/Development/Launch/zephyr/soc/ite/ec/Kconfig.soc"
osource "/home/aaron/Development/Launch/zephyr/soc/intel/raptor_lake/Kconfig.soc"
osource "/home/aaron/Development/Launch/zephyr/soc/intel/lakemont/Kconfig.soc"
osource "/home/aaron/Development/Launch/zephyr/soc/intel/intel_socfpga_std/Kconfig.soc"
osource "/home/aaron/Development/Launch/zephyr/soc/intel/intel_socfpga/Kconfig.soc"
osource "/home/aaron/Development/Launch/zephyr/soc/intel/intel_niosv/Kconfig.soc"
osource "/home/aaron/Development/Launch/zephyr/soc/intel/intel_ish/Kconfig.soc"
osource "/home/aaron/Development/Launch/zephyr/soc/intel/intel_adsp/Kconfig.soc"
osource "/home/aaron/Development/Launch/zephyr/soc/intel/elkhart_lake/Kconfig.soc"
osource "/home/aaron/Development/Launch/zephyr/soc/intel/atom/Kconfig.soc"
osource "/home/aaron/Development/Launch/zephyr/soc/intel/apollo_lake/Kconfig.soc"
osource "/home/aaron/Development/Launch/zephyr/soc/intel/alder_lake/Kconfig.soc"
osource "/home/aaron/Development/Launch/zephyr/soc/infineon/cat3/Kconfig.soc"
osource "/home/aaron/Development/Launch/zephyr/soc/infineon/cat1b/Kconfig.soc"
osource "/home/aaron/Development/Launch/zephyr/soc/infineon/cat1a/Kconfig.soc"
osource "/home/aaron/Development/Launch/zephyr/soc/gd/gd32/Kconfig.soc"
osource "/home/aaron/Development/Launch/zephyr/soc/gaisler/leon3/Kconfig.soc"
osource "/home/aaron/Development/Launch/zephyr/soc/gaisler/gr716a/Kconfig.soc"
osource "/home/aaron/Development/Launch/zephyr/soc/espressif/Kconfig.soc"
osource "/home/aaron/Development/Launch/zephyr/soc/ene/kb1200/Kconfig.soc"
osource "/home/aaron/Development/Launch/zephyr/soc/efinix/sapphire/Kconfig.soc"
osource "/home/aaron/Development/Launch/zephyr/soc/cdns/xtensa_sample_controller/Kconfig.soc"
osource "/home/aaron/Development/Launch/zephyr/soc/cdns/dc233c/Kconfig.soc"
osource "/home/aaron/Development/Launch/zephyr/soc/brcm/bcmvk/Kconfig.soc"
osource "/home/aaron/Development/Launch/zephyr/soc/brcm/bcm2712/Kconfig.soc"
osource "/home/aaron/Development/Launch/zephyr/soc/brcm/bcm2711/Kconfig.soc"
osource "/home/aaron/Development/Launch/zephyr/soc/atmel/sam0/Kconfig.soc"
osource "/home/aaron/Development/Launch/zephyr/soc/atmel/sam/Kconfig.soc"
osource "/home/aaron/Development/Launch/zephyr/soc/aspeed/Kconfig.soc"
osource "/home/aaron/Development/Launch/zephyr/soc/arm/Kconfig.soc"
osource "/home/aaron/Development/Launch/zephyr/soc/arm/beetle/Kconfig.soc"
osource "/home/aaron/Development/Launch/zephyr/soc/andestech/Kconfig.soc"
osource "/home/aaron/Development/Launch/zephyr/soc/ambiq/Kconfig.soc"
osource "/home/aaron/Development/Launch/zephyr/soc/altr/zephyr_nios2f/Kconfig.soc"
osource "/home/aaron/Development/Launch/zephyr/soc/altr/qemu_nios2/Kconfig.soc"
osource "/home/aaron/Development/Launch/zephyr/soc/adi/max32/Kconfig.soc"
```

## app/backplane/deployment_module/sample.yaml
```yaml
sample:
  description:
  name: deployment-module
common:
  build_only: true
  integration_platforms:
    - deployment_module
tests:
  backplane.deployment_module.default: {}
  backplane.deployment_module.debug:
    extra_overlay_confs:
      - debug.conf
      - sim.conf
```

## app/boards/arm/power_module/Kconfig.board
```kconfig
config BOARD_POWER_MODULE
	bool "Launch Initiative Power Module"
	depends on SOC_STM32F446XX
```

## app/boards/arm/power_module/Kconfig.defconfig
```kconfig
# STM32F446RE Nucleo board configuration
if BOARD_POWER_MODULE

config BOARD
	default "power_module"

config SPI_STM32_INTERRUPT
	default y
	depends on SPI

endif # BOARD_POWER_MODULE
```

## app/boards/arm/radio_module/Kconfig.board
```kconfig
config RADIO_MODULE
	bool "Launch Initiative Radio Module"
	depends on SOC_STM32F446XX
```

## app/boards/arm/radio_module/Kconfig.defconfig
```kconfig
# STM32F446RE Nucleo board configuration

# Copyright (c) 2018 Philémon Jaermann
# SPDX-License-Identifier: Apache-2.0

if RADIO_MODULE

config BOARD
	default "radio_module"

config SPI_STM32_INTERRUPT
	default y
	depends on SPI

config I2C_STM32_INTERRUPT
    default y
    depends on SPI
endif # RADIO_MODULE
```

## app/boards/arm/radio_module/radio_module_defconfig
```kconfig
# SPDX-License-Identifier: Apache-2.0

CONFIG_SOC_SERIES_STM32F4X=y
CONFIG_SOC_STM32F446XX=y

# Enable MPU
CONFIG_ARM_MPU=y

# Enable HW stack protection
CONFIG_HW_STACK_PROTECTION=y

CONFIG_SERIAL=y

# console
CONFIG_CONSOLE=y
CONFIG_UART_CONSOLE=y
CONFIG_CBPRINTF_FP_SUPPORT=y

# enable GPIO
CONFIG_GPIO=y

# Enable Clocks
CONFIG_CLOCK_CONTROL=y

# enable pin controller
CONFIG_PINCTRL=y
CONFIG_LED=y

# I2C
CONFIG_I2C=y
CONFIG_I2C_CALLBACK=y
CONFIG_I2C_RTIO=y

# SPI
CONFIG_SPI=y
CONFIG_SPI_RTIO=y


# GNSS (MAX-M10S)
CONFIG_GNSS=y
CONFIG_GNSS_SATELLITES=y
CONFIG_GNSS_NMEA0183=y
CONFIG_UBXLIB=y

# LORA
CONFIG_LORA=y

CONFIG_HAS_SEMTECH_LORAMAC=y

# Networking
CONFIG_NET_L2_ETHERNET=y
CONFIG_NETWORKING=y
CONFIG_NET_L2_ETHERNET_MGMT=y
CONFIG_NET_IPV4=y
CONFIG_NET_STATISTICS=y
CONFIG_SHELL=y
CONFIG_PTP_CLOCK=y


# Non-Volatile Memory
CONFIG_FLASH=y
```

## app/boards/arm/sensor_module/Kconfig.board
```kconfig
# STM32F446RE Nucleo board configuration

# Copyright (c) 2018 Philémon Jaermann
# SPDX-License-Identifier: Apache-2.0

config SENSOR_MODULE
	bool "Sensor Module"
	depends on SOC_STM32F446XX
```

## app/boards/arm/sensor_module/power_module_defconfig
```kconfig
# SPDX-License-Identifier: Apache-2.0

CONFIG_SOC_SERIES_STM32F4X=y
CONFIG_SOC_STM32F446XX=y

# Enable MPU
CONFIG_ARM_MPU=y

# Enable HW stack protection
CONFIG_HW_STACK_PROTECTION=y

CONFIG_SERIAL=y

# console
CONFIG_CONSOLE=y
CONFIG_UART_CONSOLE=y

# enable GPIO
CONFIG_GPIO=y

# Enable Clocks
CONFIG_CLOCK_CONTROL=y

# enable pin controller
CONFIG_PINCTRL=y

# W5500
CONFIG_SPI=y
CONFIG_NET_L2_ETHERNET=y
CONFIG_ETH_W5500=y
CONFIG_ETH_W5500_TIMEOUT=1000
CONFIG_NET_DHCPV4=y
CONFIG_NET_MGMT=y
```

## app/ground/receiver_module/Kconfig
```kconfig
# Copyright (c) 2025 RIT Launch Initiative
# SPDX-License-Identifier: Apache-2.0

menu "Zephyr"
source "Kconfig.zephyr"
endmenu

module = APP_RECEIVER_MODULE
module-str = APP_RECEIVER_MODULE
source "subsys/logging/Kconfig.template.log_config"
```

## app/ground/receiver_module/sample.yaml
```yaml
sample:
  description: Receiver Module
  name: receiver-module
common:
  build_only: true
  integration_platforms:
    - radio_module
tests:
  ground.receiever_module.default: {}
  ground.receiver_module.433mhz:
    extra_overlay_confs:
      - 433mhz.conf
  ground.receiver_module.debug:
    extra_overlay_confs:
      - debug.conf
  ground.receiver_module.debug_433mhz:
    extra_overlay_confs:
      - debug.conf
      - 433mhz.conf
```

## app/other/.retired/app_potato/Kconfig
```kconfig
# Copyright (c) 2024 Launch Initiative
# SPDX-License-Identifier: Apache-2.0

menu "Zephyr"
source "Kconfig.zephyr"
endmenu

module = APP_POTATO
module-str = APP_POTATO
source "subsys/logging/Kconfig.template.log_config"
```

## app/payload/control_freak/sample.yaml
```yaml
sample:
  description:
  name: control_freak
common:
  build_only: true
  platform_allow:
    - native_sim
tests:
  control_freak.flight.default: {}
```

## app/payload/crashout/sample.yaml
```yaml
sample:
  description:
  name: crashout
common:
  build_only: true
  platform_allow:
    - native_sim
    - nucleo_f446re
tests:
  payload.crashout.default: {}
```

## app/samples/.template-project/sample.yaml
```yaml
sample:
  description:
  name: sample template
common:
  build_only: true
  platform_allow:
    - native_sim
tests:
  samples.sample-template.default: {}
```

## app/samples/afs/sample.yaml
```yaml
sample:
  description:
  name: afs-sample
common:
  build_only: true
  platform_allow:
    - native_sim
tests:
  samples.afs-sample.default: {}
```

## app/samples/data_log_shell/sample.yaml
```yaml
sample:
  description:
  name: data_log_shell
common:
  build_only: true
  platform_allow:
    - native_sim
tests:
  samples.data_log_shell.default: {}
```

## app/samples/electric_toothbrush/sample.yaml
```yaml
sample:
  description:
  name: electric-toothbrush
common:
  build_only: true
  platform_allow:
    - nucleo_f446re
    - native_sim
tests:
  samples.electric_toothbrush.default: {}
```
