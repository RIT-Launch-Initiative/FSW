## app/.template-project-backplane/Kconfig
```kconfig
# Copyright (c) 2025 RIT Launch Initiative
# SPDX-License-Identifier: Apache-2.0

menu "Zephyr"
source "Kconfig.zephyr"
endmenu

module = APP
module-str = APP
source "subsys/logging/Kconfig.template.log_config"
```

## app/.template-project-backplane/sample.yaml
```yaml
sample:
  description:
  name: template-backplane
common:
  build_only: true
  platform_allow:
    - native_sim
tests:
  samples.template-backplane.default: {}
```

## app/backplane/app_sensor_module/build-native-sim/Kconfig/Kconfig.shield
```kconfig
osource "/home/aaron/Development/Launch/FSW/app/backplane/app_sensor_module/boards/shields/*/Kconfig.shield"
osource "/home/aaron/Development/Launch/FSW/boards/shields/*/Kconfig.shield"
```

## app/backplane/app_sensor_module/build-native-sim/Kconfig/Kconfig.shield.defconfig
```kconfig
osource "/home/aaron/Development/Launch/FSW/app/backplane/app_sensor_module/boards/shields/*/Kconfig.defconfig"
osource "/home/aaron/Development/Launch/FSW/boards/shields/*/Kconfig.defconfig"
```

## app/backplane/app_sensor_module/build-native-sim/Kconfig/arch/Kconfig
```kconfig
# Load arch Kconfig descriptions.
osource "/home/aaron/Development/Launch/zephyr/arch/x86/Kconfig"
osource "/home/aaron/Development/Launch/zephyr/arch/xtensa/Kconfig"
osource "/home/aaron/Development/Launch/zephyr/arch/sparc/Kconfig"
osource "/home/aaron/Development/Launch/zephyr/arch/riscv/Kconfig"
osource "/home/aaron/Development/Launch/zephyr/arch/posix/Kconfig"
osource "/home/aaron/Development/Launch/zephyr/arch/nios2/Kconfig"
osource "/home/aaron/Development/Launch/zephyr/arch/mips/Kconfig"
osource "/home/aaron/Development/Launch/zephyr/arch/arm64/Kconfig"
osource "/home/aaron/Development/Launch/zephyr/arch/arm/Kconfig"
osource "/home/aaron/Development/Launch/zephyr/arch/arc/Kconfig"
```

## app/backplane/app_sensor_module/build-native-sim/Kconfig/soc/Kconfig
```kconfig
# Load Zephyr SoC Kconfig descriptions.
osource "/home/aaron/Development/Launch/zephyr/soc/xlnx/zynqmp/Kconfig"
osource "/home/aaron/Development/Launch/zephyr/soc/xlnx/zynq7000/Kconfig"
osource "/home/aaron/Development/Launch/zephyr/soc/xen/Kconfig"
osource "/home/aaron/Development/Launch/zephyr/soc/ti/simplelink/Kconfig"
osource "/home/aaron/Development/Launch/zephyr/soc/ti/lm3s6965/Kconfig"
osource "/home/aaron/Development/Launch/zephyr/soc/ti/k3/Kconfig"
osource "/home/aaron/Development/Launch/zephyr/soc/telink/tlsr/Kconfig"
osource "/home/aaron/Development/Launch/zephyr/soc/starfive/jh71xx/Kconfig"
osource "/home/aaron/Development/Launch/zephyr/soc/st/stm32/Kconfig"
osource "/home/aaron/Development/Launch/zephyr/soc/snps/qemu_arc/Kconfig"
osource "/home/aaron/Development/Launch/zephyr/soc/snps/nsim/arc_v/Kconfig"
osource "/home/aaron/Development/Launch/zephyr/soc/snps/nsim/arc_classic/Kconfig"
osource "/home/aaron/Development/Launch/zephyr/soc/snps/hsdk4xd/Kconfig"
osource "/home/aaron/Development/Launch/zephyr/soc/snps/hsdk/Kconfig"
osource "/home/aaron/Development/Launch/zephyr/soc/snps/emsk/Kconfig"
osource "/home/aaron/Development/Launch/zephyr/soc/snps/emsdp/Kconfig"
osource "/home/aaron/Development/Launch/zephyr/soc/snps/arc_iot/Kconfig"
osource "/home/aaron/Development/Launch/zephyr/soc/silabs/Kconfig"
osource "/home/aaron/Development/Launch/zephyr/soc/sifive/sifive_freedom/Kconfig"
osource "/home/aaron/Development/Launch/zephyr/soc/rockchip/Kconfig"
osource "/home/aaron/Development/Launch/zephyr/soc/renode/riscv_virtual/Kconfig"
osource "/home/aaron/Development/Launch/zephyr/soc/renesas/smartbond/Kconfig"
osource "/home/aaron/Development/Launch/zephyr/soc/renesas/rzt2m/Kconfig"
osource "/home/aaron/Development/Launch/zephyr/soc/renesas/rcar/Kconfig"
osource "/home/aaron/Development/Launch/zephyr/soc/renesas/ra/Kconfig"
osource "/home/aaron/Development/Launch/zephyr/soc/raspberrypi/Kconfig"
osource "/home/aaron/Development/Launch/zephyr/soc/quicklogic/eos_s3/Kconfig"
osource "/home/aaron/Development/Launch/zephyr/soc/qemu/virt_riscv/Kconfig"
osource "/home/aaron/Development/Launch/zephyr/soc/qemu/malta/Kconfig"
osource "/home/aaron/Development/Launch/zephyr/soc/openisa/rv32m1/Kconfig"
osource "/home/aaron/Development/Launch/zephyr/soc/nxp/s32/Kconfig"
osource "/home/aaron/Development/Launch/zephyr/soc/nxp/rw/Kconfig"
osource "/home/aaron/Development/Launch/zephyr/soc/nxp/mcx/Kconfig"
osource "/home/aaron/Development/Launch/zephyr/soc/nxp/lpc/Kconfig"
osource "/home/aaron/Development/Launch/zephyr/soc/nxp/layerscape/Kconfig"
osource "/home/aaron/Development/Launch/zephyr/soc/nxp/kinetis/Kconfig"
osource "/home/aaron/Development/Launch/zephyr/soc/nxp/imxrt/Kconfig"
osource "/home/aaron/Development/Launch/zephyr/soc/nxp/imx/Kconfig"
osource "/home/aaron/Development/Launch/zephyr/soc/nuvoton/numicro/Kconfig"
osource "/home/aaron/Development/Launch/zephyr/soc/nuvoton/numaker/Kconfig"
osource "/home/aaron/Development/Launch/zephyr/soc/nuvoton/npcx/Kconfig"
osource "/home/aaron/Development/Launch/zephyr/soc/nordic/Kconfig"
osource "/home/aaron/Development/Launch/zephyr/soc/neorv32/Kconfig"
osource "/home/aaron/Development/Launch/zephyr/soc/native/inf_clock/Kconfig"
osource "/home/aaron/Development/Launch/zephyr/soc/microchip/miv/Kconfig"
osource "/home/aaron/Development/Launch/zephyr/soc/microchip/mec/Kconfig"
osource "/home/aaron/Development/Launch/zephyr/soc/mediatek/mtk_adsp/Kconfig"
osource "/home/aaron/Development/Launch/zephyr/soc/lowrisc/opentitan/Kconfig"
osource "/home/aaron/Development/Launch/zephyr/soc/litex/litex_vexriscv/Kconfig"
osource "/home/aaron/Development/Launch/zephyr/soc/ite/ec/Kconfig"
osource "/home/aaron/Development/Launch/zephyr/soc/intel/raptor_lake/Kconfig"
osource "/home/aaron/Development/Launch/zephyr/soc/intel/lakemont/Kconfig"
osource "/home/aaron/Development/Launch/zephyr/soc/intel/intel_socfpga_std/Kconfig"
osource "/home/aaron/Development/Launch/zephyr/soc/intel/intel_socfpga/Kconfig"
osource "/home/aaron/Development/Launch/zephyr/soc/intel/intel_niosv/Kconfig"
osource "/home/aaron/Development/Launch/zephyr/soc/intel/intel_ish/Kconfig"
osource "/home/aaron/Development/Launch/zephyr/soc/intel/intel_adsp/Kconfig"
osource "/home/aaron/Development/Launch/zephyr/soc/intel/elkhart_lake/Kconfig"
osource "/home/aaron/Development/Launch/zephyr/soc/intel/atom/Kconfig"
osource "/home/aaron/Development/Launch/zephyr/soc/intel/apollo_lake/Kconfig"
osource "/home/aaron/Development/Launch/zephyr/soc/intel/alder_lake/Kconfig"
osource "/home/aaron/Development/Launch/zephyr/soc/infineon/cat3/Kconfig"
osource "/home/aaron/Development/Launch/zephyr/soc/infineon/cat1b/Kconfig"
osource "/home/aaron/Development/Launch/zephyr/soc/infineon/cat1a/Kconfig"
osource "/home/aaron/Development/Launch/zephyr/soc/gd/gd32/Kconfig"
osource "/home/aaron/Development/Launch/zephyr/soc/gaisler/leon3/Kconfig"
osource "/home/aaron/Development/Launch/zephyr/soc/gaisler/gr716a/Kconfig"
osource "/home/aaron/Development/Launch/zephyr/soc/espressif/Kconfig"
osource "/home/aaron/Development/Launch/zephyr/soc/ene/kb1200/Kconfig"
osource "/home/aaron/Development/Launch/zephyr/soc/efinix/sapphire/Kconfig"
osource "/home/aaron/Development/Launch/zephyr/soc/cdns/xtensa_sample_controller/Kconfig"
osource "/home/aaron/Development/Launch/zephyr/soc/cdns/dc233c/Kconfig"
osource "/home/aaron/Development/Launch/zephyr/soc/brcm/bcmvk/Kconfig"
osource "/home/aaron/Development/Launch/zephyr/soc/brcm/bcm2712/Kconfig"
osource "/home/aaron/Development/Launch/zephyr/soc/brcm/bcm2711/Kconfig"
osource "/home/aaron/Development/Launch/zephyr/soc/atmel/sam0/Kconfig"
osource "/home/aaron/Development/Launch/zephyr/soc/atmel/sam/Kconfig"
osource "/home/aaron/Development/Launch/zephyr/soc/aspeed/Kconfig"
osource "/home/aaron/Development/Launch/zephyr/soc/arm/Kconfig"
osource "/home/aaron/Development/Launch/zephyr/soc/arm/beetle/Kconfig"
osource "/home/aaron/Development/Launch/zephyr/soc/andestech/Kconfig"
osource "/home/aaron/Development/Launch/zephyr/soc/ambiq/Kconfig"
osource "/home/aaron/Development/Launch/zephyr/soc/altr/zephyr_nios2f/Kconfig"
osource "/home/aaron/Development/Launch/zephyr/soc/altr/qemu_nios2/Kconfig"
osource "/home/aaron/Development/Launch/zephyr/soc/adi/max32/Kconfig"
```

## app/backplane/app_sensor_module/build-native-sim/Kconfig/soc/Kconfig.defconfig
```kconfig
# Load Zephyr SoC Kconfig defconfig.
osource "/home/aaron/Development/Launch/zephyr/soc/xlnx/zynqmp/Kconfig.defconfig"
osource "/home/aaron/Development/Launch/zephyr/soc/xlnx/zynq7000/Kconfig.defconfig"
osource "/home/aaron/Development/Launch/zephyr/soc/xen/Kconfig.defconfig"
osource "/home/aaron/Development/Launch/zephyr/soc/ti/simplelink/Kconfig.defconfig"
osource "/home/aaron/Development/Launch/zephyr/soc/ti/lm3s6965/Kconfig.defconfig"
osource "/home/aaron/Development/Launch/zephyr/soc/ti/k3/Kconfig.defconfig"
osource "/home/aaron/Development/Launch/zephyr/soc/telink/tlsr/Kconfig.defconfig"
osource "/home/aaron/Development/Launch/zephyr/soc/starfive/jh71xx/Kconfig.defconfig"
osource "/home/aaron/Development/Launch/zephyr/soc/st/stm32/Kconfig.defconfig"
osource "/home/aaron/Development/Launch/zephyr/soc/snps/qemu_arc/Kconfig.defconfig"
osource "/home/aaron/Development/Launch/zephyr/soc/snps/nsim/arc_v/Kconfig.defconfig"
osource "/home/aaron/Development/Launch/zephyr/soc/snps/nsim/arc_classic/Kconfig.defconfig"
osource "/home/aaron/Development/Launch/zephyr/soc/snps/hsdk4xd/Kconfig.defconfig"
osource "/home/aaron/Development/Launch/zephyr/soc/snps/hsdk/Kconfig.defconfig"
osource "/home/aaron/Development/Launch/zephyr/soc/snps/emsk/Kconfig.defconfig"
osource "/home/aaron/Development/Launch/zephyr/soc/snps/emsdp/Kconfig.defconfig"
osource "/home/aaron/Development/Launch/zephyr/soc/snps/arc_iot/Kconfig.defconfig"
osource "/home/aaron/Development/Launch/zephyr/soc/silabs/Kconfig.defconfig"
osource "/home/aaron/Development/Launch/zephyr/soc/sifive/sifive_freedom/Kconfig.defconfig"
osource "/home/aaron/Development/Launch/zephyr/soc/rockchip/Kconfig.defconfig"
osource "/home/aaron/Development/Launch/zephyr/soc/renode/riscv_virtual/Kconfig.defconfig"
osource "/home/aaron/Development/Launch/zephyr/soc/renesas/smartbond/Kconfig.defconfig"
osource "/home/aaron/Development/Launch/zephyr/soc/renesas/rzt2m/Kconfig.defconfig"
osource "/home/aaron/Development/Launch/zephyr/soc/renesas/rcar/Kconfig.defconfig"
osource "/home/aaron/Development/Launch/zephyr/soc/renesas/ra/Kconfig.defconfig"
osource "/home/aaron/Development/Launch/zephyr/soc/raspberrypi/Kconfig.defconfig"
osource "/home/aaron/Development/Launch/zephyr/soc/quicklogic/eos_s3/Kconfig.defconfig"
osource "/home/aaron/Development/Launch/zephyr/soc/qemu/virt_riscv/Kconfig.defconfig"
osource "/home/aaron/Development/Launch/zephyr/soc/qemu/malta/Kconfig.defconfig"
osource "/home/aaron/Development/Launch/zephyr/soc/openisa/rv32m1/Kconfig.defconfig"
osource "/home/aaron/Development/Launch/zephyr/soc/nxp/s32/Kconfig.defconfig"
osource "/home/aaron/Development/Launch/zephyr/soc/nxp/rw/Kconfig.defconfig"
osource "/home/aaron/Development/Launch/zephyr/soc/nxp/mcx/Kconfig.defconfig"
osource "/home/aaron/Development/Launch/zephyr/soc/nxp/lpc/Kconfig.defconfig"
osource "/home/aaron/Development/Launch/zephyr/soc/nxp/layerscape/Kconfig.defconfig"
osource "/home/aaron/Development/Launch/zephyr/soc/nxp/kinetis/Kconfig.defconfig"
osource "/home/aaron/Development/Launch/zephyr/soc/nxp/imxrt/Kconfig.defconfig"
osource "/home/aaron/Development/Launch/zephyr/soc/nxp/imx/Kconfig.defconfig"
osource "/home/aaron/Development/Launch/zephyr/soc/nuvoton/numicro/Kconfig.defconfig"
osource "/home/aaron/Development/Launch/zephyr/soc/nuvoton/numaker/Kconfig.defconfig"
osource "/home/aaron/Development/Launch/zephyr/soc/nuvoton/npcx/Kconfig.defconfig"
osource "/home/aaron/Development/Launch/zephyr/soc/nordic/Kconfig.defconfig"
osource "/home/aaron/Development/Launch/zephyr/soc/neorv32/Kconfig.defconfig"
osource "/home/aaron/Development/Launch/zephyr/soc/native/inf_clock/Kconfig.defconfig"
osource "/home/aaron/Development/Launch/zephyr/soc/microchip/miv/Kconfig.defconfig"
osource "/home/aaron/Development/Launch/zephyr/soc/microchip/mec/Kconfig.defconfig"
osource "/home/aaron/Development/Launch/zephyr/soc/mediatek/mtk_adsp/Kconfig.defconfig"
osource "/home/aaron/Development/Launch/zephyr/soc/lowrisc/opentitan/Kconfig.defconfig"
osource "/home/aaron/Development/Launch/zephyr/soc/litex/litex_vexriscv/Kconfig.defconfig"
osource "/home/aaron/Development/Launch/zephyr/soc/ite/ec/Kconfig.defconfig"
osource "/home/aaron/Development/Launch/zephyr/soc/intel/raptor_lake/Kconfig.defconfig"
osource "/home/aaron/Development/Launch/zephyr/soc/intel/lakemont/Kconfig.defconfig"
osource "/home/aaron/Development/Launch/zephyr/soc/intel/intel_socfpga_std/Kconfig.defconfig"
osource "/home/aaron/Development/Launch/zephyr/soc/intel/intel_socfpga/Kconfig.defconfig"
osource "/home/aaron/Development/Launch/zephyr/soc/intel/intel_niosv/Kconfig.defconfig"
osource "/home/aaron/Development/Launch/zephyr/soc/intel/intel_ish/Kconfig.defconfig"
osource "/home/aaron/Development/Launch/zephyr/soc/intel/intel_adsp/Kconfig.defconfig"
osource "/home/aaron/Development/Launch/zephyr/soc/intel/elkhart_lake/Kconfig.defconfig"
osource "/home/aaron/Development/Launch/zephyr/soc/intel/atom/Kconfig.defconfig"
osource "/home/aaron/Development/Launch/zephyr/soc/intel/apollo_lake/Kconfig.defconfig"
osource "/home/aaron/Development/Launch/zephyr/soc/intel/alder_lake/Kconfig.defconfig"
osource "/home/aaron/Development/Launch/zephyr/soc/infineon/cat3/Kconfig.defconfig"
osource "/home/aaron/Development/Launch/zephyr/soc/infineon/cat1b/Kconfig.defconfig"
osource "/home/aaron/Development/Launch/zephyr/soc/infineon/cat1a/Kconfig.defconfig"
osource "/home/aaron/Development/Launch/zephyr/soc/gd/gd32/Kconfig.defconfig"
osource "/home/aaron/Development/Launch/zephyr/soc/gaisler/leon3/Kconfig.defconfig"
osource "/home/aaron/Development/Launch/zephyr/soc/gaisler/gr716a/Kconfig.defconfig"
osource "/home/aaron/Development/Launch/zephyr/soc/espressif/Kconfig.defconfig"
osource "/home/aaron/Development/Launch/zephyr/soc/ene/kb1200/Kconfig.defconfig"
osource "/home/aaron/Development/Launch/zephyr/soc/efinix/sapphire/Kconfig.defconfig"
osource "/home/aaron/Development/Launch/zephyr/soc/cdns/xtensa_sample_controller/Kconfig.defconfig"
osource "/home/aaron/Development/Launch/zephyr/soc/cdns/dc233c/Kconfig.defconfig"
osource "/home/aaron/Development/Launch/zephyr/soc/brcm/bcmvk/Kconfig.defconfig"
osource "/home/aaron/Development/Launch/zephyr/soc/brcm/bcm2712/Kconfig.defconfig"
osource "/home/aaron/Development/Launch/zephyr/soc/brcm/bcm2711/Kconfig.defconfig"
osource "/home/aaron/Development/Launch/zephyr/soc/atmel/sam0/Kconfig.defconfig"
osource "/home/aaron/Development/Launch/zephyr/soc/atmel/sam/Kconfig.defconfig"
osource "/home/aaron/Development/Launch/zephyr/soc/aspeed/Kconfig.defconfig"
osource "/home/aaron/Development/Launch/zephyr/soc/arm/Kconfig.defconfig"
osource "/home/aaron/Development/Launch/zephyr/soc/arm/beetle/Kconfig.defconfig"
osource "/home/aaron/Development/Launch/zephyr/soc/andestech/Kconfig.defconfig"
osource "/home/aaron/Development/Launch/zephyr/soc/ambiq/Kconfig.defconfig"
osource "/home/aaron/Development/Launch/zephyr/soc/altr/zephyr_nios2f/Kconfig.defconfig"
osource "/home/aaron/Development/Launch/zephyr/soc/altr/qemu_nios2/Kconfig.defconfig"
osource "/home/aaron/Development/Launch/zephyr/soc/adi/max32/Kconfig.defconfig"
```
