## CMakeLists.txt
```
#-------------------------------------------------------------------------------
# Backplane Power Module Application
#
# Copyright (c) 2023 Launch Initiative
# SPDX-License-Identifier: Apache-2.0

cmake_minimum_required(VERSION 3.13.1)
find_package(Zephyr REQUIRED HINTS $ENV{ZEPHYR_BASE})

project(power-module LANGUAGES C CXX)

FILE(GLOB sources src/*.c src/*.cpp)
target_include_directories(app PRIVATE include)
target_sources(app PRIVATE ${sources})
```

## sample.yaml
```
sample:
  description:
  name: power-module
common:
  build_only: true
  integration_platforms:
    - power_module@2
tests:
  app.default: {}
  app.debug:
    extra_overlay_confs:
      - debug.conf
```

## prj.conf
```kconfig
# Copyright (c) 2024 RIT Launch Initiative
# SPDX-License-Identifier: Apache-2.0

# ADC
CONFIG_ADC=y
CONFIG_ADC_ASYNC=y

# Clocks
CONFIG_CLOCK_CONTROL=y

# CPP
CONFIG_CPP=y
CONFIG_REQUIRES_FULL_LIBCPP=y
CONFIG_STD_CPP20=y

# Dynamic threads
CONFIG_DYNAMIC_THREAD=y
# Max stack size for dynamic threads
CONFIG_DYNAMIC_THREAD_STACK_SIZE=512
# Number of threads in the dynamic thread pool
# (Zephyr wants 4 for some reason instead of 2)
CONFIG_DYNAMIC_THREAD_POOL_SIZE=4

# F-Core
CONFIG_F_CORE=y

# Flash
CONFIG_FLASH=y
CONFIG_FLASH_MAP=y
CONFIG_FLASH_PAGE_LAYOUT=y

# Filesystem
CONFIG_FLASH=y
CONFIG_FLASH_MAP=y
CONFIG_FLASH_PAGE_LAYOUT=y
CONFIG_DISK_ACCESS=y
CONFIG_FILE_SYSTEM=y
CONFIG_FILE_SYSTEM_LITTLEFS=y
CONFIG_FS_LITTLEFS_FMP_DEV=y

# Hashmap for UDP
CONFIG_SYS_HASH_MAP=y
CONFIG_SYS_HASH_FUNC32=y

# IO
CONFIG_GPIO=y
CONFIG_I2C=y
CONFIG_PINCTRL=y
CONFIG_SERIAL=y
CONFIG_LED=y

# OS
CONFIG_POLL=y
CONFIG_MAIN_STACK_SIZE=4096
CONFIG_STACK_USAGE=y
CONFIG_TIMESLICE_SIZE=50

# Launch Core
CONFIG_LAUNCH_CORE=y
CONFIG_LAUNCH_CORE_NET=y

# State Machine
CONFIG_SMF=y

# SPI
CONFIG_SPI=y
CONFIG_SPI_ASYNC=y
CONFIG_SPI_STM32_INTERRUPT=y
# CONFIG_SPI_STM32_DMA=y
CONFIG_SPI_RTIO=y

# Networking
CONFIG_NETWORKING=y
CONFIG_NET_ARP_TABLE_SIZE=4
CONFIG_NET_CONTEXT_RCVTIMEO=y
CONFIG_NET_DEFAULT_IF_ETHERNET=y
CONFIG_NET_DRIVERS=y
CONFIG_NET_IPV4=y
CONFIG_NET_IPV6=n
CONFIG_NET_L2_ETHERNET=y
CONFIG_NET_L2_ETHERNET_MGMT=y
CONFIG_NET_MAX_CONN=10
CONFIG_NET_SOCKETS=y
CONFIG_NET_SOCKETS_POSIX_NAMES=y
CONFIG_NET_STATISTICS=y
CONFIG_SNTP=y

# RNG (Needed for networking)
CONFIG_ENTROPY_GENERATOR=y
CONFIG_TEST_RANDOM_GENERATOR=y # TODO: See if its worth using STM32 HW RNG to remove warning

# Sensors
CONFIG_SENSOR=y
CONFIG_SENSOR_ASYNC_API=y


# OS
CONFIG_POLL=y
CONFIG_MAIN_STACK_SIZE=1024
CONFIG_STACK_USAGE=y

CONFIG_TIMESLICING=y
CONFIG_TIMESLICE_SIZE=50000
CONFIG_TIMESLICE_PRIORITY=0
CONFIG_THREAD_STACK_INFO=y
```

## src/main.c
```c
/*
 * Copyright (c) 2023 RIT Launch Initiative
 *
 * SPDX-License-Identifier: Apache-2.0
 */

#include "power_module.h"

#include <launch_core_classic/os/fs.h>
#include <launch_core_classic/utils/event_monitor.h>
#include <zephyr/drivers/gpio.h>
#include <zephyr/kernel.h>
#include <zephyr/logging/log.h>
#include <zephyr/smf.h>

LOG_MODULE_REGISTER(main, CONFIG_APP_POWER_MODULE_LOG_LEVEL);

#define DEFINE_STATE_FUNCTIONS(state_name)                                                                             \
    static void state_name##_state_entry(void *);                                                                      \
    static void state_name##_state_run(void *);                                                                        \
    static void state_name##_state_exit(void *) {}

struct s_object {
    struct smf_ctx ctx;
} state_obj;

bool logging_enabled; // Keep separate from s_object to eliminate extra #includes in other src fiels

DEFINE_STATE_FUNCTIONS(ground);
DEFINE_STATE_FUNCTIONS(flight);

static const struct smf_state states[] = {
    [GROUND_STATE] = SMF_CREATE_STATE(ground_state_entry, ground_state_run, ground_state_exit),
    [FLIGHT_STATE] = SMF_CREATE_STATE(flight_state_entry, flight_state_run, flight_state_exit),
};

static void ground_state_entry(void *) {
    LOG_INF("Entered ground state");
    logging_enabled = false;
}

static void ground_state_run(void *) {
    while (true) {
        if (l_get_event_udp() == L_BOOST_DETECTED) {
            smf_set_state(SMF_CTX(&state_obj), &states[FLIGHT_STATE]);
            return;
        }
    }
}
static void flight_state_entry(void *) {
    LOG_INF("Entered flight state");
    logging_enabled = true;
}

static void flight_state_run(void *) {
    while (true) {
        if (l_get_event_udp() == L_LANDING_DETECTED) {
            smf_set_state(SMF_CTX(&state_obj), &states[GROUND_STATE]);
            return;
        }
    }
}

static void init() {
    init_networking();

    smf_set_initial(SMF_CTX(&state_obj), &states[GROUND_STATE]);
    l_init_event_monitor(POWER_MODULE_IP_ADDR);
}

int main(void) {
    init();

    while (true) {
        static int ret = 0;
        if (ret == 0) {
            ret = smf_run_state(SMF_CTX(&state_obj));
            if (ret < 0) {
                LOG_ERR("Failed to run state machine: %d", ret);
            }
        }
    }

    return 0;
}
```

## src/main.cpp
```c
/*
* Copyright (c) 2024 RIT Launch Initiative
 *
 * SPDX-License-Identifier: Apache-2.0
 */

#include "c_power_module.h"

// F-Core Includes
#include <f_core/os/n_rtos.h>

int main() {
    static CPowerModule config{};

    NRtos::StartRtos();

    return 0;
}
```

## include/c_adc_monitor.h
```c
#ifndef C_ADC_MONITOR_H
#define C_ADC_MONITOR_H

#include <f_core/os/c_task.h>

class CAdcMonitor : public CTask {
public:
    CAdcMonitor(const char *name, uint8_t priority, uint32_t stackSize) : CTask(name, priority, stackSize) {}

    void Run() override;
private:
    // TODO: ADC class
};



#endif //C_ADC_MONITOR_H
```

## include/c_power_module.h
```c
#ifndef C_POWER_MODULE_H
#define C_POWER_MODULE_H

// Tenant Includes
#include "c_adc_monitor.h"
#include "c_shunt_monitor.h"

// F-Core Includes
#include <f_core/os/c_task.h>

class CPowerModule {
public:
    CPowerModule() = default;

    void Initialize();

private:
    CTask telemetryTask{"Telemetry Task", 15, 512};
    CTask broadcastTask{"Broadcast Task", 15, 512};
    CTask dataLogTask{"Data Logging Task", 15, 512};

    // CTenant *shuntMonitorTenant{"Shunt Monitor"};
    // CTenant *adcMonitorTenant{"ADC Monitor"};
    // CTenant *telemetryBroadcastTenant{"Telemetry Broadcast"};
    // CTenant *dataLogTenant{"Data Logging"};

    // TODO: OMG FORGOT THE SHUNT SENSOR CLASS
    const device &ina3v3 = *DEVICE_DT_GET(DT_ALIAS(ina3v3));
    const device &ina5v0 = *DEVICE_DT_GET(DT_ALIAS(ina5v0));
    const device &inaBatt = *DEVICE_DT_GET(DT_ALIAS(inabatt));
    void addTenantsToTasks();
};



#endif //C_POWER_MODULE_H
```

## include/c_power_module_configuration.h
```c
#ifndef C_POWER_MODULE_CONFIGURATION_H
#define C_POWER_MODULE_CONFIGURATION_H

#include <f_core/c_project_configuration.h>
#include <f_core/os/c_task.h>
#include <f_core/os/c_tenant.h>

class CPowerModuleConfiguration : public CProjectConfiguration {
public:
    CPowerModuleConfiguration();

    void SetupTasks() override;

private:
    // Tasks
    CTask powerMonitorTask;
    CTask ethernetTask;
    CTask loggingTask;
};

#endif //C_POWER_MODULE_CONFIGURATION_H
```

## include/c_shunt_monitor.h
```c
#ifndef C_SHUNT_MONITOR_H
#define C_SHUNT_MONITOR_H

// F-Core Includes
#include <f_core/os/c_task.h>

class CSensorDevice;

class CShuntMonitor : public CTask {
public:
    CShuntMonitor(const char *name, uint8_t priority, uint32_t stackSize) : CTask(name, priority, stackSize) {}

    void Run() override;

private:
    CSensorDevice &ina3v3;
    CSensorDevice &ina5v0;
    CSensorDevice &inaBatt;
};



#endif //C_SHUNT_MONITOR_H
```

## include/power_module.h
```c
#ifndef POWER_MODULE_H
#define POWER_MODULE_H

#include <launch_core_classic/backplane_defs.h>
#include <launch_core_classic/net/net_common.h>
#include <launch_core_classic/types.h>

#define POWER_MODULE_IP_ADDR BACKPLANE_IP(POWER_MODULE_ID, 2, 1) // TODO: Make this configurable

typedef enum {
    GROUND_STATE = 0,
    FLIGHT_STATE,
} FLIGHT_STATES;

typedef struct __attribute__((packed)) {
    uint64_t timestamp;
    power_module_telemetry_t data;
} timed_power_module_telemetry_t;

typedef struct __attribute__((packed)) {
    uint64_t timestamp;
    float data;
} timed_adc_telemetry_t;

/**
 * Initialize networking
 */
void init_networking();

/**
 * Task for reading INA219 sensor data into a queue
 */
void ina_task(void);

/**
 * Task for reading ADC data into a queue
 */
void adc_task(void);

/**
 * Task for broadcasting data from a queue over UDP
 */
void telemetry_broadcast_task(void);

#endif //POWER_MODULE_H
```

## src/c_adc_monitor.cpp
```c
#include "c_adc_monitor.h"

void CAdcMonitor::Run() {

}
```

## src/c_power_module.cpp
```c
#include "c_power_module.h"
```

## src/c_power_module_configuration.cpp
```c
#include "c_power_module_configuration.h"

CPowerModuleConfiguration::CPowerModuleConfiguration() {}

void CPowerModuleConfiguration::SetupTasks() {

}
```

## src/c_shunt_monitor.cpp
```c
#include "c_shunt_monitor.h"

#include <f_core/device/sensor/c_sensor_device.h>

void CShuntMonitor::Run() {
    ina3v3.UpdateSensorValue();
    ina5v0.UpdateSensorValue();
    inaBatt.UpdateSensorValue();

    // TODO: Need a types file to create a telemetry message
}
```

## src/logging.c
```c
// Self Include
#include "power_module.h"

// Launch Includes
#include <launch_core_classic/os/fs.h>
#include <launch_core_classic/types.h>

// Zephyr Includes
#include <zephyr/drivers/gpio.h>
#include <zephyr/kernel.h>
#include <zephyr/logging/log.h>

#define LOGGING_STACK_SIZE 4096
#define MAX_DIR_NAME_LEN   10 // 4 number boot count + 5 for "/lfs/" + 1 for end slash
#define MAX_FILE_NAME_LEN  3

#define INA_SAMPLE_COUNT  4600          // 15 samples per second for 5 minutes (rounded to nearest hundred)
#define ADC_SAMPLE_COUNT  16000         // 50 samples per second for 5 minutes (rounded to nearest thousand)
#define GNSS_SAMPLE_COUNT (10 * 60 / 2) // 1 samples every 2 seconds for 10 minutes
LOG_MODULE_REGISTER(logging);

static void logging_task(void);
K_THREAD_DEFINE(data_logger, LOGGING_STACK_SIZE, logging_task, NULL, NULL, NULL, K_PRIO_PREEMPT(20), 0, 1000);

// Message queues
// TODO: Avoid duplicate queues. Fine for now since this isn't too expensive and we have the memory.
// Easier for now since we also need to buffer data before launch
K_MSGQ_DEFINE(ina_logging_msgq, sizeof(timed_power_module_telemetry_t), 50, 4);
K_MSGQ_DEFINE(adc_logging_msgq, sizeof(timed_adc_telemetry_t), 200, 4);
K_MSGQ_DEFINE(gnss_logging_msgq, sizeof(l_gnss_time_sync_t), 200, 4);

#ifdef CONFIG_SEND_LAST_LOG
#include <launch_core_classic/net/tftp.h>
static void send_last_log(const uint32_t boot_count_to_get) {
    LOG_INF("Attempting to send last logs over TFTP");
    // Open /lfs/current_boot_count-1 directory
    char dir_name[MAX_DIR_NAME_LEN] = "";
    snprintf(dir_name, sizeof(dir_name), "/lfs/%d", boot_count_to_get);

    // Setup output file names
    char ina_output_file_name[MAX_FILE_NAME_LEN + 4] = "";
    snprintf(ina_output_file_name, sizeof(ina_output_file_name), "ina_%d", boot_count_to_get);

    char adc_output_file_name[MAX_DIR_NAME_LEN + MAX_FILE_NAME_LEN + 1] = "";
    snprintf(adc_output_file_name, sizeof(adc_output_file_name), "adc_%d", boot_count_to_get);
    LOG_INF("Writing last logs to %s and %s", ina_output_file_name, adc_output_file_name);

    // Read INA into buffer
    char ina_file_name[MAX_DIR_NAME_LEN + MAX_FILE_NAME_LEN + 1] = "";
    snprintf(ina_file_name, sizeof(ina_file_name), "%s/ina", dir_name);
    l_fs_file_t ina_file = {
        .fname = ina_file_name,
        .width = sizeof(timed_power_module_telemetry_t),
        .mode = SLOG_ONCE,
        .size = sizeof(timed_power_module_telemetry_t) * INA_SAMPLE_COUNT,
        .initialized = false,
        .file = {0},
        .dirent = {0},
        .vfs = {0},
        .wpos = 0,
    };

    char adc_file_name[MAX_DIR_NAME_LEN + MAX_FILE_NAME_LEN + 1] = "";
    snprintf(adc_file_name, sizeof(adc_file_name), "%s/adc", dir_name);
    l_fs_file_t adc_file = {
        .fname = adc_file_name,
        .width = sizeof(timed_adc_telemetry_t),
        .mode = SLOG_ONCE,
        .size = sizeof(timed_adc_telemetry_t) * ADC_SAMPLE_COUNT,
        .initialized = false,
        .file = {0},
        .dirent = {0},
        .vfs = {0},
        .wpos = 0,
    };

    static char gnss_file_name[MAX_DIR_NAME_LEN + MAX_FILE_NAME_LEN + 1] = "";
    snprintf(gnss_file_name, sizeof(gnss_file_name), "%s/gns", dir_name);
    static l_fs_file_t gnss_file = {
        .fname = gnss_file_name,
        .width = sizeof(l_gnss_time_sync_t),
        .mode = SLOG_ONCE,
        .size = sizeof(l_gnss_time_sync_t) * GNSS_SAMPLE_COUNT,
        .initialized = false,
        .file = {0},
        .dirent = {0},
        .vfs = {0},
        .wpos = 0,
    };

    timed_power_module_telemetry_t ina_data[INA_SAMPLE_COUNT] = {0};
    size_t ina_log_file_size = l_fs_file_size(&ina_file);
    LOG_INF("Previous INA219 Log File Size: %d", ina_log_file_size);
    if ((l_fs_init(&ina_file) == 0) && fs_read(&ina_file.file, &ina_data, ina_log_file_size)) {
        l_tftp_init_and_put(L_DEFAULT_SERVER_IP, ina_output_file_name, (uint8_t *) &ina_data, ina_log_file_size);
        l_fs_close(&ina_file);
    } else {
        LOG_ERR("Failed to read INA data from file.");
    }

    timed_adc_telemetry_t adc_data[ADC_SAMPLE_COUNT] = {0};
    size_t adc_log_file_size = l_fs_file_size(&adc_file);
    LOG_INF("Previous ADC Log File Size: %d", adc_log_file_size);
    if ((l_fs_init(&adc_file) == 0) && fs_read(&adc_file.file, &adc_data, adc_log_file_size)) {
        l_tftp_init_and_put(L_DEFAULT_SERVER_IP, adc_output_file_name, (uint8_t *) &adc_data, adc_log_file_size);
        l_fs_close(&adc_file);
    } else {
        LOG_ERR("Failed to read ADC data from file.");
    }

    timed_sensor_module_ten_hz_telemetry_t gnss_data[TEN_HZ_SAMPLE_COUNT] = {0};
    size_t gnss_log_file_size = l_fs_file_size(&gnss_file);
    LOG_INF("Previous gnss Log File Size: %d", gnss_log_file_size);
    if ((l_fs_init(&gnss_file) == 0) && fs_read(&gnss_file.file, &gnss_data, gnss_log_file_size)) {
        l_tftp_init_and_put(L_DEFAULT_SERVER_IP, gnss_file_name, (uint8_t *) &gnss_data, gnss_log_file_size);
        l_fs_close(&gnss_file);
    } else {
        LOG_ERR("Failed to read gnss data from file.");
    }
}
#endif

static void init_logging(l_fs_file_t **p_ina_file, l_fs_file_t **p_adc_file, l_fs_file_t **p_gnss_file) {
    uint32_t boot_count = l_fs_boot_count_check();
#ifdef CONFIG_SEND_LAST_LOG
    send_last_log(boot_count);
#endif
    // Create directory with boot count
    char dir_name[MAX_DIR_NAME_LEN] = "";
    snprintf(dir_name, sizeof(dir_name), "/lfs/%d", boot_count);
    LOG_INF("Logging files to %s", dir_name);
    fs_mkdir(dir_name);

    // Create filenames
    static char ina_file_name[MAX_DIR_NAME_LEN + MAX_FILE_NAME_LEN + 1] = "";
    snprintf(ina_file_name, sizeof(ina_file_name), "%s/ina", dir_name);

    static char adc_file_name[MAX_DIR_NAME_LEN + MAX_FILE_NAME_LEN + 1] = "";
    snprintf(adc_file_name, sizeof(adc_file_name), "%s/adc", dir_name);

    static char gnss_file_name[MAX_DIR_NAME_LEN + MAX_FILE_NAME_LEN + 1] = "";
    snprintf(gnss_file_name, sizeof(gnss_file_name), "%s/gns", dir_name);

    // Initialize structs
    static l_fs_file_t ina_file = {
        .fname = ina_file_name,
        .width = sizeof(timed_power_module_telemetry_t),
        .mode = SLOG_ONCE,
        .size = sizeof(timed_power_module_telemetry_t) * INA_SAMPLE_COUNT,
        .initialized = false,
        .file = {0},
        .dirent = {0},
        .vfs = {0},
        .wpos = 0,
    };

    static l_fs_file_t adc_file = {
        .fname = adc_file_name,
        .width = sizeof(timed_adc_telemetry_t),
        .mode = SLOG_ONCE,
        .size = sizeof(timed_adc_telemetry_t) * ADC_SAMPLE_COUNT,
        .initialized = false,
        .file = {0},
        .dirent = {0},
        .vfs = {0},
        .wpos = 0,
    };

    static l_fs_file_t gnss_file = {
        .fname = gnss_file_name,
        .width = sizeof(l_gnss_time_sync_t),
        .mode = SLOG_ONCE,
        .size = sizeof(l_gnss_time_sync_t) * GNSS_SAMPLE_COUNT,
        .initialized = false,
        .file = {0},
        .dirent = {0},
        .vfs = {0},
        .wpos = 0,
    };

    LOG_INF("Creating files %s, %s, and %s", ina_file_name, adc_file_name, gnss_file_name);

    // Initialize files
    if (l_fs_init(&ina_file) == 0) {
        LOG_INF("Successfully created file for storing INA219 data.");
        *p_ina_file = &ina_file;
    }

    if (l_fs_init(&adc_file) == 0) {
        LOG_INF("Successfully created file for storing ADC data.");
        *p_adc_file = &adc_file;
    }
    if (l_fs_init(&gnss_file) == 0) {
        LOG_INF("Successfully created file for storing GNSS data.");
        *p_adc_file = &gnss_file;
    }
}

extern bool logging_enabled;

static void logging_task(void) {
    static const struct gpio_dt_spec led1 = GPIO_DT_SPEC_GET(DT_ALIAS(led1), gpios);
    static const struct gpio_dt_spec led3 = GPIO_DT_SPEC_GET(DT_ALIAS(led3), gpios);

    l_fs_file_t *ina_file = NULL;
    l_fs_file_t *adc_file = NULL;
    l_fs_file_t *gnss_file = NULL;

    timed_power_module_telemetry_t sensor_telemetry;
    timed_adc_telemetry_t vin_adc_data_v;
    l_gnss_time_sync_t gnss_data;

    init_logging(&ina_file, &adc_file, &gnss_file);

    bool ina_out_of_space = false;
    bool adc_out_of_space = false;
    bool gnss_out_of_space = false;

    while (true) {
        if (!logging_enabled) {
            continue;
        }

        if (!k_msgq_get(&ina_logging_msgq, &sensor_telemetry, K_MSEC(10)) && (ina_file != NULL) &&
            (!ina_out_of_space)) {
            LOG_INF("Logged INA219 data");
            gpio_pin_toggle_dt(&led1);

            int32_t err_flag = 0;
            l_fs_write(ina_file, (const uint8_t *) &sensor_telemetry, &err_flag);
            ina_out_of_space = err_flag == -ENOSPC;
            LOG_INF("%d", err_flag);
        }

        if (!k_msgq_get(&adc_logging_msgq, &vin_adc_data_v, K_MSEC(3)) && (adc_file != NULL) && (!adc_out_of_space)) {
            LOG_INF("Logged ADC data");
            gpio_pin_toggle_dt(&led3);

            int32_t err_flag = 0;
            l_fs_write(adc_file, (const uint8_t *) &vin_adc_data_v, &err_flag);
            adc_out_of_space = err_flag == -ENOSPC;
            LOG_INF("%d", err_flag);
        }
        if (!k_msgq_get(&gnss_logging_msgq, &gnss_data, K_MSEC(3)) && (gnss_file != NULL) && (!gnss_out_of_space)) {
            LOG_INF("Logged GNSS data");
            gpio_pin_toggle_dt(&led3);

            int32_t err_flag = 0;
            l_fs_write(gnss_file, (const uint8_t *) &gnss_data, &err_flag);
            gnss_out_of_space = err_flag == -ENOSPC;
            LOG_INF("%d", err_flag);
        }

        if (ina_out_of_space && adc_out_of_space && gnss_out_of_space) {
            LOG_ERR("Out of space on both INA219, ADC and GNSS files. Stopping logging.");
            logging_enabled = false;
            l_fs_close(ina_file);
            l_fs_close(adc_file);
            l_fs_close(gnss_file);
            return;
        }
    }
}
```

## src/networking.c
```c
/*
 * Copyright (c) 2024 RIT Launch Initiative
 *
 * SPDX-License-Identifier: Apache-2.0
 */

// Self Include
#include "power_module.h"

// Launch Includes
#include <launch_core_classic/backplane_defs.h>
#include <launch_core_classic/dev/dev_common.h>
#include <launch_core_classic/net/net_common.h>
#include <launch_core_classic/net/udp.h>
#include <launch_core_classic/types.h>

// Zephyr Includes
#include <zephyr/drivers/gpio.h>
#include <zephyr/logging/log.h>

#define QUEUE_PROCESSING_STACK_SIZE (1024)
#define NUM_SOCKETS                 1

// TODO: Annoying RTOS setup where priority needs to be higher than other tasks and queues need to sleep
// Otherwise, logging task gets starved during flight
K_THREAD_DEFINE(telemetry_broadcast, QUEUE_PROCESSING_STACK_SIZE, telemetry_broadcast_task, NULL, NULL, NULL,
                K_PRIO_PREEMPT(19), 0, 1000);

extern struct k_msgq ina_telemetry_msgq;
extern struct k_msgq adc_telemetry_msgq;

static int udp_sockets[NUM_SOCKETS] = {0};
static int udp_socket_ports[] = {POWER_MODULE_BASE_PORT + POWER_MODULE_INA_DATA_PORT};
static l_udp_socket_list_t udp_socket_list = {.sockets = udp_sockets, .num_sockets = NUM_SOCKETS};

LOG_MODULE_REGISTER(networking);

void init_networking() {
    const struct device *wiznet = DEVICE_DT_GET_ONE(wiznet_w5500);
    if (l_check_device(wiznet) != 0) {
        LOG_ERR("Wiznet device not found");
        return;
    }

    int ret = l_init_udp_net_stack_default(POWER_MODULE_IP_ADDR);
    if (ret != 0) {
        LOG_ERR("Failed to initialize UDP networking stack: %d", ret);
        return;
    }

    for (int i = 0; i < udp_socket_list.num_sockets; i++) {
        udp_socket_list.sockets[i] = l_init_udp_socket(POWER_MODULE_IP_ADDR, udp_socket_ports[i]);
        if (udp_socket_list.sockets[i] < 0) {
            LOG_ERR("Failed to create UDP socket: %d", udp_socket_list.sockets[i]);
            return;
        }
    }
}

void telemetry_broadcast_task(void) {
    static const struct gpio_dt_spec led0 = GPIO_DT_SPEC_GET(DT_ALIAS(led0), gpios);

    power_module_telemetry_t sensor_telemetry = {0};
    int sock = udp_socket_list.sockets[0];

    while (true) {
        if (!k_msgq_get(&ina_telemetry_msgq, &sensor_telemetry, K_MSEC(10))) {
            gpio_pin_toggle_dt(&led0);
            l_send_udp_broadcast(sock, (uint8_t *) &sensor_telemetry, sizeof(sensor_telemetry),
                                 POWER_MODULE_BASE_PORT + POWER_MODULE_INA_DATA_PORT);
        }
    }
}
```
