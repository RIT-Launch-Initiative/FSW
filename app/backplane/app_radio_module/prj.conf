## CMakeLists.txt
```
set(BOARD radio_module)
set(BOARD_ROOT ${CMAKE_CURRENT_SOURCE_DIR})

cmake_minimum_required(VERSION 3.13.1)
find_package(Zephyr REQUIRED HINTS $ENV{ZEPHYR_BASE})

project(radio-module LANGUAGES C)

FILE(GLOB sources src/*.c)
target_include_directories(app PRIVATE include)
target_sources(app PRIVATE ${sources})
```

## Kconfig
```
# Copyright (c) 2021 Nordic Semiconductor ASA
# SPDX-License-Identifier: Apache-2.0
#
# This file is the application Kconfig entry point. All application Kconfig
# options can be defined here or included via other application Kconfig files.
# You can browse these options using the west targets menuconfig (terminal) or
# guiconfig (GUI).

menu "Zephyr"
source "Kconfig.zephyr"
endmenu

menuconfig RADIO_MODULE_RECEIVER
	bool "Radio module is the ground receiver"
	default n

config LORA_TX_QUEUE_SIZE
	int "LoRa TX queue size"
	default 16
	help
	  The number of LoRa packets that can be queued for transmission.

config GNSS_DATA_TX_INTERVAL
	int "GNSS data tx interval (miliseconds)"
	default 5000
	help
	  The interval at which GNSS data is transmitted through LoRa in milliseconds.

module = APP_RADIO_MODULE
module-str = APP_RADIO_MODULE
source "subsys/logging/Kconfig.template.log_config"
```

## prj.conf
```kconfig
# Copyright (c) 2023 RIT Launch Initiative
# SPDX-License-Identifier: Apache-2.0

# Clocks
CONFIG_CLOCK_CONTROL=y

# CPP
CONFIG_CPP=y

# Flash
CONFIG_FLASH=y
CONFIG_FLASH_MAP=y
CONFIG_FLASH_PAGE_LAYOUT=y

# Filesystem
CONFIG_FLASH=y
CONFIG_FLASH_MAP=y
CONFIG_FLASH_PAGE_LAYOUT=y
CONFIG_DISK_ACCESS=y
CONFIG_FILE_SYSTEM=y
CONFIG_FILE_SYSTEM_LITTLEFS=y
CONFIG_FS_LITTLEFS_BLK_DEV=y

# GNSS
CONFIG_GNSS=y
CONFIG_GNSS_SATELLITES=y
CONFIG_GNSS_NMEA0183=y

# Hashmap for UDP
CONFIG_SYS_HASH_MAP=y
CONFIG_SYS_HASH_FUNC32=y

# IO
CONFIG_GPIO=y
CONFIG_I2C=y
#CONFIG_I2C_CALLBACK=y
CONFIG_PINCTRL=y
CONFIG_SERIAL=y
CONFIG_SPI=y
# CONFIG_SPI_RTIO=y
CONFIG_LED=y

# LoRa
CONFIG_LORA=y
CONFIG_LORA_SX127X=y

# OS
CONFIG_TIMESLICE_SIZE=50
CONFIG_MAIN_STACK_SIZE=2048

# RNG (Needed for networking)
CONFIG_ENTROPY_GENERATOR=y
CONFIG_TEST_RANDOM_GENERATOR=y # TODO: See if its worth using STM32 HW RNG to remove warning

# SPI
CONFIG_SPI_STM32_INTERRUPT=y
#CONFIG_SPI_STM32_DMA=y
CONFIG_SPI_ASYNC=y

# State Machine
CONFIG_SMF=y

# Modem
CONFIG_MODEM_BACKEND_UART=y

# Networking
CONFIG_NETWORKING=y
CONFIG_NET_ARP_TABLE_SIZE=4
CONFIG_NET_CONTEXT_RCVTIMEO=y
CONFIG_NET_DEFAULT_IF_ETHERNET=y
CONFIG_NET_DRIVERS=y
CONFIG_NET_IPV4=y
CONFIG_NET_IPV6=n
CONFIG_NET_L2_ETHERNET=y
CONFIG_NET_MAX_CONN=10
CONFIG_NET_SOCKETS=y
CONFIG_NET_PKT_RX_COUNT=32
CONFIG_NET_BUF_RX_COUNT=32
CONFIG_NET_BUF_DATA_SIZE=1100

# UART
CONFIG_UART_INTERRUPT_DRIVEN=y
```

## src/main.c
```c
// Application Includes
#include "radio_module_functionality.h"

#include <launch_core_classic/os/fs.h>
// Zephyr Includes
#include <zephyr/drivers/gpio.h>
#include <zephyr/kernel.h>
#include <zephyr/logging/log.h>
#include <zephyr/storage/flash_map.h>

#define SLEEP_TIME_MS 100

LOG_MODULE_REGISTER(main, CONFIG_APP_RADIO_MODULE_LOG_LEVEL);

// Queues
K_QUEUE_DEFINE(net_tx_queue);

// Devices
static const struct device* const lora_dev = DEVICE_DT_GET_ONE(semtech_sx1276);
static const struct device* const wiznet = DEVICE_DT_GET_ONE(wiznet_w5500);

static int init_networking() {
    int ret = l_init_udp_net_stack_by_device(wiznet, RADIO_MODULE_IP_ADDR);
    if (ret != 0) {
        LOG_ERR("Failed to initialize UDP networking stack: %d", ret);
        return ret;
    } else {
        LOG_INF("Initialized networking stack");
    }

    return 0;
}

int main() {
    LOG_DBG("Starting radio module!\n");

    const struct gpio_dt_spec led0 = GPIO_DT_SPEC_GET(DT_ALIAS(led0), gpios);
    const struct gpio_dt_spec led1 = GPIO_DT_SPEC_GET(DT_ALIAS(led1), gpios);
    gpio_pin_set_dt(&led0, 1);
    gpio_pin_set_dt(&led1, 1);

    if (l_check_device(lora_dev) == 0) {
        if (l_lora_set_frequency(lora_dev, 905000000)) {
            LOG_ERR("Failed to properly set LoRa frequency");
        }

        if (l_lora_set_bandwidth(lora_dev, BW_125_KHZ)) {
            LOG_ERR("Failed to properly set LoRa bandwidth");
        }

        if (l_lora_set_data_rate(lora_dev, SF_12)) {
            LOG_ERR("Failed to set LoRa data rate");
        }

        if (l_lora_set_spreading_factor(lora_dev, CR_4_6)) {
            LOG_ERR("Failed to set LoRa coding rate");
        }

        init_lora_unique(lora_dev);
    }

    if (l_check_device(wiznet) == 0) {
        init_networking();
        init_udp_unique();
    }

    return main_unique();
}
```

## include/transmitter_gnss.h
```c
#ifndef CONFIG_RADIO_MODULE_RECEIVER

#ifndef RADIO_MODULE_TRANSMITTER_GNSS_H
#define RADIO_MODULE_TRANSMITTER_GNSS_H

#include <stdint.h>
#include <zephyr/kernel.h>

void config_gnss_tx_time(k_timeout_t interval);

#endif //RADIO_MODULE_TRANSMITTER_GNSS_H
#endif //CONFIG_RADIO_MODULE_RECEIVER
```

## include/transmitter_smf.h
```c
#ifndef CONFIG_RADIO_MODULE_RECEIVER
#ifndef RADIO_MODULE_TRANSMITTER_SMF_H
#define RADIO_MODULE_TRANSMITTER_SMF_H

#include <zephyr/smf.h>

typedef enum {
    GROUND_STATE = 0,
    FLIGHT_STATE,
} TRANSMITTER_STATES;

/**
 * Initializes the state machine
 */
void init_state_machine();

/**
 * Runs through state machine logic
 */
void run_state_machine();

#endif //RADIO_MODULE_TRANSMITTER_SMF_H
#endif //CONFIG_RADIO_MODULE_RECEIVER
```

## src/logging.c
```c
#ifndef CONFIG_RADIO_MODULE_RECEIVER
// Launch Includes
#include <launch_core_classic/os/fs.h>
#include <launch_core_classic/types.h>

// Zephyr Includes
#include <zephyr/drivers/gpio.h>
#include <zephyr/kernel.h>
#include <zephyr/logging/log.h>

#define LOGGING_STACK_SIZE 4096
#define MAX_DIR_NAME_LEN   10 // 4 number boot count + 5 for "/lfs/" + 1 for end slash
#define MAX_FILE_NAME_LEN  4

#define GNSS_SAMPLE_COUNT 300 // 1 samples every 2 seconds for 10 minutes

LOG_MODULE_REGISTER(logging);

static void logging_task(void);
K_THREAD_DEFINE(data_logger, LOGGING_STACK_SIZE, logging_task, NULL, NULL, NULL, K_PRIO_PREEMPT(20), 0, 1000);

// Message queues
K_MSGQ_DEFINE(gnss_logging_msgq, sizeof(l_gnss_data_t), 10, 4);

#ifdef CONFIG_SEND_LAST_LOG
#include <launch_core_classic/net/tftp.h>

static void send_last_log(const uint32_t boot_count_to_get) {
    LOG_INF("Attempting to send last logs over TFTP");
    // Open /lfs/current_boot_count-1 directory
    char dir_name[MAX_DIR_NAME_LEN] = "";
    snprintf(dir_name, sizeof(dir_name), "/lfs/%d", boot_count_to_get);

    // Setup output file names
    char gnss_output_file_name[MAX_FILE_NAME_LEN + 4] = "";
    snprintf(gnss_output_file_name, sizeof(gnss_output_file_name), "gnss_%d", boot_count_to_get);

    // Read GNSS into buffer
    char gnss_file_name[MAX_DIR_NAME_LEN + MAX_FILE_NAME_LEN + 1] = "";
    snprintf(gnss_file_name, sizeof(gnss_file_name), "%s/gnss", dir_name);
    l_fs_file_t gnss_file = {
        .fname = gnss_file_name,
        .width = sizeof(l_gnss_time_sync_t),
        .mode = SLOG_ONCE,
        .size = sizeof(l_gnss_time_sync_t) * GNSS_SAMPLE_COUNT,
        .initialized = false,
        .file = {0},
        .dirent = {0},
        .vfs = {0},
        .wpos = 0,
    };

    l_gnss_time_sync_t gnss_data[GNSS_SAMPLE_COUNT] = {0};
    size_t gnss_log_file_size = l_fs_file_size(&gnss_file);
    LOG_INF("Previous GNSS Log File Size: %d", gnss_log_file_size);
    if ((l_fs_init(&gnss_file) == 0) && fs_read(&gnss_file.file, &gnss_data, gnss_log_file_size)) {
        l_tftp_init_and_put(L_DEFAULT_SERVER_IP, gnss_output_file_name, (uint8_t*) &gnss_data, gnss_log_file_size);
        l_fs_close(&gnss_file);
    } else {
        LOG_ERR("Failed to read GNSS data from file.");
    }
}
#endif

static void init_logging(l_fs_file_t** p_gnss_file) {
    uint32_t boot_count = l_fs_boot_count_check();
#ifdef CONFIG_SEND_LAST_LOG
    send_last_log(boot_count);
#endif

    // Create directory with boot count
    char dir_name[MAX_DIR_NAME_LEN] = "";
    snprintf(dir_name, sizeof(dir_name), "/lfs/%d", boot_count);
    LOG_INF("Logging files to %s", dir_name);
    fs_mkdir(dir_name);

    // Create filenames
    static char gnss_file_name[MAX_DIR_NAME_LEN + MAX_FILE_NAME_LEN + 1] = "";
    snprintf(gnss_file_name, sizeof(gnss_file_name), "%s/gnss", dir_name);

    // Initialize structs
    static l_fs_file_t gnss_file = {
        .fname = gnss_file_name,
        .width = sizeof(l_gnss_time_sync_t),
        .mode = SLOG_ONCE,
        .size = sizeof(l_gnss_time_sync_t) * GNSS_SAMPLE_COUNT,
        .initialized = false,
        .file = {0},
        .dirent = {0},
        .vfs = {0},
        .wpos = 0,
    };

    LOG_INF("Creating file %s", gnss_file_name);

    // Initialize files
    if (l_fs_init(&gnss_file) == 0) {
        LOG_INF("Successfully created file for storing GNSS data.");
        *p_gnss_file = &gnss_file;
    }
}

extern bool logging_enabled;

static void logging_task(void) {
    l_fs_file_t* gnss_file = NULL;

    l_gnss_time_sync_t gnss_data;

    init_logging(&gnss_file);

    bool gnss_out_of_space = false;

    while (true) {
        if (!logging_enabled) {
            k_msleep(1000);
        }

        if (!k_msgq_get(&gnss_logging_msgq, &gnss_data, K_MSEC(10)) && (gnss_file != NULL) && (!gnss_out_of_space)) {
            LOG_INF("Logged GNSS data");

            int32_t err_flag = 0;
            l_fs_write(gnss_file, (const uint8_t*) &gnss_data, &err_flag);
            gnss_out_of_space = err_flag == -ENOSPC;
            LOG_INF("%d", err_flag);
        }

        if (gnss_out_of_space) {
            LOG_ERR("Out of space logging GNSS. Stopping logging.");
            logging_enabled = false;
            l_fs_close(gnss_file);
            return;
        }
    }
}
#endif
```

## src/radio_module_functionality.h
```c
#ifndef RADIO_MODULE_FUNCTIONALITY_H
#define RADIO_MODULE_FUNCTIONALITY_H

#include <launch_core_classic/backplane_defs.h>
#include <launch_core_classic/dev/dev_common.h>
#include <launch_core_classic/net/lora.h>
#include <launch_core_classic/net/net_common.h>
#include <launch_core_classic/net/udp.h>

// Networking
#define RADIO_MODULE_IP_ADDR BACKPLANE_IP(RADIO_MODULE_ID, 1, 1) // TODO: KConfig the board revision and #
#define NUM_SOCKETS       3
#define UDP_RX_STACK_SIZE 1024
#define UDP_RX_BUFF_LEN   256 // TODO: Make this a KConfig

// LoRa
#define LORA_TX_STACK_SIZE 1024
#define LORA_LOG_STACK_SIZE 512

int init_lora_unique(const struct device *lora_dev);

int init_udp_unique();

int start_tasks();

int main_unique();

#ifndef CONFIG_RADIO_MODULE_RECEIVER
/**
 * Listen for UDP packets and send payloads over LoRa
 */
void udp_to_lora();
#endif

#endif //RADIO_MODULE_FUNCTIONALITY_H
```

## src/receiver.c
```c
#ifdef CONFIG_RADIO_MODULE_RECEIVER

// Self Include
#include "radio_module_functionality.h"

// Launch Includes
#include <launch_core_classic/net/lora.h>

// Zephyr Includes
#include <zephyr/drivers/gpio.h>
#include <zephyr/kernel.h>
#include <zephyr/kernel/thread.h>
#include <zephyr/logging/log.h>

LOG_MODULE_REGISTER(radio_module_rxer);

// Queues - Name, Entry Size, Queue Size, Alignment
K_MSGQ_DEFINE(rx_telem_queue, sizeof(l_lora_packet_t), 8, 1);
K_MSGQ_DEFINE(statistics_queue, sizeof(l_lora_statistics_t), 8, 1);

static void reset_recv_async(struct k_timer*);
K_TIMER_DEFINE(recv_heartbeat, reset_recv_async, NULL);

// LEDs
static const struct gpio_dt_spec led0 = GPIO_DT_SPEC_GET(DT_ALIAS(led0), gpios);
static const struct gpio_dt_spec led1 = GPIO_DT_SPEC_GET(DT_ALIAS(led1), gpios);
static const struct device* lora;

// Forward Declares
static void udp_broadcast_task(void);

// Threads
#define THREAD_STACK_SIZE 2048
K_THREAD_DEFINE(udp_bcast_thread, THREAD_STACK_SIZE, udp_broadcast_task, NULL, NULL, NULL, K_PRIO_PREEMPT(25), 0, 2000);
int sock = -1;

static void init_udp_sock() {
    if (sock == -1) {
        sock = l_init_udp_socket(RADIO_MODULE_IP_ADDR, RADIO_MODULE_BASE_PORT);
        if (sock >= 0) {
            l_set_socket_rx_timeout(sock, 10);
        }
    }
}

static void udp_broadcast_task(void) {
    init_udp_sock();

    if (sock < 0) {
        LOG_ERR("Failed to create socket for UDP broadcasts. Not sending received LoRa packets");
        return;
    }

    l_lora_packet_t lora_packet = {0};
    l_lora_statistics_t lora_statistics = {0};

    while (true) {
        if (k_msgq_get(&rx_telem_queue, &lora_packet, K_MSEC(100)) == 0) {
            LOG_INF("Received for port %d", lora_packet.port);
            l_send_udp_broadcast(sock, lora_packet.payload, lora_packet.payload_len, lora_packet.port);
            gpio_pin_toggle_dt(&led0);
        }

        if (k_msgq_get(&statistics_queue, &lora_statistics, K_MSEC(100)) == 0) {
            l_send_udp_broadcast(sock, (uint8_t*) &lora_statistics, sizeof(l_lora_statistics_t),
                                 RADIO_MODULE_BASE_PORT);
        }
    }
}

static void receiver_cb(const struct device* lora_dev, uint8_t* payload, uint16_t len, int16_t rssi, int8_t snr) {
    ARG_UNUSED(lora_dev);
    ARG_UNUSED(len);

    gpio_pin_toggle_dt(&led0);
    // Reset the heartbeat timer
    k_timer_start(&recv_heartbeat, K_MSEC(10000), K_NO_WAIT);

    static l_lora_statistics_t statistics = {0};
    statistics.count++;
    statistics.rssi = rssi;
    statistics.snr = snr;

    l_lora_packet_t lora_packet = {
        .port = sys_get_le16(payload), // Get the first 2 bytes as the port
        .payload_len = len - 2         // Subtract the 2 bytes used for the port
    };

    memcpy(lora_packet.payload, payload + 2, lora_packet.payload_len);

    LOG_INF("Received payload of %d bytes for port %d", lora_packet.payload_len, lora_packet.port);

    if (k_msgq_put(&rx_telem_queue, (void*) &lora_packet, K_NO_WAIT) < 0) {
        LOG_ERR("Failed to queue received telemetry");
    }

    if (k_msgq_put(&statistics_queue, &statistics, K_NO_WAIT) < 0) {
        LOG_ERR("Failed to queue statistics");
    }

    LOG_INF("Received %d bytes. RSSI: %d SNR: %d", len, rssi, snr);
}

static const struct device* lora = NULL;
static void reset_recv_async(struct k_timer*) {
    LOG_INF("Resetting recv async!");
    // lora_recv_async(lora, NULL);
    // k_timer_start(&recv_heartbeat, K_SECONDS(10), K_SECONDS(10));
    // lora_recv_async(lora, &receiver_cb);
    gpio_pin_toggle_dt(&led1);
}


int init_lora_unique(const struct device* const lora_dev) {
    lora = lora_dev;
    return lora_recv_async(lora, &receiver_cb);
    // reset_recv_async(NULL);
    // return 0;
}

int init_udp_unique() {
    return 0;
}

int main_unique() {
    LOG_INF("Started radio module RECEIVER");
    return 0;
}

#endif
```

## src/transmitter.c
```c
#ifndef CONFIG_RADIO_MODULE_RECEIVER

// Self Include
#include "radio_module_functionality.h"
#include "transmitter_gnss.h"
#include "transmitter_smf.h"

// Launch Includes
#include <launch_core_classic/backplane_defs.h>

// Zephyr Includes
#include <zephyr/drivers/gpio.h>
#include <zephyr/kernel.h>
#include <zephyr/kernel/thread.h>
#include <zephyr/logging/log.h>

LOG_MODULE_REGISTER(transmitter);

static int udp_sockets[NUM_SOCKETS] = {0};
static uint16_t udp_socket_ports[NUM_SOCKETS] = {
    POWER_MODULE_BASE_PORT + POWER_MODULE_INA_DATA_PORT,
    SENSOR_MODULE_BASE_PORT + SENSOR_MODULE_TEN_HZ_DATA_PORT,
    SENSOR_MODULE_BASE_PORT + SENSOR_MODULE_HUNDRED_HZ_DATA_PORT,
};

l_udp_socket_list_t sock_list = {.sockets = udp_sockets, .ports = udp_socket_ports, .num_sockets = NUM_SOCKETS};

// Queues
K_MSGQ_DEFINE(lora_tx_queue, sizeof(l_lora_packet_t), CONFIG_LORA_TX_QUEUE_SIZE, 1);

// Threads
static void lora_tx_task(void);
K_THREAD_DEFINE(lora_tx_thread, LORA_TX_STACK_SIZE, lora_tx_task, NULL, NULL, NULL, K_PRIO_PREEMPT(20), 0, 1000);

static void state_machine_task(void);
K_THREAD_DEFINE(state_machine_thread, 1024, state_machine_task, NULL, NULL, NULL, K_PRIO_PREEMPT(20), 0, 1000);
static bool eth_init = false;

void udp_to_lora() {
    static const struct gpio_dt_spec led1 = GPIO_DT_SPEC_GET(DT_ALIAS(led1), gpios);
    int rcv_size = 0;

    bool transmitted = false;

    for (int i = 0; i < sock_list.num_sockets; i++) {
        l_lora_packet_t packet = {0};

        packet.port = sock_list.ports[i];
        rcv_size = l_receive_udp(sock_list.sockets[i], packet.payload, LORA_PACKET_DATA_SIZE);
        if (rcv_size <= 0) {
            LOG_INF("Receive err: %d", errno);
            continue;
        }

        transmitted = true;
        packet.payload_len = (uint8_t) rcv_size;
        k_msgq_put(&lora_tx_queue, &packet, K_NO_WAIT);
    }

    if (transmitted) {
        gpio_pin_toggle_dt(&led1);
    }
}

static void lora_tx_task(void) {
    const struct device* const lora_dev = DEVICE_DT_GET_ONE(semtech_sx1276);

    while (1) {
        l_lora_packet_t packet = {0};
        k_msgq_get(&lora_tx_queue, &packet, K_FOREVER);
        l_lora_tx(lora_dev, (uint8_t*) &packet, packet.payload_len + sizeof(packet.port));
    }
}

int init_lora_unique(const struct device* const lora_dev) { return l_lora_set_tx_rx(lora_dev, true); }

int init_udp_unique() {
    if (eth_init) {
        return;
    }

    for (int i = 0; i < sock_list.num_sockets; i++) {
        sock_list.sockets[i] = l_init_udp_socket(INADDR_ANY, sock_list.ports[i]);
        if (sock_list.sockets[i] < 0) {
            LOG_ERR("Failed to create UDP socket: %d", sock_list.sockets[i]);
        } else {
            l_set_socket_rx_timeout(sock_list.sockets[i], 1);
        }
    }

    eth_init = true;
    return 0;
}

static void state_machine_task(void) {
    init_state_machine();
    while (true) {
        run_state_machine();

        k_msleep(100);
    }
}

int main_unique() {
    return 0;
}

#endif
```

## src/transmitter_gnss.c
```c
#include <zephyr/drivers/gpio.h>
#ifndef CONFIG_RADIO_MODULE_RECEIVER
#include "transmitter_gnss.h"

#include "radio_module_functionality.h"

// Launch Includes
#include <launch_core_classic/dev/gnss.h>
#include <launch_core_classic/types.h>

// Zephyr Includes
#include <zephyr/kernel.h>
#include <zephyr/logging/log.h>

#define GNSS_TX_QUEUE_SIZE 8
#define GNSS_TASK_STACK_SIZE 1024

LOG_MODULE_REGISTER(transmitter_gnss);

// Forward Declaration
static void gnss_tx_on_expire(struct k_timer* timer_id);
static void gnss_data_cb(const struct device* dev, const struct gnss_data* data);

// Message Queues
K_MSGQ_DEFINE(gnss_tx_queue, sizeof(l_gnss_data_t), GNSS_TX_QUEUE_SIZE, 1);

// Flags
static bool ready_to_tx = false;
bool logging_enabled = false;

// LEDs (can't be defined in cb)
static const struct gpio_dt_spec led0 = GPIO_DT_SPEC_GET(DT_ALIAS(led0), gpios);

// Callbacks
GNSS_DATA_CALLBACK_DEFINE(DEVICE_DT_GET(DT_ALIAS(gnss)), gnss_data_cb);
// GNSS_SATELLITES_CALLBACK_DEFINE(DEVICE_DT_GET(DT_ALIAS(gnss)), l_gnss_debug_sat_count_cb);

// Timers
struct k_timer gnss_tx_timer;
K_TIMER_DEFINE(gnss_tx_timer, gnss_tx_on_expire, NULL);

// External Variables
extern struct k_msgq lora_tx_queue;
extern struct k_msgq gnss_logging_msgq;
float gnss_altitude;

void config_gnss_tx_time(k_timeout_t interval) { k_timer_start(&gnss_tx_timer, interval, interval); }

static void gnss_tx_on_expire(struct k_timer* timer_id) { ready_to_tx = true; }

static void gnss_data_cb(const struct device* dev, const struct gnss_data* data) {
    gpio_pin_toggle_dt(&led0);
    gnss_altitude = (float) data->nav_data.altitude / L_GNSS_ALTITUDE_DIVISION_FACTOR;

    if (!ready_to_tx) {
        return; // timer hasnt expired yet
    }
    l_lora_packet_t packet = {0};
    packet.port = RADIO_MODULE_GNSS_DATA_PORT + RADIO_MODULE_BASE_PORT;
    packet.payload_len = sizeof(l_gnss_data_t);

    l_gnss_data_t gnss_data = {0};
    gnss_data.latitude = (double) data->nav_data.latitude / (double) L_GNSS_LATITUDE_DIVISION_FACTOR;
    gnss_data.longitude = (double) data->nav_data.longitude / (double) L_GNSS_LONGITUDE_DIVISION_FACTOR;
    gnss_data.altitude = gnss_altitude;

    LOG_INF("Queuing GNSS packet");
    memcpy(packet.payload, &gnss_data, sizeof(l_gnss_data_t));
    k_msgq_put(&lora_tx_queue, &packet, K_NO_WAIT);
    if (logging_enabled) {
        k_msgq_put(&gnss_logging_msgq, &packet, K_NO_WAIT);
    }

#ifdef CONFIG_DEBUG // if debugging is on tx gnss over ethernet
    // push to udp tx queue
    k_msgq_put(&gnss_tx_queue, (void*) &gnss_data, K_NO_WAIT);
#endif

    ready_to_tx = false;
}

#ifdef CONFIG_DEBUG
static void gnss_debug_task(void);
K_THREAD_DEFINE(gnss_udp_tx, GNSS_TASK_STACK_SIZE, gnss_debug_task, NULL, NULL, NULL, K_PRIO_PREEMPT(20), 0, 1000);

static void gnss_debug_task(void) {
    LOG_INF("Started GNSS Debug task");
    const uint16_t gnss_port = RADIO_MODULE_BASE_PORT + RADIO_MODULE_GNSS_DATA_PORT;
    int sock = l_init_udp_socket(RADIO_MODULE_IP_ADDR, gnss_port);
    if (sock < 0) {
        LOG_ERR("Failed to initialize UDP socket for GNSS debug task");
        return;
    }

    while (true) {
        l_gnss_data_t gnss_data = {0};
        k_msgq_get(&gnss_tx_queue, &gnss_data, K_FOREVER);
        l_send_udp_broadcast(sock, (uint8_t*) &gnss_data, sizeof(l_gnss_data_t), gnss_port);
    }
}

#endif
#endif
```

## src/transmitter_smf.c
```c
#ifndef CONFIG_RADIO_MODULE_RECEIVER
#include "transmitter_smf.h"

#include "radio_module_functionality.h"
#include "transmitter_gnss.h"

#include <launch_core_classic/backplane_defs.h>
#include <launch_core_classic/net/udp.h>
#include <launch_core_classic/utils/event_monitor.h>
#include <zephyr/logging/log.h>

LOG_MODULE_REGISTER(transmitter_smf);

// External variables
extern struct k_timer gnss_tx_timer;
extern bool logging_enabled;


// State Machine Variables
#define DEFINE_STATE_FUNCTIONS(state_name)                                                                             \
    static void state_name##_state_entry(void *);                                                                      \
    static void state_name##_state_run(void *);                                                                        \
    static void state_name##_state_exit(void *);

DEFINE_STATE_FUNCTIONS(ground);

DEFINE_STATE_FUNCTIONS(flight);

static const struct smf_state transmitter_states[] = {
    [GROUND_STATE] = SMF_CREATE_STATE(ground_state_entry, ground_state_run, ground_state_exit),
    [FLIGHT_STATE] = SMF_CREATE_STATE(flight_state_entry, flight_state_run, flight_state_exit),
};

struct s_object {
    struct smf_ctx ctx;
    bool boost_detected;
} state_obj;

extern float gnss_altitude;

static void boost_detector(struct k_timer *timer_id) {
    static bool first_pass = true;
    static const uint32_t BOOST_THRESHOLD_FT = 500;
    static uint32_t prev_altitude = 0;

    // TODO: Check behavior without lock
    if (first_pass) {
        first_pass = false;
        prev_altitude = gnss_altitude;
    }

    if ((gnss_altitude - prev_altitude) < BOOST_THRESHOLD_FT) {
        prev_altitude = gnss_altitude;
        return;
    }

    state_obj.boost_detected = true;
}

K_TIMER_DEFINE(boost_detect_timer, boost_detector, NULL);

static void ground_state_entry(void *) {
    LOG_INF("Entered ground state");
    k_timer_start(&boost_detect_timer, K_SECONDS(5), K_SECONDS(5));
    config_gnss_tx_time(K_SECONDS(5));
    state_obj.boost_detected = false;
    logging_enabled = false;
}

static void ground_state_run(void *) {
    while (true) {
        // If GNSS altitude changes, notify everyone and go to flight state
        if (state_obj.boost_detected) {
            smf_set_state(SMF_CTX(&state_obj), &transmitter_states[FLIGHT_STATE]);
            l_post_event_udp(L_BOOST_DETECTED);
            return;
        }

        udp_to_lora();


        // Check port 9999 for notifications. If we get one, go to flight state on next iter
        state_obj.boost_detected = l_get_event_udp() == L_BOOST_DETECTED;
    }
}

static void ground_state_exit(void *) {
    k_timer_stop(&boost_detect_timer);
    return;
}



static void flight_state_entry(void *) {
    LOG_INF("Entered flight state");
    logging_enabled = true;
}

static void flight_state_run(void *) {
    while (true) {
        // Convert UDP to LoRa
        udp_to_lora();

        // If notified of landing, go back to ground state.
        if (l_get_event_udp() == L_LANDING_DETECTED) {
            smf_set_state(SMF_CTX(&state_obj), &transmitter_states[GROUND_STATE]);
            return;
        }
    }
}

static void flight_state_exit(void *) {
}

void init_state_machine() {
    smf_set_initial(SMF_CTX(&state_obj), &transmitter_states[GROUND_STATE]);
    l_init_event_monitor(RADIO_MODULE_IP_ADDR);
}

void run_state_machine() {
    static int ret = 0;
    if (ret == 0) {
        ret = smf_run_state(SMF_CTX(&state_obj));
        if (ret < 0) {
            LOG_ERR("Failed to run state machine: %d", ret);
        }
    }
}
#endif
```
