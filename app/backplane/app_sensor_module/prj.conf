## CMakeLists.txt
```
set(BOARD sensor_module)
set(BOARD_ROOT ${CMAKE_CURRENT_SOURCE_DIR})

cmake_minimum_required(VERSION 3.13.1)
find_package(Zephyr REQUIRED HINTS $ENV{ZEPHYR_BASE})

project(sensor-module LANGUAGES C)

FILE(GLOB sources src/*.c)
target_include_directories(app PRIVATE include)
target_sources(app PRIVATE ${sources})
```

## Kconfig
```
# Copyright (c) 2024 Aaron Chan
# SPDX-License-Identifier: Apache-2.0

menu "Zephyr"
source "Kconfig.zephyr"
endmenu

module = APP_SENSOR_MODULE
module-str = APP_SENSOR_MODULE
source "subsys/logging/Kconfig.template.log_config"

config TEN_HZ_QUEUE_SIZE
    int "10 Hz Queue Size"
    default 4
    help
      The number of samples that can be stored in the 10 Hz telemetry processing queue

config HUNDRED_HZ_QUEUE_SIZE
    int "100 Hz Queue Size"
    default 16
    help
      The number of samples that can be stored in the 100 Hz telemetry processing queue

config EXTENSION_BOARD_QUEUE_SIZE
    int "Extension Board Queue Size"
    default 16
    help
      The number of samples that can be stored in the extension board telemetry processing queue

config IREC_2024_DEMO
    bool "IREC 2024 Demo"
    default y
    help
      Enable the IREC 2024 Demo (reading POTATO telemetry and sending over UDP)
```

## sample.yaml
```
sample:
  description:
  name: sensor-module
common:
  build_only: true
  integration_platforms:
    - sensor_module
    - native_sim
tests:
  app.default: {}
  app.debug:
    extra_overlay_confs:
      - debug.conf
```

## prj.conf
```kconfig
# Copyright (c) 2024 RIT Launch Initiative
# SPDX-License-Identifier: Apache-2.0

# CPP
CONFIG_CPP=y
CONFIG_REQUIRES_FULL_LIBCPP=y
CONFIG_STD_CPP20=y

CONFIG_F_CORE=y
CONFIG_CBPRINTF_FP_SUPPORT=y

# OS
CONFIG_POLL=y
CONFIG_MAIN_STACK_SIZE=1024
CONFIG_STACK_USAGE=y

CONFIG_TIMESLICING=y
CONFIG_TIMESLICE_SIZE=50000
CONFIG_TIMESLICE_PRIORITY=0
CONFIG_THREAD_STACK_INFO=y

CONFIG_DYNAMIC_THREAD=y
# Max stack size for dynamic threads
CONFIG_DYNAMIC_THREAD_STACK_SIZE=512
CONFIG_DYNAMIC_THREAD_POOL_SIZE=4
CONFIG_SHELL=y
CONFIG_LOG=y

# Sensors
CONFIG_SENSOR=y
CONFIG_OPENROCKET_LOG_LEVEL_DBG=y
CONFIG_OPENROCKET_SENSORS=y
CONFIG_OPENROCKET_DATA_FILE="../../../data/orksim_csv/omen.csv"
CONFIG_OPENROCKET_MS_BEFORE_LAUNCH=1000
CONFIG_OPENROCKET_SCALAR_TYPE_DOUBLE=y
CONFIG_OPENROCKET_EVENT_LOG=y
CONFIG_OPENROCKET_IMU=y
CONFIG_OPENROCKET_BAROMETER=y

# Networking
CONFIG_NETWORKING=y
CONFIG_NET_ARP_TABLE_SIZE=4
CONFIG_NET_CONTEXT_RCVTIMEO=y
CONFIG_NET_DEFAULT_IF_ETHERNET=y
CONFIG_NET_DRIVERS=y
CONFIG_NET_IPV4=y
CONFIG_NET_IPV6=n
CONFIG_NET_L2_ETHERNET=y
CONFIG_NET_L2_ETHERNET_MGMT=y
CONFIG_NET_MAX_CONN=10
CONFIG_NET_SOCKETS=y
CONFIG_NET_STATISTICS=y
```

## boards/native_sim.conf
```kconfig
CONFIG_OPENROCKET_LOG_LEVEL_DBG=y
CONFIG_OPENROCKET_SENSORS=y
CONFIG_OPENROCKET_DATA_FILE="../../../../data/orksim_csv/omen.csv"
CONFIG_OPENROCKET_MS_BEFORE_LAUNCH=1000
CONFIG_OPENROCKET_SCALAR_TYPE_DOUBLE=y
CONFIG_OPENROCKET_EVENT_LOG=y
CONFIG_OPENROCKET_IMU=y
CONFIG_OPENROCKET_BAROMETER=y
```

## src/main.c
```c
// Self Include
#include "sensor_module.h"

// Launch Includes
#include <launch_core_classic/backplane_defs.h>
#include <launch_core_classic/dev/dev_common.h>
#include <launch_core_classic/os/fs.h>
#include <launch_core_classic/utils/event_monitor.h>

// Zephyr Includes
#include <zephyr/drivers/gpio.h>
#include <zephyr/kernel.h>
#include <zephyr/logging/log.h>

LOG_MODULE_REGISTER(main, CONFIG_APP_SENSOR_MODULE_LOG_LEVEL);

void init() {
    init_networking();
}

int main() {
    init();
    return 0;
}
```

## src/main.cpp
```c
/*
* Copyright (c) 2024 RIT Launch Initiative
 *
 * SPDX-License-Identifier: Apache-2.0
 */
#include "c_sensor_module.h"

#include "common.h"

#include <f_core/os/c_task.h>
#include <f_core/os/n_rtos.h>

K_MSGQ_DEFINE(broadcastQueue, sizeof(telemetry), 10, 4);

int main() {
    CSensorModule sensorModule = CSensorModule();

    sensorModule.AddTenantsToTasks();
    sensorModule.AddTasksToRtos();
    sensorModule.SetupCallbacks();

    NRtos::StartRtos();

#ifdef CONFIG_ARCH_POSIX
    k_sleep(K_SECONDS(300));
    NRtos::StopRtos();
#endif

    return 0;
}
```

## include/c_broadcast_tenant.h
```c
#ifndef C_BROADCAST_TENANT_H
#define C_BROADCAST_TENANT_H

#include <f_core/os/c_tenant.h>

#include <f_core/net/network/c_ipv4.h>
#include <f_core/net/transport/c_udp_socket.h>

class CBroadcastTenant : public CTenant {
public:
    explicit CBroadcastTenant(const char* name)
        : CTenant(name)
    {
    }

    ~CBroadcastTenant() override = default;

    void Startup() override = delete;

    void PostStartup() override = delete;

    void Run() override;

private:
    CIPv4 ip{"10.0.0.0"};
    CUdpSocket udp{ip, 10000, 10000};
};



#endif //C_BROADCAST_TENANT_H
```

## include/c_sensing_tenant.h
```c
#ifndef C_SENSING_TENANT_H
#define C_SENSING_TENANT_H

#include <f_core/os/c_tenant.h>

class CSensingTenant : public CTenant {
public:
    explicit CSensingTenant(const char* name)
        : CTenant(name)
    {
    }

    ~CSensingTenant() override = default;

    void Startup() override;

    void PostStartup() override;

    void Run() override;
};



#endif //C_SENSING_TENANT_H
```

## include/c_sensor_module.h
```c
#ifndef C_SENSOR_MODULE_H
#define C_SENSOR_MODULE_H

#include "c_sensing_tenant.h"
#include "c_broadcast_tenant.h"

// F-Core Includes
#include <f_core/c_project_configuration.h>
#include <f_core/os/c_task.h>
#include <f_core/os/c_tenant.h>

class CSensorModule : public CProjectConfiguration {
public:
    /**
     * Constructor
     */
    CSensorModule();

    /**
     * See parent docs
     */
    void AddTenantsToTasks() override;

    /**
     * See parent docs
     */
    void AddTasksToRtos() override;

    /**
     * See parent docs
     */
    void SetupCallbacks() override;

private:
    // Tenants
    CSensingTenant sensingTenant{"Sensing Tenant"};
    CBroadcastTenant broadcastTenant{"Broadcast Tenant"};

    // Tasks
    CTask networkTask{"Networking Task", 15, 128, 0};
    CTask sensingTask{"Sensing Task", 15, 128, 0};

    // TODO: Messaging handlers to pass into tenants
};



#endif //C_SENSOR_MODULE_H
```

## include/common.h
```c
#ifndef COMMON_H
#define COMMON_H

struct __attribute__((packed)) telemetry {
    float AccelerationX;
    float AccelerationY;
    float AccelerationZ;
    float GyroscopeX;
    float GyroscopeY;
    float GyroscopeZ;
    float Pressure;
    float Temperature;
};

#endif //COMMON_H
```

## include/sensor_module.h
```c
#ifndef SENSOR_MODULE_H
#define SENSOR_MODULE_H

#include <launch_core_classic/net/net_common.h>
#include <launch_core_classic/types.h>
#include <stdbool.h>

#define SENSOR_MODULE_IP_ADDR             BACKPLANE_IP(SENSOR_MODULE_ID, 2, 1)
#define DETECTION_METHOD_PER_SENSOR_COUNT 2

#ifdef CONFIG_DEBUG
#define THREAD_START_TIME 0
#define SAMPLE_COUNT 10
#define SENSOR_READ_THREAD_START_TIME 0
#else
#define THREAD_START_TIME 60000 * 5 // 5 minutes
#define SAMPLE_COUNT 512000000 / sizeof(sensor_module_telemetry_t)
#define SENSOR_READ_THREAD_START_TIME 60000 * 5
#endif

typedef enum { PAD_STATE = 0, PRE_MAIN_STATE, POST_MAIN_STATE, LANDING_STATE } FLIGHT_STATES;

typedef enum {
    SENSOR_MODULE_ADXL375 = 0,
    SENSOR_MODULE_BMP388,
    SENSOR_MODULE_LIS3MDL,
    SENSOR_MODULE_LSM6DSL,
    SENSOR_MODULE_MS5611,
    SENSOR_MODULE_NUM_HUNDRED_HZ_SENSORS
} sensor_module_hundred_hz_sensor_t;

typedef struct __attribute__((packed)) {
    uint64_t timestamp;
    l_accelerometer_data_t adxl375;
    l_accelerometer_data_t lsm6dsl_accel;

    l_barometer_data_t ms5611;
    l_barometer_data_t bmp388;

    l_gyroscope_data_t lsm6dsl_gyro;

    l_magnetometer_data_t lis3mdl;
    l_temperature_data_t tmp117;
} sensor_module_telemetry_t;

typedef struct __attribute__((packed)) {
    uint64_t timestamp;
    sensor_module_ten_hz_telemetry_t data;
} timed_sensor_module_ten_hz_telemetry_t;

void init();

int init_networking(void);

/**
 * Start tasks for getting sensor data
 */
void start_sensor_tasks();


#endif //SENSOR_MODULE_H
```

## src/c_broadcast_tenant.cpp
```c
#include "c_broadcast_tenant.h"

#include <common.h>
#include <zephyr/logging/log.h>

LOG_MODULE_REGISTER(CBroadcastTenant);

extern k_msgq broadcastQueue;

void CBroadcastTenant::Startup() {
}

void CBroadcastTenant::PostStartup() {
}

void CBroadcastTenant::Run() {
    while (true) {
        telemetry data{};
        if (k_msgq_get(&broadcastQueue, &data, K_FOREVER) == 0) {
            udp.TransmitSynchronous(&data, sizeof(telemetry));
        }
    }
}
```

## src/c_sensing_tenant.cpp
```c
#include "c_sensing_tenant.h"

#include <common.h>
#include <f_core/device/sensor/c_accelerometer.h>
#include <f_core/device/sensor/c_barometer.h>
#include <f_core/device/sensor/c_gyroscope.h>
#include <zephyr/logging/log.h>

LOG_MODULE_REGISTER(CSensingTenant);

extern k_msgq broadcastQueue;

void CSensingTenant::Startup() {

}

void CSensingTenant::PostStartup() {

}

void CSensingTenant::Run() {
    CAccelerometer imu_accelerometer(*DEVICE_DT_GET_ONE(openrocket_imu));
    CGyroscope imu_gyroscope(*DEVICE_DT_GET_ONE(openrocket_imu));
    CBarometer barometer(*DEVICE_DT_GET_ONE(openrocket_barometer));

    CSensorDevice* sensors[] = {&imu_accelerometer, &imu_gyroscope, &barometer};

    telemetry data;
    while (true) {
        for (auto sensor : sensors) {
            sensor->UpdateSensorValue();
        }

        data.AccelerationX = imu_accelerometer.GetSensorValueFloat(SENSOR_CHAN_ACCEL_X);
        data.AccelerationY = imu_accelerometer.GetSensorValueFloat(SENSOR_CHAN_ACCEL_Y);
        data.AccelerationZ = imu_accelerometer.GetSensorValueFloat(SENSOR_CHAN_ACCEL_Z);

        data.GyroscopeX = imu_gyroscope.GetSensorValueFloat(SENSOR_CHAN_GYRO_X);
        data.GyroscopeY = imu_gyroscope.GetSensorValueFloat(SENSOR_CHAN_GYRO_Y);
        data.GyroscopeZ = imu_gyroscope.GetSensorValueFloat(SENSOR_CHAN_GYRO_Z);

        data.Pressure = barometer.GetSensorValueFloat(SENSOR_CHAN_PRESS);
        data.Temperature = barometer.GetSensorValueFloat(SENSOR_CHAN_AMBIENT_TEMP);

        LOG_INF(
            "\nAccelerationX: %f\nAccelerationY: %f\nAccelerationZ: %f"
            "\nGyroscopeX: %f\nGyroscopeY: %f\nGyroscopeZ: %f"
            "\nPressure: %f\nTemperature: %f\n",
            (double) data.AccelerationX, (double) data.AccelerationY, (double) data.AccelerationZ,
            (double) data.GyroscopeX, (double) data.GyroscopeY, (double) data.GyroscopeZ,
            (double) data.Pressure, (double) data.Temperature);
        k_msgq_put(&broadcastQueue, &data, K_NO_WAIT);
        k_msleep(100);
    }
}
```

## src/c_sensor_module.cpp
```c
#include "c_sensor_module.h"

// F-Core Tenant
#include <f_core/os/n_rtos.h>

CSensorModule::CSensorModule() : CProjectConfiguration() {
    addTenantsToTasks();
    addTasksToRtos();
}

void CSensorModule::addTenantsToTasks() {
    // Networking
    networkTask.AddTenant(broadcastTenant);

    // Sensing
    sensingTask.AddTenant(sensingTenant);
}

void CSensorModule::addTasksToRtos() {
    // Networking
    NRtos::AddTask(networkTask);

    // Sensing
    NRtos::AddTask(sensingTask);
}

void CSensorModule::setupCallbacks() {
}
```

## src/logging.c
```c
// Self Include
#include "sensor_module.h"

// Launch Includes
#include <launch_core_classic/os/fs.h>
#include <launch_core_classic/types.h>

// Zephyr Includes
#include <zephyr/kernel.h>
#include <zephyr/logging/log.h>

#define LOGGING_STACK_SIZE 4096
#define MAX_DIR_NAME_LEN   10 // 4 number boot count + 5 for "/lfs/" + 1 for end slash
#define MAX_FILE_NAME_LEN  3

LOG_MODULE_REGISTER(logging);

// static void logging_task(void);
// K_THREAD_DEFINE(data_logger, LOGGING_STACK_SIZE, logging_task, NULL, NULL, NULL, K_PRIO_PREEMPT(20), 0, THREAD_START_TIME);

// Message queues
#ifdef CONFIG_DEBUG
#define QUEUE_SIZE 100
#else
#define QUEUE_SIZE 1000
#endif

K_MSGQ_DEFINE(telem_logging_msgq, sizeof(sensor_module_hundred_hz_telemetry_t), QUEUE_SIZE, 4);

static void init_logging(l_fs_file_t** p_telem_file) {
    uint32_t boot_count = l_fs_boot_count_check();

    // Create directory with boot count
    char dir_name[MAX_DIR_NAME_LEN] = "";
    snprintf(dir_name, sizeof(dir_name), "/lfs/%d", boot_count);
    LOG_INF("Logging files to %s", dir_name);
    fs_mkdir(dir_name);

    // Create filenames
    static char telem_file_name[MAX_DIR_NAME_LEN + MAX_FILE_NAME_LEN + 1] = "";
    snprintf(telem_file_name, sizeof(telem_file_name), "%s/hun", dir_name);

    // Initialize structs
    static l_fs_file_t telem_file = {
        .fname = telem_file_name,
        .width = sizeof(sensor_module_telemetry_t),
        .mode = SLOG_ONCE,
        .size = sizeof(sensor_module_telemetry_t) * SAMPLE_COUNT,
        .initialized = false,
        .file = {0},
        .dirent = {0},
        .vfs = {0},
        .wpos = 0,
    };

    // Initialize files
    if (l_fs_init(&telem_file) == 0) {
        LOG_INF("Successfully created file for storing data.");
        *p_telem_file = &telem_file;
    }
}

static void logging_task(void) {
    l_fs_file_t* telem_file = NULL;

    sensor_module_telemetry_t telem;

    while (telem_file == NULL) {
        init_logging(&telem_file);
        k_msleep(1000);
    }

    bool out_of_space = false;

        int i = 0;
    while (true) {
        i++;
        if (!k_msgq_get(&telem_logging_msgq, &telem, K_MSEC(10)) && (telem_file != NULL)) {
            LOG_INF("Logged data");

            int32_t err_flag = 0;
            l_fs_write(telem_file, (const uint8_t*) &telem, &err_flag);
            out_of_space = err_flag == -ENOSPC;
        }

        if (out_of_space) {
            LOG_INF("Out of space %d", i);
            l_fs_close(telem_file);
            return;
        }
    }
}
```

## src/networking.c
```c
// Self Include
#include "sensor_module.h"

// Launch Includes
#include <launch_core_classic/dev/dev_common.h>
#include <launch_core_classic/types.h>

// Zephyr Includes
#include <launch_core_classic/backplane_defs.h>
#include <launch_core_classic/net/udp.h>
#include <zephyr/kernel.h>
#include <zephyr/logging/log.h>

LOG_MODULE_REGISTER(networking);

static void telemetry_broadcast_task(void*, void*, void*);

K_THREAD_DEFINE(telemetry_broadcast, 1024, telemetry_broadcast_task, NULL, NULL, NULL, K_PRIO_PREEMPT(20), 0, 1000);

extern struct k_msgq telem_queue;

int init_networking(void) {
    if (l_check_device(DEVICE_DT_GET_ONE(wiznet_w5500)) != 0) {
        LOG_ERR("Wiznet device not found");
        return -ENODEV;
    }

    int ret = l_init_udp_net_stack_default(SENSOR_MODULE_IP_ADDR);
    if (ret != 0) {
        LOG_ERR("Failed to initialize UDP networking stack: %d", ret);
        return -ENXIO;
    }

    return 0;
}

static void telemetry_broadcast_task(void*, void*, void*) {
    LOG_INF("Starting broadcast task");

    sensor_module_hundred_hz_telemetry_t telem;

    int hundred_hz_socket =
        l_init_udp_socket(SENSOR_MODULE_IP_ADDR, SENSOR_MODULE_BASE_PORT + SENSOR_MODULE_TEN_HZ_DATA_PORT);

    while (true) {
        if (0 == k_msgq_get(&telem_queue, &telem, K_MSEC(20))) {
            l_send_udp_broadcast(hundred_hz_socket, (uint8_t*) &telem,
                                 sizeof(sensor_module_hundred_hz_telemetry_t),
                                 SENSOR_MODULE_BASE_PORT + SENSOR_MODULE_HUNDRED_HZ_DATA_PORT);
        }
    }
}
```

## src/sensing.c
```c
// Self Include
#include "sensor_module.h"

// stdlib Includes
#include <stdint.h>

// Launch Includes
#include <launch_core_classic/dev/dev_common.h>
#include <launch_core_classic/dev/sensor.h>

// Zephyr Includes
#include <zephyr/devicetree.h>
#include <zephyr/kernel.h>
#include <zephyr/logging/log.h>

// Constants
#define SENSOR_READING_STACK_SIZE            1024
#define HUNDRED_HZ_TELEM_PRIORITY            20
#define SENSOR_MODULE_SENSOR_COUNT 5

// Forward Declarations
static void hundred_hz_sensor_reading_task(void);

// Threads
K_THREAD_DEFINE(hundred_hz_readings, SENSOR_READING_STACK_SIZE, hundred_hz_sensor_reading_task, NULL, NULL, NULL,
                K_PRIO_PREEMPT(HUNDRED_HZ_TELEM_PRIORITY), 0, SENSOR_READ_THREAD_START_TIME);

// Message Queues
K_MSGQ_DEFINE(telem_queue, sizeof(sensor_module_hundred_hz_telemetry_t), 16, 1);

// Extern Variables
extern struct k_msgq telem_logging_msgq;

bool logging_enabled = false;

LOG_MODULE_REGISTER(sensing_tasks);

static void check_sensors_ready(const struct device* const* sensors, bool* sensor_ready, uint8_t num_sensors) {
    for (uint8_t i = 0; i < num_sensors; i++) {
        if (l_check_device(sensors[i]) == 0) {
            sensor_ready[i] = true;
        } else {
            sensor_ready[i] = false;
        }
    }
}

static void setup_lsm6dsl() {
    const struct device* lsm6dsl = DEVICE_DT_GET_ONE(st_lsm6dsl);
    const struct sensor_value odr_attr = {.val1 = 104, .val2 = 0};

    if (sensor_attr_set(lsm6dsl, SENSOR_CHAN_ACCEL_XYZ, SENSOR_ATTR_SAMPLING_FREQUENCY, &odr_attr) < 0) {
        LOG_ERR("Cannot set sampling frequency for LSM6DSL accelerometer.\n");
    }

    if (sensor_attr_set(lsm6dsl, SENSOR_CHAN_GYRO_XYZ, SENSOR_ATTR_SAMPLING_FREQUENCY, &odr_attr) < 0) {
        LOG_ERR("Cannot set sampling frequency for LSM6DSL gyroscope.\n");
    }
}

static void hundred_hz_sensor_reading_task(void) {
    LOG_INF("Starting sensor task");
    // Initialize variables for receiving telemetry
    sensor_module_hundred_hz_telemetry_t telemetry;


    const struct device* adxl375 = DEVICE_DT_GET_ONE(adi_adxl375);
    const struct device* ms5611 = DEVICE_DT_GET_ONE(meas_ms5611);
    const struct device* bmp388 = DEVICE_DT_GET_ONE(bosch_bmp388);
    const struct device* lsm6dsl = DEVICE_DT_GET_ONE(st_lsm6dsl);
    const struct device* lis3mdl = DEVICE_DT_GET_ONE(st_lis3mdl_magn);

    const struct device* sensors[SENSOR_MODULE_SENSOR_COUNT] = {adxl375,
                                                                  ms5611,
                                                                  bmp388,
                                                                  lsm6dsl,
                                                                  lis3mdl};
    // Perform any necessary sensor setup
    setup_lsm6dsl();

    // Confirm sensors are ready
    bool sensor_ready[SENSOR_MODULE_SENSOR_COUNT] = {false};
    check_sensors_ready(sensors, sensor_ready, SENSOR_MODULE_SENSOR_COUNT);

    while (true) {
        // Refresh sensor data
        for (uint8_t i = 0; i < SENSOR_MODULE_SENSOR_COUNT; i++) {
            if (sensor_sample_fetch(sensors[i])) {
                LOG_ERR("Failed to fetch %s data %d", sensors[i]->name, i);
            }
        }
        l_get_accelerometer_data_float(adxl375, &telemetry.adxl375);
        l_get_accelerometer_data_float(lsm6dsl, &telemetry.lsm6dsl_accel);
        l_get_gyroscope_data_float(lsm6dsl, &telemetry.lsm6dsl_gyro);
        l_get_barometer_data_float(ms5611, &telemetry.ms5611);
        l_get_barometer_data_float(bmp388, &telemetry.bmp388);
        l_get_magnetometer_data_float(lis3mdl, &telemetry.lis3mdl);

        // Put telemetry into queue
        k_msgq_put(&telem_queue, &telemetry, K_MSEC(10));
        k_msgq_put(&telem_logging_msgq, &telemetry, K_MSEC(10));

        k_msleep(20);
    }
}
```
