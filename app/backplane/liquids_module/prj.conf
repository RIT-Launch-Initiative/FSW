## CMakeLists.txt
```
#-------------------------------------------------------------------------------
# Backplane Liquids Module Application
#
# Copyright (c) 2026 Launch Initiative
# SPDX-License-Identifier: Apache-2.0

set(FSW_ROOT ${CMAKE_CURRENT_SOURCE_DIR}/../../..)
include(${FSW_ROOT}/cmake/Autocoders.cmake)
include(${FSW_ROOT}/cmake/Snippets.cmake)

AddCommonSnippets()

if (DEBUG)
    message(STATUS "Adding debug configuration")
    AddDebugSnippets()
    list(APPEND CONF_FILE ${CMAKE_CURRENT_SOURCE_DIR}/debug.conf)
endif ()


cmake_minimum_required(VERSION 3.13.1)
find_package(Zephyr REQUIRED HINTS $ENV{ZEPHYR_BASE})

project(liquid-module LANGUAGES C CXX)

FILE(GLOB SOURCES src/*.c src/*.cpp)
target_include_directories(app PRIVATE include)
target_sources(app PRIVATE ${SOURCES})

AutocodeTypes(${CMAKE_SOURCE_DIR}/ac/types.yaml)
AutocodeNetworkDefinitions()
add_dependencies(app ac_net_defs ac_types)
```

## Kconfig
```
# Copyright (c) 2024 Launch Initiative
# SPDX-License-Identifier: Apache-2.0

menu "Zephyr"
source "Kconfig.zephyr"
endmenu

config MODULE_ID
    int "Module ID number"
    default 5
    help
      The module ID to use as the fourth octet in the IP address.

module = APP_LIQUIDS_MODULE
module-str = APP_LIQUIDS_MODULE
source "subsys/logging/Kconfig.template.log_config"
```

## sample.yaml
```
sample:
  description: Liquids Module
  name: liquids-module
common:
  build_only: true
  integration_platforms:
    - liquids_module
    - native_sim
```

## prj.conf
```kconfig
# Copyright (c) 2024 RIT Launch Initiative
# SPDX-License-Identifier: Apache-2.0

# CPP
CONFIG_CPP=y
CONFIG_REQUIRES_FULL_LIBCPP=y
CONFIG_STD_CPP20=y

CONFIG_F_CORE=y
CONFIG_F_CORE_DEVICE=y
CONFIG_F_CORE_SENSOR=y
CONFIG_F_CORE_NET=y
CONFIG_F_CORE_OS=y
CONFIG_F_CORE_UTILS=y
CONFIG_CBPRINTF_FP_SUPPORT=y


CONFIG_DEBUG=y
CONFIG_DEBUG_OPTIMIZATIONS=y
CONFIG_DEBUG_THREAD_INFO=y
CONFIG_THREAD_RUNTIME_STATS=y


# Shell
CONFIG_SHELL=y
CONFIG_DEVICE_SHELL=y
CONFIG_NET_SHELL=y
CONFIG_FLASH_SHELL=y
CONFIG_SENSOR_SHELL=y
CONFIG_HEAP_MEM_POOL_SIZE=4096
CONFIG_SHELL_BACKEND_SERIAL=y



# OS
CONFIG_POLL=y
CONFIG_MAIN_STACK_SIZE=2048
CONFIG_STACK_USAGE=y
CONFIG_LOG=y

# Networking
CONFIG_NETWORKING=y
CONFIG_NET_ARP_TABLE_SIZE=4
CONFIG_NET_CONTEXT_RCVTIMEO=y
CONFIG_NET_DEFAULT_IF_ETHERNET=y
CONFIG_NET_DRIVERS=y
CONFIG_NET_IPV4=y
CONFIG_NET_IPV6=n
CONFIG_NET_L2_ETHERNET=y
CONFIG_NET_L2_ETHERNET_MGMT=y
CONFIG_NET_MAX_CONN=10
CONFIG_NET_SOCKETS=y
CONFIG_NET_STATISTICS=y
CONFIG_SNTP=y

# RNG (Needed for networking)
CONFIG_ENTROPY_GENERATOR=y
CONFIG_TEST_RANDOM_GENERATOR=y # TODO: See if its worth using STM32 HW RNG to remove warning

# IO
CONFIG_I2C=y
CONFIG_SPI=y
CONFIG_SENSOR=y

CONFIG_FLASH=y
CONFIG_FLASH_MAP=y
CONFIG_FLASH_PAGE_LAYOUT=y
```

## debug.conf
```kconfig
# Copyright (c) 2024 RIT Launch Initiative
# SPDX-License-Identifier: Apache-2.0

# Compiler
CONFIG_DEBUG=y
CONFIG_DEBUG_OPTIMIZATIONS=y
CONFIG_DEBUG_THREAD_INFO=y
CONFIG_THREAD_RUNTIME_STATS=y

# Console
CONFIG_CONSOLE=y
CONFIG_CONSOLE_SUBSYS=y
CONFIG_SERIAL=y
CONFIG_UART_CONSOLE=y

# Shell (common)
CONFIG_SHELL=y
CONFIG_DEVICE_SHELL=y
CONFIG_FILE_SYSTEM_SHELL=y
CONFIG_FLASH_SHELL=y
CONFIG_GPIO_SHELL=y
CONFIG_I2C_SHELL=y
CONFIG_KERNEL_SHELL=y
CONFIG_NET_SHELL=y
CONFIG_SENSOR_SHELL=y
CONFIG_HEAP_MEM_POOL_SIZE=4096
CONFIG_SHELL_BACKEND_SERIAL_API_INTERRUPT_DRIVEN=y
CONFIG_SHELL_BACKEND_SERIAL_TX_RING_BUFFER_SIZE=4096
CONFIG_SHELL_BACKEND_SERIAL_RX_RING_BUFFER_SIZE=4096

# Logging
CONFIG_APP_LIQUIDS_MODULE_LOG_LEVEL_DBG=y
CONFIG_LOG=y

# Networking
CONFIG_NET_STATISTICS=y
```

## src/main.cpp
```c
/*
* Copyright (c) 2026 RIT Launch Initiative
 *
 * SPDX-License-Identifier: Apache-2.0
 */

#include <n_autocoder_network_defs.h>
#include <zephyr/logging/log.h>

LOG_MODULE_REGISTER(main);

int main() {
    int i = 0;
    while (true) {
        printk("hello %d\n", i);
        i++;
        k_msleep(1000);
    }
    return 0;
}
```
