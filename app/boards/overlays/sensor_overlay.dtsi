/ {
    soc {
        &i2c1 {
          	pinctrl-0 = <&i2c1_scl_pb8 &i2c1_sda_pb9>;
	        pinctrl-names = "default";
        	status = "okay";
        	clock-frequency = <I2C_BITRATE_FAST>;

            tmp116: tmp116@48 {
                compatible = "ti,tmp116";
                reg = <0x48>;
            };
        };
    };
};

