## CMakeLists.txt
```
set(FSW_ROOT ${CMAKE_CURRENT_SOURCE_DIR}/../../..)
include(${FSW_ROOT}/cmake/Snippets.cmake)

AddCommonSnippets()
AddDebugSnippets()

cmake_minimum_required(VERSION 3.13.1)
find_package(Zephyr REQUIRED HINTS $ENV{ZEPHYR_BASE})

project(tftp-server LANGUAGES C CXX)

FILE(GLOB sources src/*.c src/*.cpp)
target_include_directories(app PRIVATE include)
target_sources(app PRIVATE ${sources})
```

## sample.yaml
```
sample:
  description: TFTP Server
  name: tftp-server
common:
  build_only: true
  platform_allow:
    - native_sim
    - deployment_module
    - power_module
    - radio_module
    - sensor_module
tests:
  samples.tftp_server.default: {}
```

## prj.conf
```kconfig
# Copyright (c) 2024 RIT Launch Initiative
# SPDX-License-Identifier: Apache-2.0

# CPP
CONFIG_CPP=y
CONFIG_REQUIRES_FULL_LIBCPP=y
CONFIG_STD_CPP20=y

CONFIG_F_CORE=y
CONFIG_F_CORE_OS=y

# OS
CONFIG_POLL=y
CONFIG_MAIN_STACK_SIZE=8192
CONFIG_STACK_USAGE=y

CONFIG_SHELL=y
CONFIG_LOG=y

# F-Core
CONFIG_F_CORE=y
CONFIG_F_CORE_NET=y
CONFIG_F_CORE_OS=y

# Networking
CONFIG_NETWORKING=y
CONFIG_NET_NATIVE=y
CONFIG_NET_UDP=y
CONFIG_NET_SOCKETS=y
CONFIG_NET_IPV4=y
CONFIG_NET_L2_ETHERNET=y
CONFIG_NET_MAX_CONN=10
CONFIG_TEST_RANDOM_GENERATOR=y

# Filesystem
CONFIG_FILE_SYSTEM=y
CONFIG_FILE_SYSTEM_LITTLEFS=y
CONFIG_FS_LITTLEFS_FMP_DEV=y
CONFIG_FLASH=y
CONFIG_FLASH_MAP=y
CONFIG_FLASH_PAGE_LAYOUT=y
```

## src/main.cpp
```c
/*
* Copyright (c) 2024 RIT Launch Initiative
 *
 * SPDX-License-Identifier: Apache-2.0
 */
#include <f_core/net/application/c_tftp_server_tenant.h>
#include <f_core/net/application/c_udp_broadcast_tenant.h>
#include <f_core/os/c_file.h>
#include <f_core/os/n_rtos.h>
#include <zephyr/fs/fs.h>
#include <zephyr/kernel.h>
#include <zephyr/logging/log.h>

LOG_MODULE_REGISTER(main, LOG_LEVEL_DBG);

int main() {
    CIPv4 ip("10.0.0.1");
    CTftpServerTenant *tftpServer = CTftpServerTenant::GetInstance(ip);
    tftpServer->Register();

    while (true) {
        // Keep the main thread alive
        k_msleep(10000);
    }

    return 0;
}
```
