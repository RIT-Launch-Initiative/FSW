
const float lower_bounds_lut[] = {
    228.13975, 226.63562, 225.13479, 223.63411, 222.13367, 220.63321, 219.13249, 217.63156, 216.12998, 214.62781,
    213.12502, 211.62107, 210.11617, 208.60991, 207.10218, 205.59298, 204.08196, 202.56889, 201.05398, 199.53656,
    198.01689, 196.49459, 194.96925, 193.44122, 191.90997, 190.37507, 188.83697, 187.29487, 185.74889, 184.19874,
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    61.704579, 58.055858, 54.268402, 50.221118, 45.712674, 40.902467, 35.286864, 28.613436, 20.152737, -5.6427664};

const float upper_bounds_lut[] = {
    271.55075, 270.05258, 268.52033, 266.85796, 264.43371, 262.00732, 259.5964,  257.20072, 254.81953, 252.45247,
    250.0989,  247.7585,  245.43059, 243.115,   240.81111, 238.51841, 236.23683, 233.9656,  231.70444, 229.453,
    227.21096, 224.97772, 222.7533,  220.537,   218.32843, 216.12734, 213.93344, 211.74632, 209.56548, 207.39091,
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    62.5114,   58.734818, 54.821743, 50.657838, 46.049275, 41.142219, 35.447572, 28.708335, 20.193958, -5.6543081,
};

// TODO, when this file is autogenerated, fail if the two LUTs are different sizes
#define LUT_SIZE (sizeof(lower_bounds_lut) / sizeof(lower_bounds_lut[0]))


#define LUT_MINIMUM_X 1200.0f
#define LUT_MAXIMUM_X 3300.0f
