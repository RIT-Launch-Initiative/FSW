## prj.conf
```kconfig
CONFIG_LV_Z_MEM_POOL_SIZE=16384
CONFIG_LV_Z_SHELL=y
CONFIG_MAIN_STACK_SIZE=8192

CONFIG_DISPLAY=y
CONFIG_DISPLAY_LOG_LEVEL_ERR=y

CONFIG_LOG=y
CONFIG_SHELL=y

CONFIG_LVGL=y
CONFIG_LV_USE_LOG=y
CONFIG_LV_USE_LABEL=y
CONFIG_LV_USE_ARC=y
CONFIG_LV_USE_MONKEY=y
CONFIG_LV_FONT_MONTSERRAT_18=y
CONFIG_LV_COLOR_16_SWAP=y
CONFIG_LV_Z_POINTER_INPUT=y

CONFIG_INPUT=y

CONFIG_GPIO=y
CONFIG_GPIO_SHELL=y

CONFIG_LOG=y
#CONFIG_LOG_LEVEL_DEBUG=y
CONFIG_DEBUG=y

CONFIG_INPUT_EVENT_DUMP=y

CONFIG_TDECK_KEYBOARD=y

CONFIG_I2S=y
```

## src/main.c
```c
/*
 * Copyright (c) 2018 Jan Van Winkel <jan.van_winkel@dxplore.eu>
 *
 * SPDX-License-Identifier: Apache-2.0
 */

int main() {
    
}
```
