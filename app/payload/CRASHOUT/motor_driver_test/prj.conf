## CMakeLists.txt
```
# SPDX-License-Identifier: Apache-2.0

cmake_minimum_required(VERSION 3.20.0)
find_package(Zephyr REQUIRED HINTS $ENV{ZEPHYR_BASE})
project(motor_driver_test)

target_sources(app PRIVATE src/main.cpp src/spi.cpp src/arm.cpp src/servo.cpp src/motor.cpp src/imu_math.cpp)
```

## prj.conf
```kconfig
CONFIG_GPIO=y
CONFIG_I2C=y
CONFIG_I2C_STM32_BUS_RECOVERY=y
CONFIG_SPI=y
CONFIG_SPI_SLAVE=y
CONFIG_SPI_STM32_INTERRUPT=y
CONFIG_SPI_STM32_DMA=y
CONFIG_DMA=y
#CONFIG_SYS_CLOCK_TICKS_PER_SEC=10000
CONFIG_LOG_PRINTK=y
CONFIG_SHELL=y
CONFIG_I2C_SHELL=y
CONFIG_I2C_STM32_BUS_RECOVERY=y
CONFIG_GPIO_SHELL=n
CONFIG_SHELL_BACKEND_SERIAL=y
# CONFIG_CBPRINTF_FP_SUPPORT=y
CONFIG_CPP=y
CONFIG_STD_CPP17=y
CONFIG_GLIBCXX_LIBCPP=y

CONFIG_REBOOT=y



CONFIG_DEVMEM_SHELL=n
CONFIG_DEVICE_SHELL=n
CONFIG_DATE_SHELL=n
CONFIG_SHELL_MINIMAL=y
CONFIG_SHELL_VT100_COMMANDS=n

CONFIG_LIS2DH=y
CONFIG_LIS2DH_ODR_6=y
CONFIG_LIS2DH_ACCEL_RANGE_8G=y
#cm

CONFIG_WATCHDOG=y
CONFIG_IWDG_STM32=y
```

## boards/nucleo_f446re.overlay
```dts
/ {
	aliases {
		nsleep = &pinctrl;
	};
	leds: leds {
		compatible = "gpio-leds";
		nsleep: nsleep{
			gpios = <&gpioc 8 GPIO_ACTIVE_HIGH>;
			label = "GPS LED";
		};
	};
};
```

## boards/sw_board.overlay
```dts
/ {
	aliases {
		led0 = &led2;
	};
};
```

## src/main.c
```c
/*
 * Copyright (c) 2016 Intel Corporation
 *
 * SPDX-License-Identifier: Apache-2.0
 */

#include <stdio.h>
#include <zephyr/device.h>
#include <zephyr/devicetree.h>
#include <zephyr/drivers/gpio.h>
#include <zephyr/drivers/i2c.h>
#include <zephyr/kernel.h>
#include <string.h>

/* 1000 msec = 1 sec */
#define SLEEP_TIME_MS 1000

/* The devicetree node identifiers*/
#define NSLEEP_NODE DT_NODELABEL(nsleep)
const struct device* const i2c_bus = DEVICE_DT_GET(DT_NODELABEL(arduino_i2c));
const struct i2c_dt_spec i2c_dev = {.bus = i2c_bus, .addr = 0x30};
/*
 * A build error on this line means your board is unsupported.
 * See the sample documentation for information on how to fix this.
 */
static const struct gpio_dt_spec nSleep = GPIO_DT_SPEC_GET(NSLEEP_NODE, gpios);

/* Motor Driver Register Addresses */
#define RC_STATUS1  0x1
#define RC_STATUS2  0x2
#define RC_STATUS3  0x3
#define REG_STATUS1 0x4
#define REG_STATUS2 0x5
#define REG_STATUS3 0x6

#define CONFIG0_REG 0x9
#define CONFIG1_REG 0xa
#define CONFIG2_REG 0xb
#define CONFIG3_REG 0xc
#define CONFIG4_REG 0xd

#define REG_CTRL0_REG 0xe
#define REG_CTRL1_REG 0xf
#define REG_CTRL2_REG 0x10

#define RC_CTRL0_REG 0x11
#define RC_CTRL1_REG 0x12
#define RC_CTRL2_REG 0x13
#define RC_CTRL3_REG 0x14
#define RC_CTRL4_REG 0x15
#define RC_CTRL5_REG 0x16
#define RC_CTRL6_REG 0x17
#define RC_CTRL7_REG 0x18
#define RC_CTRL8_REG 0x19

/* Global variables */
uint8_t flt = 0;
bool motorOn = false;
// w_scale_value is used to convert the speed value read from the motor driver in Rad/s to RPM
// The value 16 is the minimum value and maxes the motor out at 4080 Rad/s (Page 31 of datatsheet)
uint32_t w_scale_value = 16;

/**
 * Sets the voltage of the motor driver by writing to the appropriate register.
 * <<< Doesn't actually work lol >>>
 */
void set_voltage(float volts) {
    if (volts > 38) {
        printk("invalid volts");
        return;
    }
    // The value 228 is the maximum value that can be written to the motor driver and corresponds to 38 volts (Page 45 of datasheet).
    float val = (volts / 38.f) * 227;
    uint8_t regval = (uint8_t) (val + .5f);
    i2c_reg_write_byte_dt(&i2c_dev, REG_CTRL1_REG, regval);
}

/**
 * Converts the voltage value read from the motor driver to volts.
 * The value 228 is the maximum value that can be read from the motor driver and corresponds to 38 volts (Page 45 of datasheet).
 */
float map_voltage(uint8_t vmtr) { return ((float) vmtr / 228.f) * 38.f; }

/**
 * Converts the speed value read from the motor driver in Rad/s to RPM.
 */
float speed_rpm(uint8_t speed, int32_t w_scale) {
    float radps = speed * w_scale;
    float rpm = 60.f * radps / 6.28318f;
    return rpm;
}

/**
 * Turns on the motor driver by writing to the appropriate registers.
 */
void turnOn(){
    //reset flt variable to 0
    flt = 0;

    gpio_pin_configure_dt(&nSleep, GPIO_OUTPUT_INACTIVE);

    k_msleep(10);

    gpio_pin_configure_dt(&nSleep, GPIO_OUTPUT_ACTIVE);

    uint8_t rc_ctrl0_reg = 0b11100010;
    uint8_t reg_ctrl_0 = 0b00110111;
    i2c_reg_write_byte_dt(&i2c_dev, RC_CTRL0_REG, rc_ctrl0_reg);
    i2c_reg_write_byte_dt(&i2c_dev, REG_CTRL0_REG, reg_ctrl_0);
    i2c_reg_write_byte_dt(&i2c_dev, REG_CTRL1_REG, 0x03);
    motorOn = true;
}

/**
 * Clears the ripple count on the motor driver by resetting the nSleep pin and writing to the appropriate registers.
 */
void clearRippleCount(){
    // turn nSleep off then on again
    gpio_pin_configure_dt(&nSleep, GPIO_OUTPUT_INACTIVE);
    k_msleep(10);
    gpio_pin_configure_dt(&nSleep, GPIO_OUTPUT_ACTIVE);
    // reset registers to default values
    i2c_reg_write_byte_dt(&i2c_dev, RC_CTRL0_REG, 0b11100010);
    i2c_reg_write_byte_dt(&i2c_dev, REG_CTRL0_REG, 0b00100111);
    i2c_reg_write_byte_dt(&i2c_dev, REG_CTRL1_REG, 0x03); 
}

/**
 * Sets the motor driver to speed control mode
 */
void setToSpeedControlMode(){
    uint8_t reg_ctrl_0;
    i2c_reg_read_byte_dt(&i2c_dev, REG_CTRL0_REG, &reg_ctrl_0);

    // set bits 4,3 to 10 to set speed control mode (page 30 of datasheet)
    reg_ctrl_0 &= 0b11100111;
    reg_ctrl_0 |= 0b00010000;
    i2c_reg_write_byte_dt(&i2c_dev, REG_CTRL0_REG, reg_ctrl_0);

    // set duty ctrl to 0
    uint8_t config0;
    i2c_reg_read_byte_dt(&i2c_dev, CONFIG0_REG, &config0);
    config0 &= 0b11111110;
    i2c_reg_write_byte_dt(&i2c_dev, CONFIG0_REG, config0);
}

/**
 * Sets the motor driver to voltage control mode
 */
void setToVoltageControlMode(){
    uint8_t reg_ctrl_0;
    i2c_reg_read_byte_dt(&i2c_dev, REG_CTRL0_REG, &reg_ctrl_0);

    // set bits 4,3 to 11 to set voltage control mode (page 30 of datasheet)
    reg_ctrl_0 |= 0b00011000;
    i2c_reg_write_byte_dt(&i2c_dev, REG_CTRL0_REG, reg_ctrl_0);

    // set duty ctrl to 0
    uint8_t config0;
    i2c_reg_read_byte_dt(&i2c_dev, CONFIG0_REG, &config0);
    config0 &= 0b11111110;
    i2c_reg_write_byte_dt(&i2c_dev, CONFIG0_REG, config0);
}

/**
 * Reads and prints the voltage, speed, ripple count, and direction from the motor driver.
 */
void print_info(){
    //Read voltage from the motor driver
    uint8_t vmtr = 0;
    i2c_reg_read_byte_dt(&i2c_dev, REG_STATUS1, &vmtr);
    float volts = map_voltage(vmtr);

    //Read speed from the motor driver
    uint8_t speed;
    i2c_reg_read_byte_dt(&i2c_dev, RC_STATUS1, &speed);
    printk("Speed: %02x\n", speed);
    float speedrpm = speed_rpm(speed, w_scale_value);

    //Read ripple count from the motor driver
    uint8_t rcc0 = 0;
    uint8_t rcc1 = 0;
    i2c_reg_read_byte_dt(&i2c_dev, RC_STATUS2, &rcc0);
    i2c_reg_read_byte_dt(&i2c_dev, RC_STATUS3, &rcc1);
    uint16_t rc_cnt = (rcc1 << 8) | rcc0;

    //Read direction from the motor driver
    uint8_t dir = 0;
    i2c_reg_read_byte_dt(&i2c_dev, CONFIG4_REG, &dir);

    //Print voltage, speed, ripple count, and direction returned by the motor driver
    printk("V=%.4f V, S=%.4f rpm, RC=%d, ", (double) volts, (double) speedrpm, (int) rc_cnt);
    if(dir == 0x36){
        printk("Clockwise\n");
    } else if(dir == 0x37){
        printk("Counter Clockwise\n");
    } else{
        printk("Failed to read Direction\n");
    }
}

/**
 * Tests running the motor by directly controlling the speed
 * @param dir the direction to run the motor in, 0x36 for clockwise and 0x37 for counterclockwise
 */
void speed_control_test(uint8_t dir){
    static const uint8_t inv_r_scale = 0b10;
    static const uint8_t inv_r = 42;

    static const uint8_t kmc_scale = 0b01;
    static const uint8_t kmc = 139;

    uint8_t rc_ctrl_2 = (inv_r_scale << 6) | (kmc_scale << 4) | (3 << 2) | 3;
    uint8_t rc_ctrl_3 = inv_r;
    uint8_t rc_ctrl_4 = kmc;

    i2c_reg_write_byte_dt(&i2c_dev, RC_CTRL2_REG, rc_ctrl_2);
    i2c_reg_write_byte_dt(&i2c_dev, RC_CTRL3_REG, rc_ctrl_3);
    i2c_reg_write_byte_dt(&i2c_dev, RC_CTRL4_REG, rc_ctrl_4);

    setToSpeedControlMode();

    if(!motorOn){
        printk("Motor is off, cannot spin\n");
        return;
    }

    printk("Initted i2c dev\n");
    i2c_reg_write_byte_dt(&i2c_dev, CONFIG4_REG, 0x34); // 0011, 0100 
    i2c_reg_read_byte_dt(&i2c_dev, 0, &flt);
    printk("Fault 34: %02x\n", flt);
    
    i2c_reg_write_byte_dt(&i2c_dev, CONFIG0_REG, 0xe0);
    i2c_reg_read_byte_dt(&i2c_dev, 0, &flt);
    printk("Fault e0: %02x\n", flt);

    i2c_reg_write_byte_dt(&i2c_dev, CONFIG4_REG, dir); // 0x36 counterclockwise, 0x37 clockwise
    i2c_reg_read_byte_dt(&i2c_dev, 0, &flt);
    printk("Fault 36: %02x\n", flt);

    i2c_reg_read_byte_dt(&i2c_dev, 0, &flt);
    printk("Fault: %02x\n", flt);

    for (int i = 0; i < 20; i++){
        print_info();
        i2c_reg_read_byte_dt(&i2c_dev, 0, &flt);
        k_msleep(200);
    }
    i2c_reg_write_byte_dt(&i2c_dev, CONFIG4_REG, 0x34);
}

/**
 * Tests running the motor by controlling the voltage sent to it
 * @param dir the direction to run the motor in, 0x36 for clockwise and 0x37 for counterclockwise
 */
void voltage_control_test(uint8_t dir){
    static const uint8_t inv_r_scale = 0b10;
    static const uint8_t inv_r = 42;

    static const uint8_t kmc_scale = 0b01;
    static const uint8_t kmc = 139;

    uint8_t rc_ctrl_2 = (inv_r_scale << 6) | (kmc_scale << 4) | (3 << 2) | 3;
    uint8_t rc_ctrl_3 = inv_r;
    uint8_t rc_ctrl_4 = kmc;

    i2c_reg_write_byte_dt(&i2c_dev, RC_CTRL2_REG, rc_ctrl_2);
    i2c_reg_write_byte_dt(&i2c_dev, RC_CTRL3_REG, rc_ctrl_3);
    i2c_reg_write_byte_dt(&i2c_dev, RC_CTRL4_REG, rc_ctrl_4);

    setToVoltageControlMode();

    if(!motorOn){
        printk("Motor is off, cannot spin\n");
        return;
    }

    printk("Initted i2c dev\n");
    i2c_reg_write_byte_dt(&i2c_dev, CONFIG4_REG, 0x34); // 0011, 0100 
    i2c_reg_read_byte_dt(&i2c_dev, 0, &flt);
    printk("Fault 34: %02x\n", flt);
    
    i2c_reg_write_byte_dt(&i2c_dev, CONFIG0_REG, 0xe0);
    i2c_reg_read_byte_dt(&i2c_dev, 0, &flt);
    printk("Fault e0: %02x\n", flt);

    i2c_reg_write_byte_dt(&i2c_dev, CONFIG4_REG, dir);
    i2c_reg_read_byte_dt(&i2c_dev, 0, &flt);
    printk("Fault 36: %02x\n", flt);

    i2c_reg_read_byte_dt(&i2c_dev, 0, &flt);
    printk("Fault: %02x\n", flt);

    for (int i = 0; i < 20; i++){
        print_info();
        i2c_reg_read_byte_dt(&i2c_dev, 0, &flt);
        k_msleep(200);
    }
    i2c_reg_write_byte_dt(&i2c_dev, CONFIG4_REG, 0x34);
}

int main(void) {
    if (!device_is_ready(i2c_bus)) {
        printk("No i2c ready");
        return 0;
    }
    
    k_msleep(1000);

    turnOn();

    setToVoltageControlMode();
    set_voltage(6);
    voltage_control_test(0x37); // counter clockwise
    set_voltage(12);
    voltage_control_test(0x36); // clockwise

    return 0;
}
```

## src/main.cpp
```c
#include <stdio.h>
#include <zephyr/device.h>
#include <zephyr/devicetree.h>
#include <zephyr/drivers/gpio.h>
#include <zephyr/drivers/i2c.h>
#include <zephyr/drivers/sensor.h>
#include <zephyr/kernel.h>
#include <string.h>
#include "motor.hpp"

/* 1000 msec = 1 sec */
#define SLEEP_TIME_MS 1000

/* The devicetree node identifiers*/
#define LED1_NODE DT_NODELABEL(led1)


#define NSLEEP_NODE DT_NODELABEL(nsleep)
const struct device* const i2c_bus = DEVICE_DT_GET(DT_NODELABEL(motor_i2c));
const struct i2c_dt_spec motor1_i2c = {.bus = i2c_bus, .addr = 0x30};
const struct i2c_dt_spec motor2_i2c = {.bus = i2c_bus, .addr = 0x32};
const struct i2c_dt_spec motor3_i2c = {.bus = i2c_bus, .addr = 0x36};

const struct device *yaw_enc = DEVICE_DT_GET(DT_NODELABEL(yaw_enc));
const struct device *pitch_enc = DEVICE_DT_GET(DT_NODELABEL(pitch_enc));
const struct device *dcm_enc3 = DEVICE_DT_GET(DT_NODELABEL(dcm_enc3));


static const struct gpio_dt_spec nSleep = GPIO_DT_SPEC_GET(NSLEEP_NODE, gpios);
static const struct gpio_dt_spec led1 = GPIO_DT_SPEC_GET(LED1_NODE, gpios);


/**
* Resets the motor drivers by toggling the nsleep pin
* ***WARNING*** RESETS ALL MOTORS, WILL NEED TO REINIT AFTER CALLING THIS FUNCTION
*/
void reset(){
    gpio_pin_configure_dt(&nSleep, GPIO_OUTPUT_INACTIVE);
    k_msleep(10);
    gpio_pin_configure_dt(&nSleep, GPIO_OUTPUT_ACTIVE);
}


void doPid(Motor &mot, int64_t target){
    mot.enableSpin();
    int64_t integral = 0;
    int count = 0;
    for (int i = 0; i <= 200; i++){
        int64_t point = mot.read_enc();
        int64_t err = target - point;
        printk("%lld\n", point);

        if (err < 500000 && err > -500000) {
            count++;
        } else {
            count = 0;
        }

        if (count > 25){
            break;
        }

        int64_t kP = 9'000;
        int64_t kI = 0x7fffffffffffffff;
        int64_t outp = (err / kP) + (integral / kI);
        outp = outp / 11; // scale down output so we're not always running max speed
        // printk("%lld\n", outp);

        Motor::SpinMode dir = outp > 0 ? Motor::SpinMode::Forward : Motor::SpinMode::Backward;
        int speed = (outp < 0 ? -outp : outp);
        if (speed > 32000){
            speed = 32000;
        } else {
            integral += err;
        }  
        // printk("Err: %lld %d %d\n", err/1000, dir, speed);
        // printk("m2: "); mot.printInfo();
        mot.setSpinMode(dir); // set motor 1 to forward
        mot.setSpeed(speed);
        k_msleep(10);
    }
    mot.disableSpin();
}

int main(void) { 

    printk("BOOT OK\n");

    while (1) {
        printk("ALIVE\n");
        k_msleep(1000);
    }

    // while(1){
    //     printk("Program Running\n");
    //     k_msleep(1000);
    // }

    // Motor motor1(i2c_bus, motor1_i2c, yaw_enc);
    // Motor motor2(i2c_bus, motor2_i2c, pitch_enc);
    // Motor motor3(i2c_bus, motor3_i2c, dcm_enc3);

    // reset();

    // if (!motor1.initSpeedControl()){
    //     printk("Failed to initialize motor 1");
    //     return 0;
    // }
    
    // if (!motor2.initSpeedControl()){
    //     printk("Failed to initialize motor 2");
    //     return 0;
    // }

    // if (!motor3.initSpeedControl()){
    //     printk("Failed to initialize motor 3");
    //     return 0;
    // }

    // k_msleep(1000);

    // doPid(motor1, 90'000'000);
    // doPid(motor2, 90'000'000);
    // doPid(motor3, 90'000'000);

    // while(1){
    //     printk("Program Running\n");
    //     k_msleep(1000);
    // }

    // while(1){  
    //     for (int i = 270'000'000; i >= 90'000'000; i -= 10'000'000){
    //         doPid(motor1, i);
    //         printk("m1: %lld\n", motor1.read_enc());
    //         k_msleep(500);
    //         doPid(motor2, i);
    //         printk("m2: %lld\n", motor2.read_enc());
    //         k_msleep(500);
    //         doPid(motor3, i);
    //         printk("m3: %lld\n", motor3.read_enc());
    //         k_msleep(500);
    //     }
    // }

    // for (;;){
    //     int64_t md1 = motor1.read_enc();
    //     int64_t md2 = motor2.read_enc();
    //     int64_t md3 = motor3.read_enc();
    //     printk("Milldeg: %lld, %lld, %lld\n", md1/1000000, md2/1000000, md3/1000000);
    //     printk("m1: "); motor1.printInfo();
    //     printk("m2: "); motor2.printInfo();
    //     printk("m3: "); motor3.printInfo();
    //     k_msleep(200);
    // }
}
```

## src/arm.hpp
```c
#pragma once
#include "common.hpp"

void arm_init();

// call > 10 times a second to accurately detect wraparounds
void arm_measure(const Vec3_16 &base_imu, const Vec3_32 &l2_imu);


void arm_set_ignore_stall(bool ignore);

void set_jog_paramters(const JogAction &);
void start_arm_jog();
MovementResult step_arm_jog();
void stop_arm_jog();


void start_arm_hold();
MovementResult step_arm_hold();
void stop_arm_hold();

void start_arm();
MovementResult step_arm();
void stop_arm();
void set_arm_target(const ArmPose &);

void set_arm_pose(const ArmPose &);



void wakeup_motors();
void sleep_motors();
```

## src/common.hpp
```c
#pragma once
#include <cstdint>

enum class State {
    Chilling = 0,
    ArmMoving = 1,
    Servo1Moving = 2,
    Servo2Moving = 3,
    Servo3Moving = 4,
    Holding = 5,
    Jogging = 6,
};

using StatusWord = uint16_t;

enum StatusBit {
    StatusBitBooted = 0,  // set to 1 if board is ready
    StatusBit_State0 = 1, // Arm
    StatusBit_State1 = 2, // Flipping Servo 1
    StatusBit_State2 = 3, // Flipping Servo 2

    StatusBit_MovingArmFailed = 5,       // Arm failed bc OCP
    StatusBit_WristServoEn = 6,          // Efuse enable
    StatusBit_FlipServoEn = 7,           // 8.4V Buck enable
    StatusBit_MotorEn = 8,               // not sleeping
    StatusBitCantTrustImuLink = 9, // if we're on our side, the top joint doesnt know where it is
    StatusBitEncodersNotUpdating = 10,

    // identify what kind of response this is 0 - 31
    StatusBit_RType0 = 11,
    StatusBit_RType1 = 12,
    StatusBit_RType2 = 13,
    StatusBit_RType3 = 14,
    StatusBit_RType4 = 15,
};

struct ArmPose {
    int8_t shoulder_yaw;
    int8_t shoulder_pitch;
    int8_t elbow_pitch;
    int8_t wrist_pitch;
};

/**
 * 
 */
StatusWord MakeStatusWord(State state, bool wrist_en, bool flip_en, bool motor_en, bool movement_failed, bool overtemp);
void SubmitStatus(StatusWord word, const ArmPose &pose);

enum ResponseKind {
    ResponseKind_Status = 0,
    ResponseKind_Temps = 1,
    ResponseKind_Uptime = 2,
    ResponseKind_SOMETHING = 3,
    ResponseKind_BaseAccel = 4,
    ResponseKind_Link1Accel = 5,
    ResponseKind_Link2Accel = 6,

    ResponseKind_Servo1Motion = 7,
    ResponseKind_Servo2Motion = 8,
    ResponseKind_Servo3Motion = 9,

    ResponseKind_ArmPoseEst = 10,
    ResponseKind_ArmTarget = 11,

    ResponseKind_CurrentServoTargets = 12, // what we're saying since we don't have feedback

};

enum FlipServo {
    Servo1 = 0,
    Servo2 = 1,
    Servo3 = 2,
};

struct FlipServoMotion {
    uint8_t open_duration;         // How long to stay open for in 10 ms increments
    uint8_t openness;              // How much to open
    uint8_t open_travel_duration;  // How long to move the servo on open in 10 ms increments
    uint8_t closedness;            // where to go after open duration
    uint8_t close_travel_duration; // How long to move the servo on close in 10 ms increments

    uint32_t total_duration();
};

struct FlipServoMotionState {
    uint32_t iteration_started;
    FlipServoMotion motion;

    uint32_t pulse_length_at_iteration(uint32_t iteration, uint32_t min_pulse, uint32_t max_pulse);
};

struct Temperatures {
    int16_t link1_temp;
    int16_t link2_temp;
    int16_t stm_temp;
};

struct Vec3_16 {
    int16_t x;
    int16_t y;
    int16_t z;
};
struct Vec3_32 {
    int32_t x;
    int32_t y;
    int32_t z;
    Vec3_16 toMillig();
    Vec3_16 Saturated16();
};
int16_t saturate_i16(int32_t v);


bool getVerticalAngleFromImus(Vec3_16 base_imu16_normalized, Vec3_32 link_imu, int64_t yaw, int64_t pitch,
                              int64_t *microdeg_out);
Vec3_32 normalize_to16(Vec3_32 v);

struct ServoTargets {
    uint16_t servo1;
    uint16_t servo2;
    uint16_t servo3;
};

enum class MovementResult {
    Ongoing = 0,
    Finished = 1,
    Failed = 2,
    Invalid = 3,
};

struct JogAction {
    uint8_t motor;
    uint16_t iterations;
    int16_t millivolts;
};

/**
 * State that gets read by spi guy
 */

namespace CurrentState {
bool base_accel_is_valid();
uint32_t current_iteration();
bool wrist_en();
bool motors_en();
bool flip_en();
FlipServoMotion servo_motion(FlipServo servoid);

ArmPose arm_pose_est();
ArmPose arm_pose_target();

Temperatures temperatures();

uint32_t uptime();

Vec3_16 base_imu();
Vec3_16 link1_imu();
Vec3_16 link2_imu();

} // namespace CurrentState

enum class InternalCommandKind {
    Tick,
    Reset,
    StartHold,
    StartArm,
    StartArmNoCurrentLimit,
    StartServo1,
    StartServo2,
    StartServo3,
    StartJog,
    Stop,
    SetBaseAccel,
    SetArmTarget,
    SetServo1Motion,
    SetServo2Motion,
    SetServo3Motion,
    SetArmPose,
    SetJogMotion,
};

struct InternalCommand {
    InternalCommandKind kind;
    union {
        Vec3_16 set_base_accel;
        ArmPose set_arm_target;
        FlipServoMotion set_servo1_motion;
        FlipServoMotion set_servo2_motion;
        FlipServoMotion set_servo3_motion;
        ArmPose set_arm_pose;
        JogAction jog_action;
    };
};

int send_internal_command(InternalCommand *);
```

## src/imu_math.cpp
```c
// #include "common.hpp"
// #include <zephyr/kernel.h>

// #include <cmath>

// // int16 vectors should not exceed this
// constexpr int16_t max_16 = 32767;
// int16_t saturate_i16(int32_t v) {
//     if (v > max_16) {
//         return max_16;
//     } else if (v < -max_16) {
//         return -max_16;
//     }
//     return v;
// }

// /** 
// * @brief Integer square root for RMS 
// * @param sqrtAvg (sum(x squared) / count) 
// * @retval approximate square root 
// * 
// * Approximate integer square root, used for RMS calculations. 
// * https://community.st.com/t5/stm32-mcus-products/fast-sqrt-function/td-p/515126
// */
// static unsigned int sqrtI(unsigned long sqrtArg) {
//     unsigned int answer = 0;
//     unsigned int x = 0;
//     unsigned long temp = 0;
//     if (sqrtArg == 0) return 0;                   // undefined result
//     if (sqrtArg == 1) return 1;                   // identity
//     answer = 0;                                   // integer square root
//     for (x = 0x8000; x > 0; x = x >> 1) {         // 16 bit shift
//         answer |= x;                              // possible bit in root
//         temp = ((unsigned long) answer * answer); // fast unsigned multiply
//         if (temp == sqrtArg) break;               // exact, found it
//         if (temp > sqrtArg) answer ^= x;          // too large, reverse bit
//     }
//     return answer; // approximate root
// }

// // return a vec32 with a max size of 2^15-1
// Vec3_32 normalize_to16(Vec3_32 v) {
//     uint64_t norm_squared = (((int64_t)v.x * v.x) + ((int64_t)v.y * v.y) + ((int64_t)v.z * v.z));
//     uint32_t norm = sqrtI(norm_squared);

//     // normed = -1 to 1
//     // normed 16 = -2^15-1 to 2^15-1
//     // normed = v/|v|
//     // normed16 = (2^15-1)v/|v|
//     int32_t x = (int32_t) (((int64_t)v.x * max_16) / (int32_t)norm);
//     int32_t y = (int32_t) (((int64_t)v.y * max_16) / (int32_t)norm);
//     int32_t z = (int32_t) (((int64_t)v.z * max_16) / (int32_t)norm);
//     // shouldn't exceed, but just in case
//     return {saturate_i16(x), saturate_i16(y), saturate_i16(z)};
// }

// // a and b absolutely have to be normalized or else this will saturate
// int16_t dot_normed16(Vec3_32 a_normed16, Vec3_32 b_normed16) {
//     int32_t xcontrib = ((int32_t) a_normed16.x * b_normed16.x) / max_16;
//     int32_t ycontrib = ((int32_t) a_normed16.y * b_normed16.y) / max_16;
//     int32_t zcontrib = ((int32_t) a_normed16.z * b_normed16.z) / max_16;
//     // bc you promised the inputs are normalized, this should be at the most extreme -1 or 1 which is -max_16 or max_16. just incase, saturate (tho youll be wrong but at least it wont wrap)
//     int32_t n = xcontrib + ycontrib + zcontrib;
//     return saturate_i16(n);
// }

// constexpr int16_t imu_bad_thresh_cos_space = 26841; // cos 35 ~=0.819152044289, * max_16 = 29696

// // false if we're measuring gravity along the axis that just isn't helpful
// bool shouldntUseAccel(Vec3_32 measured_normed16) {
//     constexpr Vec3_32 rotation_axis_n16{0, max_16, 0};
//     int16_t n = dot_normed16(measured_normed16, rotation_axis_n16);
//     return std::abs(n) > imu_bad_thresh_cos_space;
// }

// Vec3_32 cross_n16(Vec3_32 a_n16, Vec3_32 b_n16) {
//     int32_t x = (a_n16.y * b_n16.z) - (a_n16.z * b_n16.y);
//     int32_t y = -((a_n16.x * b_n16.z) - (a_n16.z * b_n16.x));
//     int32_t z = (a_n16.x * b_n16.y) - (a_n16.y * b_n16.x);
//     // since both inputs or normalized, the maginitude of output should be <=1 (<=max_16)
//     return {x / max_16, y / max_16, z / max_16};
// }

// Vec3_32 rotate_by_udeg_about_z(Vec3_32 vec, int64_t udeg){
//     float rad = ((float)udeg)*3.14159F/180.0F / 1000000.0F;
//     float c = std::cos(rad);
//     float s = std::sin(rad);
//     float nx = vec.x * c - s * vec.y;
//     float ny = vec.x * s + c * vec.y;
//     return {saturate_i16(nx), saturate_i16(ny), vec.z};
// }

// // return false if theyre aligned and we cant get gravity
// bool getVerticalAngleFromImus(Vec3_16 base_imu16_normalized, Vec3_32 link_imu, int64_t yaw, int64_t shoulder_pitch, int64_t *microdeg_out) {
//     // just need to change datatypes
//     Vec3_32 base_imu32_normed_16{base_imu16_normalized.x, base_imu16_normalized.y, base_imu16_normalized.z};

//     // need to actualy normalize here
//     Vec3_32 link_imu32_normed_16 = normalize_to16(link_imu);
//     if (shouldntUseAccel(link_imu32_normed_16)) {
//         return false;
//     }

//     Vec3_32 base_imu32_normed_16_rotated = rotate_by_udeg_about_z(base_imu32_normed_16, -yaw);

//     Vec3_32 cross = cross_n16(base_imu32_normed_16, link_imu32_normed_16);

//     int16_t norm = dot_normed16(base_imu32_normed_16, link_imu32_normed_16);
//     float normedf = norm / (float) max_16;
//     float rad = std::acosf(normedf);
//     int64_t microdeg_to_vertical = (rad * 180.0F / 3.14159F) * 1000000;
//     if (cross.y >= 0) {
//         microdeg_to_vertical *= -1;
//     }
//     *microdeg_out = microdeg_to_vertical - shoulder_pitch;

//     return true;
// }
```

## src/motor.cpp
```c
/*
 * @file motor.cpp
 * 
 * Motor Class for controlling the motor driver of a single motor
 * Contains methods for enabling and disabling various settings of the motor driver
 * Can control the motor in both voltage control mode and speed control mode
 *
 * @author Collin Casey, Richard Sommers
 */
#include "motor.hpp"

#include <zephyr/drivers/sensor.h>
/* Motor Driver Register Addresses */
static constexpr uint8_t REG_FAULT = 0x0;
static constexpr uint8_t RC_STATUS1 = 0x01;
static constexpr uint8_t RC_STATUS2 = 0x02;
static constexpr uint8_t RC_STATUS3 = 0x03;
static constexpr uint8_t REG_STATUS1 = 0x04;
static constexpr uint8_t REG_STATUS2 = 0x05;
static constexpr uint8_t REG_STATUS3 = 0x06;

static constexpr uint8_t CONFIG0_REG = 0x09;
static constexpr uint8_t CONFIG1_REG = 0x0a;
static constexpr uint8_t CONFIG2_REG = 0x0b;
static constexpr uint8_t CONFIG3_REG = 0x0c;
static constexpr uint8_t CONFIG4_REG = 0x0d;

static constexpr uint8_t REG_CTRL0_REG = 0x0e;
static constexpr uint8_t REG_CTRL1_REG = 0x0f;
static constexpr uint8_t REG_CTRL2_REG = 0x10;

static constexpr uint8_t RC_CTRL0_REG = 0x11;
static constexpr uint8_t RC_CTRL1_REG = 0x12;
static constexpr uint8_t RC_CTRL2_REG = 0x13;
static constexpr uint8_t RC_CTRL3_REG = 0x14;
static constexpr uint8_t RC_CTRL4_REG = 0x15;
static constexpr uint8_t RC_CTRL5_REG = 0x16;
static constexpr uint8_t RC_CTRL6_REG = 0x17;
static constexpr uint8_t RC_CTRL7_REG = 0x18;
static constexpr uint8_t RC_CTRL8_REG = 0x19;

/**
 * Contructs an instance of the Motor class with the given i2c address.
 */
Motor::Motor(const struct device* i2c_bus, uint8_t addr, bool flip_voltage)
    : Motor(i2c_bus, {.bus = i2c_bus, .addr = addr}, flip_voltage) {}

/**
 * Contructs an instance of the Motor class with the given i2c device specification.
 */
Motor::Motor(const struct device* i2c_bus, struct i2c_dt_spec motor_spec, bool flip_voltage_) {
    this->i2c_bus = i2c_bus;
    motor = motor_spec;
    enc = NULL;
    flip_voltage = flip_voltage_;
}

/**
 * Contructs an instance of the Motor class with the given i2c address and encoder.
 */
Motor::Motor(const struct device* i2c_bus, uint8_t addr, bool flip_voltage, const struct device* dcm_enc, bool flip_enc)
    : Motor(i2c_bus, {.bus = i2c_bus, .addr = addr}, flip_voltage, dcm_enc, flip_enc) {}

/**
 * Contructs an instance of the Motor class with the given i2c device specification and encoder.
 */
Motor::Motor(const struct device* i2c_bus, struct i2c_dt_spec motor_spec, bool flip_voltage_,
             const struct device* dcm_enc, bool flip_enc) {
    this->i2c_bus = i2c_bus;
    motor = motor_spec;
    enc = dcm_enc;
    flip_voltage = flip_voltage_;
    flip_encoder = flip_enc;
}

/**
 * Sets the voltage of the motor driver by writing to the appropriate register.
 */
void Motor::setVoltage(float volts) {
    if (volts > 38) {
        printk("invalid volts");
        return;
    }
    // The value 228 is the maximum value that can be written to the motor driver and corresponds to 38 volts (Page 45 of datasheet).
    float val = (volts / 38.f) * 227;
    uint8_t regval = (uint8_t) (val + .5f);
    i2c_reg_write_byte_dt(&motor, REG_CTRL1_REG, regval);
}

void Motor::setVoltage16(uint16_t millivolts) {
    if (millivolts > 38000) {
        printk("invalid volts");
        return;
    }
    // The value 228 is the maximum value that can be written to the motor driver and corresponds to 38 volts (Page 45 of datasheet).
    int val = ((uint32_t) millivolts * 228) / 38000;
    if (val > 228) {
        val = 228;
    }
    uint8_t regval = (uint8_t) val;
    i2c_reg_write_byte_dt(&motor, REG_CTRL1_REG, regval);
}

void Motor::setDirAndVoltage16(int16_t millivolts) {
    if (millivolts > 0) {
        setSpinMode(Motor::Forward);
    } else {
        setSpinMode(Motor::Backward);
    }
    setVoltage16(abs(millivolts));
}

/**
 * Sets the w_scale value of the motor driver by writing to the appropriate register 
 * if w_scale given is valid (16, 32, 64, or 128).
 */
void Motor::set_w_scale_value(uint32_t w_scale) {
    uint8_t regval;
    i2c_reg_read_byte_dt(&motor, REG_CTRL0_REG, &regval);
    if (w_scale == 16) {
        // set bits 0,1 to 00 to set w_scale to 16 (page 31 of datasheet)
        regval &= 0b11111100;
        i2c_reg_write_byte_dt(&motor, REG_CTRL0_REG, regval);
    } else if (w_scale == 32) {
        // set bits 0,1 to 01 to set w_scale to 32 (page 31 of datasheet)
        regval &= 0b11111101;
        regval |= 0b00000001;
        i2c_reg_write_byte_dt(&motor, REG_CTRL0_REG, regval);
    } else if (w_scale == 64) {
        // set bits 0,1 to 10 to set w_scale to 64 (page 31 of datasheet)
        regval &= 0b11111110;
        regval |= 0b00000010;
        i2c_reg_write_byte_dt(&motor, REG_CTRL0_REG, regval);
    } else if (w_scale == 128) {
        // set bits 0,1 to 11 to set w_scale to 128 (page 31 of datasheet)
        regval |= 0b00000011;
        i2c_reg_write_byte_dt(&motor, REG_CTRL0_REG, regval);
    } else {
        printk("invalid w_scale");
        return;
    }
    w_scale_value = w_scale;
}

/**
 * Sets the speed of the motor driver by writing to the appropriate register.
 * @param radps the speed to set the motor to in Rad/s
 */
void Motor::setSpeed(uint16_t radps) {
    if (radps < 4080) {
        set_w_scale_value(16);
    } else if (radps < 8160) {
        set_w_scale_value(32);
    } else if (radps < 16320) {
        set_w_scale_value(64);
    } else if (radps < 32640) {
        set_w_scale_value(128);
    } else {
        return;
        printk("invalid speed");
    }
    uint16_t speed_val = radps / w_scale_value;
    i2c_reg_write_byte_dt(&motor, REG_CTRL1_REG, speed_val);
}

/**
 * Converts the voltage value read from the motor driver to volts.
 * The value 228 is the maximum value that can be read from the motor driver and corresponds to 38 volts (Page 45 of datasheet).
 */
float Motor::map_voltage(uint8_t vmtr) { return ((float) vmtr / 228.f) * 38.f; }

/**
 * Converts the speed value read from the motor driver in Rad/s to RPM.
 */
float Motor::speed_rpm(uint8_t speed, int32_t w_scale) {
    float radps = speed * w_scale;
    float rpm = 60.f * radps / 6.28318f;
    return rpm;
}

/**
 * Sets the motor driver to speed control mode
 */
void Motor::setToSpeedControlMode() {
    uint8_t reg_ctrl_0;
    i2c_reg_read_byte_dt(&motor, REG_CTRL0_REG, &reg_ctrl_0);

    // set bits 4,3 to 10 to set speed control mode (page 30 of datasheet)
    reg_ctrl_0 &= 0b11110111;
    reg_ctrl_0 |= 0b00010000;
    i2c_reg_write_byte_dt(&motor, REG_CTRL0_REG, reg_ctrl_0);

    // set duty ctrl to 0
    uint8_t config0;
    i2c_reg_read_byte_dt(&motor, CONFIG0_REG, &config0);
    config0 &= 0b11111110;
    i2c_reg_write_byte_dt(&motor, CONFIG0_REG, config0);
}

/**
 * Sets the motor driver to voltage control mode
 */
void Motor::setToVoltageControlMode() {
    uint8_t reg_ctrl_0;
    i2c_reg_read_byte_dt(&motor, REG_CTRL0_REG, &reg_ctrl_0);

    // set bits 4,3 to 11 to set voltage control mode (page 30 of datasheet)
    reg_ctrl_0 |= 0b00011000;
    i2c_reg_write_byte_dt(&motor, REG_CTRL0_REG, reg_ctrl_0);

    // set duty ctrl to 0
    uint8_t config0;
    i2c_reg_read_byte_dt(&motor, CONFIG0_REG, &config0);
    config0 &= 0b11111110;
    i2c_reg_write_byte_dt(&motor, CONFIG0_REG, config0);
}

void Motor::setStopOnStall(bool enabled) {
    uint8_t config3 = 0;
    i2c_reg_read_byte_dt(&motor, CONFIG3_REG, &config3);
    config3 &= 0b11011111;
    config3 |= enabled << 5;
    i2c_reg_write_byte_dt(&motor, CONFIG3_REG, config3);
}

/**
 * Reads and prints the voltage, speed, ripple count, and direction from the motor driver.
 */
void Motor::printInfo() {
    //Read voltage from the motor driver
    uint8_t vmtr = 0;
    i2c_reg_read_byte_dt(&motor, REG_STATUS1, &vmtr);
    float volts = map_voltage(vmtr);

    uint8_t imtr = 0;
    i2c_reg_read_byte_dt(&motor, REG_STATUS2, &imtr);
    // 4 amps = 0xc0
    float amps = 1.0 * (imtr / 192.0);

    //Read speed from the motor driver
    uint8_t speed;
    i2c_reg_read_byte_dt(&motor, RC_STATUS1, &speed);
    printk("Speed: %02x\n", speed);
    float speedrpm = speed_rpm(speed, w_scale_value);

    //Read ripple count from the motor driver
    uint8_t rcc0 = 0;
    uint8_t rcc1 = 0;
    i2c_reg_read_byte_dt(&motor, RC_STATUS2, &rcc0);
    i2c_reg_read_byte_dt(&motor, RC_STATUS3, &rcc1);
    uint16_t rc_cnt = (rcc1 << 8) | rcc0;

    //Read direction from the motor driver
    uint8_t dir = 0;
    i2c_reg_read_byte_dt(&motor, CONFIG4_REG, &dir);

    //Print voltage, speed, ripple count, and direction returned by the motor driver
    printk("V=%d mV, I=%d mA, S=%d rpm, RC=%d, Dir=%02x ", (int) (1000 * volts), (int) (1000 * amps),
           (int) (1000 * speedrpm), (int) rc_cnt, dir);
    if (dir == 0x36) {
        printk("Forward\n");
    } else if (dir == 0x37) {
        printk("Backward\n");
    } else if (dir == 0x34) {
        printk("Braking\n");
    } else {
        printk("Failed to read Direction\n");
    }
}

/**
 * Reads and prints the fault register from the motor driver.
 */
void Motor::printFault() {
    i2c_reg_read_byte_dt(&motor, 0, &flt);
    printk("Fault: %02x\n", flt);
}

void Motor::clearFault() {
    uint8_t reg = 0;
    i2c_reg_read_byte_dt(&motor, CONFIG0_REG, &reg);
    reg |= 0b10; // add clr_flt
    i2c_reg_write_byte_dt(&motor, CONFIG0_REG, reg);
}

bool Motor::didFault(uint8_t* fault_out) {
    uint8_t fault = 0;
    i2c_reg_read_byte_dt(&this->motor, 0, &fault);
    if (fault_out != NULL) {
        *fault_out = fault;
    }
    return (fault >> 7) == 1;
}

/**
 * Prints the values of all of the registers in the motor driver
 */
void Motor::regDump() {
    for (int i = 0; i <= 0x19; i++) {
        i2c_reg_read_byte_dt(&motor, i, &flt);
        printk("Reg%02x: %02x\n", i, flt);
    }
}

/**
 * Sets up the ripple counting on the motor driver by writing to the appropriate registers.
 */
void Motor::setupRippleCounting() {
    static const uint8_t inv_r_scale = 0b10;
    static const uint8_t inv_r = 42;

    static const uint8_t kmc_scale = 0b01;
    static const uint8_t kmc = 139;

    uint8_t rc_ctrl_2 = (inv_r_scale << 6) | (kmc_scale << 4) | (3 << 2) | 3;
    uint8_t rc_ctrl_3 = inv_r;
    uint8_t rc_ctrl_4 = kmc;

    i2c_reg_write_byte_dt(&motor, RC_CTRL0_REG, 0b11100010);
    i2c_reg_write_byte_dt(&motor, RC_CTRL2_REG, rc_ctrl_2);
    i2c_reg_write_byte_dt(&motor, RC_CTRL3_REG, rc_ctrl_3);
    i2c_reg_write_byte_dt(&motor, RC_CTRL4_REG, rc_ctrl_4);
}

/**
 * Enable overvoltage protection, and stall protection
 */
void Motor::enableOVSProtection() {
    uint8_t regval;
    i2c_reg_read_byte_dt(&motor, CONFIG0_REG, &regval);
    regval |= 0b01100000;
    i2c_reg_write_byte_dt(&motor, CONFIG0_REG, regval);
}

/**
 * Disable overvoltage protection, and stall protection
 */
void Motor::disableOVSProtection() {
    uint8_t regval;
    i2c_reg_read_byte_dt(&motor, CONFIG0_REG, &regval);
    regval &= 0b10011111;
    i2c_reg_write_byte_dt(&motor, CONFIG0_REG, regval);
}

/**
 * Enable motor spinning, overvoltage protection, and stall protection
 */
void Motor::enableSpin() {
    uint8_t regval;
    i2c_reg_read_byte_dt(&motor, CONFIG0_REG, &regval);
    regval |= 0b10000000;
    i2c_reg_write_byte_dt(&motor, CONFIG0_REG, regval);
    enableOVSProtection();
}

/**
 * Disable motor spinning
 */
void Motor::disableSpin() {
    uint8_t regval;
    i2c_reg_read_byte_dt(&motor, CONFIG0_REG, &regval);
    regval &= 0b01111111;
    i2c_reg_write_byte_dt(&motor, CONFIG0_REG, regval);
}

/**
 * Sets the spin mode of the motor driver by writing to the appropriate register.
 * @param mode: 0 = forward, 1 = backward, 2 = brake
 * We don't actually know which way forward and backward are, because it depends on how the motor is wired
 */
void Motor::setSpinMode(Motor::SpinMode mode) {
    if (flip_voltage) {
        if (mode == SpinMode::Forward) {
            mode = SpinMode::Backward;
        } else if (mode == SpinMode::Backward) {
            mode = SpinMode::Forward;
        }
    }
    if (mode == SpinMode::Forward) {
        i2c_reg_write_byte_dt(&motor, CONFIG4_REG, 0x36);
    } else if (mode == SpinMode::Backward) {
        i2c_reg_write_byte_dt(&motor, CONFIG4_REG, 0x37);
    } else if (mode == SpinMode::Brake) {
        i2c_reg_write_byte_dt(&motor, CONFIG4_REG, 0x34);
    }
}

/**
 * Enables the soft start feature of the motor driver by writing to the appropriate register.
 */
void Motor::enableSoftStart() {
    uint8_t regval;
    i2c_reg_read_byte_dt(&motor, REG_CTRL0_REG, &regval);
    regval |= 0b00100000;
    i2c_reg_write_byte_dt(&motor, REG_CTRL0_REG, regval);
}

/**
 * Disables the soft start feature of the motor driver by writing to the appropriate register.
 */
void Motor::disableSoftStart() {
    uint8_t regval;
    i2c_reg_read_byte_dt(&motor, REG_CTRL0_REG, &regval);
    regval &= 0b11011111;
    i2c_reg_write_byte_dt(&motor, REG_CTRL0_REG, regval);
}

/**
 * Tests running the motor by controlling the voltage sent to it
 * @param dir the direction to run the motor in, 0 for forward and 1 for backward
 */
void Motor::voltageControlTest(uint8_t dir) {
    setToVoltageControlMode();
    setupRippleCounting();

    setSpinMode(SpinMode::Brake); // brake mode to start
    printFault();

    setSpeed(0);

    enableSpin();
    printFault();

    setSpinMode(SpinMode::Brake);
    printFault();

    for (int i = 4; i <= 12; i++) {
        setVoltage(i);
        printInfo();
        k_msleep(500);
    }

    setSpinMode(SpinMode::Brake); // brake mode to stop
}

/**
 * Tests running the motor by directly controlling the speed
 * @param dir the direction to run the motor in, 0 for forward and 1 for backward
 */
void Motor::speedControlTest(SpinMode dir) {
    setupRippleCounting();
    setToSpeedControlMode();

    setSpinMode(SpinMode::Brake); // brake mode to start
    printFault();

    setSpeed(0);

    enableSpin();
    printFault();

    setSpinMode(dir);
    printFault();

    for (int i = 1; i <= 10; i++) {
        setSpeed(i * 40);
        printInfo();
        k_msleep(2000);
    }

    setSpinMode(SpinMode::Brake); // brake mode to stop
}

/**
 * Pre Condition: i2c bus is ready and motor is connected to the bus
 * Sets up the motor driver to run in speed control mode
 */
int Motor::initSpeedControl() {
    if (!device_is_ready(i2c_bus)) {
        printk("No i2c ready");
        return 0;
    }
    setupRippleCounting();
    setToSpeedControlMode();
    // for some reason I need to run this again after speed mode
    // Maybe an i2c failure? maybe breadboard noise? unsure, retest on crashout board
    setupRippleCounting();
    //regDump();
    enableSoftStart();
    setSpinMode(SpinMode::Brake); // default to brake mode
    setSpeed(0);
    return 1;
}

void Motor::setTInrush(uint16_t val) {
    i2c_reg_write_byte_dt(&motor, CONFIG1_REG, val & 0xff);
    i2c_reg_write_byte_dt(&motor, CONFIG2_REG, val >> 8);
}
/**
 * Sets up the motor driver to run in voltage control mode
 */
int Motor::initVoltageControl() {
    if (!device_is_ready(i2c_bus)) {
        printk("No i2c ready");
        return 0;
    }
    setTInrush(10);

    setToVoltageControlMode();
    setupRippleCounting();
    enableSoftStart();
    setSpinMode(SpinMode::Brake); // default to brake mode
    setVoltage(0);
    return 1;
}

/**
 * Reads the motor's quadrature encoder (if it has one)
 */
int64_t Motor::read_enc() {
    if (enc == NULL) return 0xFFFFFFFFFFFFFFFF; // int 64 -limit

    struct sensor_value counter_val;

    int ret = sensor_sample_fetch(enc);
    if (ret < 0) {
        printk("Unable to fetch sensor sample: %d\n", ret);
        return ret;
    }

    ret = sensor_channel_get(enc, SENSOR_CHAN_ROTATION, &counter_val);
    if (ret < 0) {
        printk("Unable to read sensor channel: %d\n", ret);
        return ret;
    }
    constexpr int64_t udeg360 = 360'000'000;
    int64_t microdegrees = sensor_value_to_micro(&counter_val);
    if (flip_encoder) {
        microdegrees = udeg360 - microdegrees;
    }
    // if underflowed or overflowed, add 1 or subtract one based on estimate
    // threshold found by 100 output rpm motor at 1:298 = 3.12 rad/ms
    // threshold found by 30 output rpm motor at 1:1000 = 3.14 rad/ms
    // if we skip our encoder check 10 times at 10 ms cycle it could
    // be as much as 100 ms so jump 314 rad
    // 314 rad = 17990 deg = 49.9 rotations ~= 50 rotations
    // 7 ticks per rotation but kinda 14 bc two pulses = 700 ticks
    // ticks per 360 degrees = 56000, 62580 for encoder 1, encoder 2
    // 6428.57, 5752.63 udeg / tick
    // 6428 udeg/tick * 700 ticks  = 4499600
    // =  ~4 degrees
    // 4 degrees per 100 ms vs 356 degrees per 100 ms assuming shorter path
    constexpr int64_t wrap_guess_threshold_microdeg = 4499600;
    constexpr int64_t wrap_guess_threshold_microdeg_top = udeg360 - wrap_guess_threshold_microdeg;

    if (last_microdegrees < wrap_guess_threshold_microdeg && microdegrees > wrap_guess_threshold_microdeg_top) {
        // underflow
        full_enc_rotations--;
    } else if (last_microdegrees > wrap_guess_threshold_microdeg_top && microdegrees < wrap_guess_threshold_microdeg) {
        // overflow
        full_enc_rotations++;
    }

    last_microdegrees = microdegrees;
    int64_t combined = (full_enc_rotations * udeg360) + microdegrees;
    return combined;
}
```

## src/motor.hpp
```c
/*
 * @file motor.cpp
 * 
 * Motor Class for controlling the motor driver of a single motor
 * Contains methods for enabling and disabling various settings of the motor driver
 * Can control the motor in both voltage control mode and speed control mode
 *
 * @author Collin Casey, Richard Sommers
 */
#include <zephyr/drivers/gpio.h>
#include <zephyr/drivers/i2c.h>

class Motor {
  public:
    /* Global variables */
    const struct device* i2c_bus;
    struct i2c_dt_spec motor;
    const struct device* enc;
    bool flip_voltage = false;
    bool flip_encoder = false;
    int32_t full_enc_rotations = 0;
    int64_t last_microdegrees = 0;
    uint8_t flt = 0;

    // w_scale_value is used to convert the speed value read from the motor driver in Rad/s to RPM
    // The default value 16 is the minimum value and maxes the motor out at 4080 Rad/s (Page 31 of datatsheet)
    static constexpr uint8_t DEFAULT_W_SCALE_VALUE = 16;
    uint8_t w_scale_value = DEFAULT_W_SCALE_VALUE;

    /**
     * Contructs an instance of the Motor class with the given i2c address.
     */
    Motor(const struct device* i2c_bus, uint8_t addr, bool flip_voltage);

    /**
     * Contructs an instance of the Motor class with the given i2c device specification.
     */
    Motor(const struct device* i2c_bus, struct i2c_dt_spec motor_spec, bool flip_voltage);


    /**
     * Contructs an instance of the Motor class with the given i2c address and encoder.
     */
    Motor(const struct device* i2c_bus, uint8_t addr, bool flip_voltage, const struct device* dcm_enc, bool flip_encoder);

    /**
     * Contructs an instance of the Motor class with the given i2c device specification and encoder.
     */
    Motor(const struct device* i2c_bus, struct i2c_dt_spec motor_spec, bool flip_voltage, const struct device* dcm_enc, bool flip_encoder);

    /**
     * Sets the voltage of the motor driver by writing to the appropriate register.
     */
    void setVoltage(float volts);
    void setVoltage16(uint16_t millivolts);
    void setDirAndVoltage16(int16_t millivolts);

    void setTInrush(uint16_t val);
    /**
     * Sets the w_scale value of the motor driver by writing to the appropriate register 
     * if w_scale given is valid (16, 32, 64, or 128).
     */
    void set_w_scale_value(uint32_t w_scale);

    /**
     * Sets the speed of the motor driver by writing to the appropriate register.
     * @param radps the speed to set the motor to in Rad/s
     */
    void setSpeed(uint16_t radps);

    /**
     * Converts the voltage value read from the motor driver to volts.
     * The value 228 is the maximum value that can be read from the motor driver and corresponds to 38 volts (Page 45 of datasheet).
     */
    float map_voltage(uint8_t vmtr);

    /**
     * Converts the speed value read from the motor driver in Rad/s to RPM.
     */
    float speed_rpm(uint8_t speed, int32_t w_scale);

    /**
     * Sets the motor driver to speed control mode
     */
    void setToSpeedControlMode();

    /**
     * Sets the motor driver to voltage control mode
     */
    void setToVoltageControlMode();

    void setStopOnStall(bool enabled);

    /**
     * Reads and prints the voltage, speed, ripple count, and direction from the motor driver.
     */
    void printInfo();

    /**
     * Reads and prints the fault register from the motor driver.
     */
    void printFault();
    void clearFault();
    bool didFault(uint8_t *fault);


    /**
     * Prints the values of all of the registers in the motor driver
     */
    void regDump();

    /**
     * Sets up the ripple counting on the motor driver by writing to the appropriate registers.
     */
    void setupRippleCounting();

    /**
     * Enable overvoltage protection, and stall protection
     */
    void enableOVSProtection();

    /**
     * Disable overvoltage protection, and stall protection
     */
    void disableOVSProtection();

    /**
     * Enable motor spinning, overvoltage protection, and stall protection
     */
    void enableSpin();
    /**
     * Disable motor spinning
     */
    void disableSpin();



    enum SpinMode {
        Forward,
        Backward, 
        Brake,
    };
    /**
     * Sets the spin mode of the motor driver by writing to the appropriate register.
     * @param mode: 0 = forward, 1 = backward, 2 = brake
     * We don't actually know which way forward and backward are, because it depends on how the motor is wired
     */
    void setSpinMode(SpinMode mode);

    /**
     * Enables the soft start feature of the motor driver by writing to the appropriate register.
     */
    void enableSoftStart();

    /**
     * Disables the soft start feature of the motor driver by writing to the appropriate register.
     */
    void disableSoftStart();

    /**
     * Tests running the motor by controlling the voltage sent to it
     * @param dir the direction to run the motor in, 0 for forward and 1 for backward
     */
    void voltageControlTest(uint8_t dir);

    /**
     * Tests running the motor by directly controlling the speed
     * @param dir the direction to run the motor in
     */
    void speedControlTest(SpinMode dir);

    /**
     * Pre Condition: i2c bus is ready and motor is connected to the bus
     * Sets up the motor driver to run in speed control mode
     */
    int initSpeedControl();

    /**
     * Sets up the motor driver to run in voltage control mode
     */
    int initVoltageControl();

    /**
     * Reads the motor's quadrature encoder to microdegrees (if it has one)
     */
    int64_t read_enc();
};
```

## src/servo.hpp
```c
#pragma once
#include "common.hpp"
#include <zephyr/drivers/pwm.h>



struct Servo {
    struct pwm_dt_spec pwm;
    uint32_t closed_us;
    uint32_t open_us;
    uint32_t last_us;

    int disconnect();
    int open();
    int close();
    int set_us(uint32_t us);

};


void servo_init();
void set_servo_motion(FlipServo servoid, FlipServoMotion motion);

MovementResult step_servo(FlipServo servoid);
void stop_servo_move(FlipServo servoid);
void start_servo_move(FlipServo servoid);

void start_servo_hold();
void stop_servo_hold();
```
