## CMakeLists.txt
```
cmake_minimum_required(VERSION 3.20.0)

find_package(Zephyr REQUIRED HINTS $ENV{ZEPHYR_BASE})

include(${ZEPHYR_FSW_MODULE_DIR}/cmake/Autocoders.cmake)


project(payload_flight_software LANGUAGES CXX)

target_compile_options(app PRIVATE -Wall -Wno-unused-parameter -Wno-unused-function -Wno-ignored-qualifiers)
FILE(GLOB app_sources src/*.cpp src/*.c)
target_sources(app PRIVATE ${app_sources})

AutocodeTypes(${CMAKE_SOURCE_DIR}/ac/types.yaml)
AutocodeNetworkDefinitions()
add_dependencies(app ac_types)

set(LORAMAC_SRC $ENV{ZEPHYR_BASE}/../modules/lib/loramac-node/src)
target_include_directories(app PRIVATE ${LORAMAC_SRC}/radio/ ${LORAMAC_SRC}/system/ ${LORAMAC_SRC}/boards/)
```

## sample.yaml
```
sample:
  description: control_freak
  name: control_freak
common:
  build_only: true
  platform_allow:
    - control_freak
tests:
  control_freak.flight.default: {}
```

## prj.conf
```kconfig
CONFIG_HORUS_TIMESLOT_SECONDS=15
CONFIG_HORUS_TIMESLOT_OFFSET_SECONDS=0

CONFIG_SHELL_VT100_COMMANDS=n
CONFIG_SHELL_PROMPT_UART=""

# default 99 but boostdata lock needs to happen after and 
# zephyr dies if priority > 99
CONFIG_FILE_SYSTEM_INIT_PRIORITY=98
CONFIG_CPP=y
CONFIG_REQUIRES_FULL_LIBCPP=y
CONFIG_STD_CPP20=y

CONFIG_F_CORE=y
CONFIG_F_CORE_OS=y

CONFIG_MAIN_STACK_SIZE=8192


# CONFIG_NO_OPTIMIZATIONS=y
#CONFIG_SIZE_OPTIMIZATIONS=y
CONFIG_SPEED_OPTIMIZATIONS=y
CONFIG_REBOOT=y

CONFIG_LOG=y
CONFIG_APP_FREAK_LOG_LEVEL_INF=y
CONFIG_CBPRINTF_FP_SUPPORT=y
CONFIG_LOG_PRINTK=y
CONFIG_SHELL_LOG_BACKEND=y

CONFIG_POLL=y
CONFIG_BASE64=y
CONFIG_SERIAL=y
CONFIG_SPI=y
CONFIG_I2C=y


CONFIG_EVENTS=y

#CONFIG_UART_ASYNC_API=y
CONFIG_UART_CONSOLE=y
# CONFIG_SHELL_BACKEND_UART=y
# 
# CONFIG_UART_CONSOLE=n
# CONFIG_RTT_CONSOLE=y
# CONFIG_USE_SEGGER_RTT=y
# CONFIG_SHELL_BACKEND_RTT=y
# CONFIG_UART_INTERRUPT_DRIVEN=y

CONFIG_SHELL=y

CONFIG_GPIO_SHELL=y
CONFIG_I2C_SHELL=y
CONFIG_SENSOR_SHELL=y
CONFIG_FLASH_SHELL=y
CONFIG_FILE_SYSTEM_SHELL=y
CONFIG_HEAP_MEM_POOL_SIZE=8192

# Flash chip is SPI
CONFIG_FLASH=y
CONFIG_FLASH_MAP=y
CONFIG_FLASH_PAGE_LAYOUT=y

# Use filesystem
CONFIG_FILE_SYSTEM=y
# Use LittleFS as the filesystem
CONFIG_FILE_SYSTEM_LITTLEFS=y
# LittleFS is mounted on a flash map device
CONFIG_FS_LITTLEFS_FMP_DEV=y 




CONFIG_SENSOR=y
CONFIG_SENSOR_INFO=y

CONFIG_PWM=y

CONFIG_LORA=y
CONFIG_LORA_SHELL=y
CONFIG_LORA_SX127X=y
#CONFIG_LORA_LOG_LEVEL_DBG=y
CONFIG_HORUSV2=y
CONFIG_HORUS_LOG_LEVEL_WRN=y

CONFIG_GNSS=y
CONFIG_GNSS_SATELLITES=n
CONFIG_GNSS_LOG_LEVEL_INF=y

#CONFIG_GNSS_DUMP_TO_LOG=y
#CONFIG_GNSS_DUMP_TO_LOG_BUF_SIZE=1024

CONFIG_SYSTEM_WORKQUEUE_STACK_SIZE=8096
CONFIG_FLASH_SHELL_BUFFER_SIZE=1024

CONFIG_SHELL_STACK_SIZE=4096
CONFIG_STORAGE_THREAD_STACK_SIZE=1536
CONFIG_LOG_BUFFER_SIZE=4096
```

## debug.conf
```kconfig
CONFIG_DEBUG=y
CONFIG_THREAD_NAME=y
CONFIG_DEBUG_THREAD_INFO=y

CONFIG_THREAD_ANALYZER=y
CONFIG_THREAD_ANALYZER_USE_PRINTK=y
CONFIG_THREAD_ANALYZER_AUTO=y
CONFIG_THREAD_ANALYZER_AUTO_INTERVAL=15
```

## src/main.cpp
```c
#include "f_core/radio/protocols/horus/horus.h"

#include <errno.h>
#include <math.h>
#include <stdio.h>
#include <stdlib.h>
#include <zephyr/drivers/gnss.h>
#include <zephyr/drivers/gpio.h>
#include <zephyr/drivers/lora.h>
#include <zephyr/drivers/pwm.h>
#include <zephyr/drivers/sensor.h>
#include <zephyr/drivers/spi.h>
#include <zephyr/fs/fs.h>
#include <zephyr/kernel.h>
#include <zephyr/logging/log.h>
#include <zephyr/shell/shell.h>
#include <zephyr/types.h>
LOG_MODULE_REGISTER(radio_recv);

#define RADIO_NODE DT_ALIAS(lora0)
static const struct device *radio = DEVICE_DT_GET(RADIO_NODE);

const uint32_t carrier = 432950000;

static const struct gpio_dt_spec ldo_en = GPIO_DT_SPEC_GET(DT_ALIAS(ldo5v), gpios);
const struct gpio_dt_spec buzzer = GPIO_DT_SPEC_GET(DT_ALIAS(buzz), gpios);

const char *state_name(uint8_t b) {
    switch (b) {
        case 0:
            return "Not Set";
        case 1:
            return "On Pad";
        case 2:
            return "Boost";
        case 3:
            return "Flight";
        case 4:
            return "Initial Roll";
        case 5:
            return "Initial Pump";
        case 6:
            return "Continous";
        default:
            return "Other????";
    }
}

int main() {
    struct lora_modem_config cfg {
        .frequency = carrier, .bandwidth = BW_250_KHZ, .datarate = SF_12, .coding_rate = CR_4_8, .preamble_len = 8,
        .tx_power = 20, .tx = false, .public_network = false,
    };

    int ret = lora_config(radio, &cfg);
    if (ret != 0) {
        LOG_WRN("Couldnt conf lora: %d", ret);
    }

    fs_file_t fil;
    fs_file_t_init(&fil);
    ret = fs_open(&fil, "/lfs/recv.bin", FS_O_CREATE | FS_O_APPEND);
    if (ret < 0) {
        LOG_ERR("Couldnt open: %d", ret);
    }

    printk("Ready\n");
    int i = 0;
    while (true) {
        char callsign[] = "KC1MOL";
        struct horus_packet_v2 data = {0};
        char buf[sizeof(callsign) + sizeof(data)] = {};

        int16_t rssi = 0;
        int8_t snr = 0;
        ret = lora_recv(radio, (uint8_t *) buf, sizeof(buf), K_FOREVER, &rssi, &snr);
        if (ret < 0) {
            LOG_WRN("Couldnt ret lora: %d", ret);
        } else {
            i++;
            if (i < 8) {
                gpio_pin_set_dt(&ldo_en, 1);
                gpio_pin_set_dt(&buzzer, 1);
            }

            data = *(struct horus_packet_v2 *) (&buf[sizeof(callsign) - 1]);
            float bat_volt = (float) (data.battery_voltage) / 255 * 10;
            printk("PACKET:    %lld ms ======================\n", k_uptime_get());
            printk("Length:    %d\n", ret);
            printk("Callsign:  %.6s\n", buf);
            printk("RSSI:      %d\n", rssi);
            printk("SNR:       %d\n", snr);
            printk("ID:        %d\n", data.payload_id);
            printk("Counter:   %d\n", data.counter);
            printk("Time:      %d:%d:%d\n", data.hours, data.minutes, data.seconds);
            printk("Latitude:  %f\n", (double) data.latitude);
            printk("Longitude: %f\n", (double) data.longitude);
            printk("Altitude:  %d\n", data.altitude);
            printk("Speed:     %d\n", data.speed);
            printk("Sats:      %d\n", data.sats);
            printk("Temp:      %d\n", data.temp);
            printk("Voltage:   %.3f\n", (double) bat_volt);
            printk("Orient:    %d %d %d\n", (int8_t) data.custom_data[0], (int8_t) data.custom_data[1],
                   (int8_t) data.custom_data[2]);
            uint16_t press = data.custom_data[4] | (data.custom_data[5] << 8);
            printk("Press:     %d\n", press);
            uint8_t state = data.custom_data[7];
            const char *state_str = state_name(state);
            printk("State:     %s\n", state_str);
            printk("\n");

            ret = fs_write(&fil, &snr, sizeof(snr));
            if (ret < 0) {
                LOG_WRN("Failed to write to file: %d", ret);
                continue;
            }

            ret = fs_write(&fil, &rssi, sizeof(rssi));
            if (ret < 0) {
                LOG_WRN("Failed to write to file: %d", ret);
                continue;
            }

            ret = fs_write(&fil, &data, sizeof(data));
            if (ret < 0) {
                LOG_WRN("Failed to write to file: %d", ret);
                continue;
            }
            fs_sync(&fil);
            k_msleep(50);
            gpio_pin_set_dt(&ldo_en, 0);
            gpio_pin_set_dt(&buzzer, 0);
        }
    }
}
```
