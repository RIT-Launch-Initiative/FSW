## sample.yaml
```
sample:
  description:
  name: control_freak imagine showcase
common:
  build_only: true
  platform_allow:
    - control_freak
tests:
  control_freak.imagine.default: {}
```

## prj.conf
```kconfig
# default 99 but boostdata lock needs to happen after and 
# zephyr dies if priority > 99
CONFIG_FILE_SYSTEM_INIT_PRIORITY=98
CONFIG_CPP=y
CONFIG_REQUIRES_FULL_LIBCPP=y
CONFIG_STD_CPP20=y

CONFIG_F_CORE=y
CONFIG_F_CORE_OS=y

CONFIG_MAIN_STACK_SIZE=8192


# CONFIG_NO_OPTIMIZATIONS=y
CONFIG_SIZE_OPTIMIZATIONS=y
#CONFIG_SPEED_OPTIMIZATIONS=y
CONFIG_REBOOT=y

CONFIG_LOG=y

CONFIG_CBPRINTF_FP_SUPPORT=y
CONFIG_LOG_PRINTK=y
CONFIG_SHELL_LOG_BACKEND=y

CONFIG_POLL=y
CONFIG_BASE64=y
CONFIG_SERIAL=y
CONFIG_SPI=y
CONFIG_I2C=y


CONFIG_EVENTS=y

#CONFIG_UART_ASYNC_API=y
CONFIG_UART_CONSOLE=y
# CONFIG_SHELL_BACKEND_UART=y
# 
# CONFIG_UART_CONSOLE=n
# CONFIG_RTT_CONSOLE=y
# CONFIG_USE_SEGGER_RTT=y
# CONFIG_SHELL_BACKEND_RTT=y
# CONFIG_UART_INTERRUPT_DRIVEN=y

CONFIG_SHELL=y

CONFIG_GPIO_SHELL=y
CONFIG_I2C_SHELL=y
CONFIG_SENSOR_SHELL=y
CONFIG_FLASH_SHELL=y
CONFIG_FILE_SYSTEM_SHELL=y
CONFIG_HEAP_MEM_POOL_SIZE=8192

# Flash chip is SPI
CONFIG_FLASH=y
CONFIG_FLASH_MAP=y
CONFIG_FLASH_PAGE_LAYOUT=y

# Use filesystem
CONFIG_FILE_SYSTEM=y
# Use LittleFS as the filesystem
CONFIG_FILE_SYSTEM_LITTLEFS=y
# LittleFS is mounted on a flash map device
CONFIG_FS_LITTLEFS_FMP_DEV=y 




CONFIG_SENSOR=y
CONFIG_SENSOR_INFO=y

CONFIG_PWM=y

CONFIG_LORA=y
CONFIG_LORA_SHELL=y
CONFIG_LORA_SX127X=y
#CONFIG_LORA_LOG_LEVEL_DBG=y
CONFIG_HORUSV2=y
CONFIG_HORUS_LOG_LEVEL_WRN=y

CONFIG_GNSS=y
CONFIG_GNSS_SATELLITES=n
CONFIG_GNSS_LOG_LEVEL_INF=y

#CONFIG_GNSS_DUMP_TO_LOG=y
#CONFIG_GNSS_DUMP_TO_LOG_BUF_SIZE=1024

CONFIG_SYSTEM_WORKQUEUE_STACK_SIZE=8096
CONFIG_FLASH_SHELL_BUFFER_SIZE=1024

CONFIG_SHELL_STACK_SIZE=4096
CONFIG_LOG_BUFFER_SIZE=4096
```

## src/main.cpp
```c
#include "f_core/radio/protocols/horus/horus.h"
// #include "ublox_m10.h"

#include "5v_ctrl.h"
#include "flipping.h"

#include <errno.h>
#include <math.h>
#include <stdio.h>
#include <stdlib.h>
#include <zephyr/drivers/gnss.h>
#include <zephyr/drivers/gpio.h>
#include <zephyr/drivers/lora.h>
#include <zephyr/drivers/pwm.h>
#include <zephyr/drivers/sensor.h>
#include <zephyr/drivers/spi.h>
#include <zephyr/kernel.h>
#include <zephyr/shell/shell.h>
#include <zephyr/types.h>
#define IMU_NODE DT_ALIAS(imu)
static const struct device *imu_dev = DEVICE_DT_GET(IMU_NODE);

#define INA_NODE DT_ALIAS(inaservo)
static const struct device *ina_dev = DEVICE_DT_GET(INA_NODE);

#define PUMPEN_NODE DT_NODELABEL(pump_enable)
static const struct gpio_dt_spec pump_enable = GPIO_DT_SPEC_GET(PUMPEN_NODE, gpios);

int cmd_pump_off(const struct shell *shell, size_t argc, char **argv) {
    ARG_UNUSED(shell);
    ARG_UNUSED(argc);
    ARG_UNUSED(argv);
    printk("Pump Off\n");
    rail_item_disable(FiveVoltItem::Pump);

    return 0;
}
int cmd_pump_on(const struct shell *shell, size_t argc, char **argv) {
    ARG_UNUSED(shell);
    ARG_UNUSED(argc);
    ARG_UNUSED(argv);

    printk("Pump On\n");
    rail_item_enable(FiveVoltItem::Pump);
    return 0;
}

bool doflip = false;

int cmd_orient(const struct shell *shell, size_t argc, char **argv) {
    ARG_UNUSED(shell);
    ARG_UNUSED(argv);
    ARG_UNUSED(argc);
    doflip = true;
    return 0;
}

#define SERVO_EN DT_NODELABEL(servo_enable)
static const struct gpio_dt_spec servo_en = GPIO_DT_SPEC_GET(SERVO_EN, gpios);

#define LDO5V_EN DT_NODELABEL(ldo5v_enable)
static const struct gpio_dt_spec ldo5v_en = GPIO_DT_SPEC_GET(LDO5V_EN, gpios);

#define BUZZ_EN DT_NODELABEL(buzzer)
static const struct gpio_dt_spec buzzer = GPIO_DT_SPEC_GET(BUZZ_EN, gpios);

// clang-format off

SHELL_STATIC_SUBCMD_SET_CREATE(freak_subcmds, 
        SHELL_CMD(orient, NULL, "Orientation info", cmd_orient),
        SHELL_SUBCMD_SET_END);

SHELL_CMD_REGISTER(freak, &freak_subcmds, "Control Freak Control Commands", NULL);


SHELL_STATIC_SUBCMD_SET_CREATE(pump_subcmds, 
        SHELL_CMD(on, NULL, "Pump on", cmd_pump_on),
        SHELL_CMD(off, NULL, "Pump off", cmd_pump_off),
        SHELL_SUBCMD_SET_END);

SHELL_CMD_REGISTER(pump, &pump_subcmds, "Pump Commands", NULL);


void buzzer_on(){
    rail_item_enable(FiveVoltItem::Buzzer);
}
void buzzer_off(){
    rail_item_disable(FiveVoltItem::Buzzer);
}

bool BEEP_FOREVER_IF_LOWBAT(){
    struct sensor_value voltage = {0};
    sensor_sample_fetch(ina_dev);
    sensor_channel_get(ina_dev, SENSOR_CHAN_VOLTAGE, &voltage);
    float c = sensor_value_to_float(&voltage);
    // all good
    if (c > 7.f){
        return true;
    }
    while(true){
        for (int i = 0; i < 6; i++){
            rail_item_enable(FiveVoltItem::Buzzer);
            k_msleep(100);
            rail_item_disable(FiveVoltItem::Buzzer);
            k_msleep(100);
        }
        rail_item_enable(FiveVoltItem::Buzzer);
        k_msleep(15000);
        rail_item_disable(FiveVoltItem::Buzzer);
    }
    return false;
}


int read_imu(const struct device *imu_dev, NTypes::AccelerometerData &acc) {
    int ret = sensor_sample_fetch(imu_dev);
    if (ret != 0) {
        return ret;
    }
    struct sensor_value vals[3];
    ret = sensor_channel_get(imu_dev, SENSOR_CHAN_ACCEL_XYZ, vals);
    if (ret != 0) {
        return ret;
    }
    acc.X = sensor_value_to_float(&vals[0]);
    acc.Y = sensor_value_to_float(&vals[1]);
    acc.Z = sensor_value_to_float(&vals[2]);


    return 0;
}


void find_vector_norm(NTypes::AccelerometerData &vec){
    read_imu(imu_dev, vec);
    float mag = vec.X * vec.X + vec.Y * vec.Y + vec.Z * vec.Z;
    vec.X /= mag;
    vec.Y /= mag;
    vec.Z /= mag;
}

int flip_one_side(const struct device *ina_dev, const Servo &servo, SweepStrategy strat, bool open, bool hold = false);


extern const Servo *servos[];
bool do_righting_once(){
    rail_item_enable(FiveVoltItem::Servos);
    NTypes::AccelerometerData vec = {0};
    find_vector_norm(vec); 
    PayloadFace face = find_orientation(vec);
    if (face > PayloadFace::Face3){
        printk("Cant do anything about that");
        return true;
    }
    // get associated servo
    // actuate out
    flip_one_side(ina_dev, *servos[face], SweepStrategy::Fast, true);
    // actuate in
    flip_one_side(ina_dev, *servos[face], SweepStrategy::Fast, false);
    // measure IMU
    // return true if on front face
    find_vector_norm(vec); 
    face = find_orientation(vec);

    return face == PayloadFace::Upright;
}


int right_until_upright(){
    bool upright = do_righting_once();
    if (upright){
        printf("chilling out\n");
        // just chill out man
        return 0;
    }
    while (true){
        BEEP_FOREVER_IF_LOWBAT();

        upright = do_righting_once();
        printf("while truing\n");

        if (upright){
            k_msleep(5000);
            break;
        }
        k_msleep(100);
    }
    return 0;
}

extern int init_flip_hw();
int main() {
    struct sensor_value sampling = {0};
     sensor_value_from_float(&sampling, 208);
    int ret = sensor_attr_set(imu_dev, SENSOR_CHAN_ACCEL_XYZ, SENSOR_ATTR_SAMPLING_FREQUENCY, &sampling);
    if (ret < 0){
        printk("Couldnt set sampling\n");
    }
     init_flip_hw();

    
    if (!gpio_is_ready_dt(&pump_enable)) {
        printk("No pump pin :(\n");
        return 0;
    }

    ret = gpio_pin_configure_dt(&pump_enable, GPIO_OUTPUT_INACTIVE);
    if (ret < 0) {
        printk("Failed to conf pump pin:(\n");
        return 0;
    }

    int upside_down_count = 0;
    while(true){
        NTypes::AccelerometerData my_dir = {0};
        find_vector_norm(my_dir);
        PayloadFace facing = find_orientation(my_dir);
        
        if (facing == PayloadFace::OnItsHead){
            upside_down_count++;
        } else {
            upside_down_count = 0;
        }

        if (upside_down_count > 5){
            for (int i = 0; i < 5; i++){
                buzzer_on();
                k_msleep(100);
                buzzer_off();
                k_msleep(100);
            }
            k_msleep(3000);
            right_until_upright();
        }
        k_msleep(100);
    }


    return 0;
}
```

## src/flipping.cpp
```c
#include "flipping.h"

#include "5v_ctrl.h"
#include "f_core/utils/linear_fit.hpp"

#include <algorithm>
#include <array>
#include <cmath>
#include <cstdint>
#include <zephyr/device.h>
#include <zephyr/drivers/pwm.h>
#include <zephyr/drivers/sensor.h>
#include <zephyr/logging/log.h>
#define INA_NODE DT_ALIAS(inaservo)
static const struct device *ina_dev = DEVICE_DT_GET(INA_NODE);

int read_ina(const struct device *ina_dev, float &voltage, float &current) {

    struct sensor_value value;
    int ret = sensor_sample_fetch(ina_dev);
    if (ret != 0) {
        return ret;
    }
    sensor_channel_get(ina_dev, SENSOR_CHAN_CURRENT, &value);
    current = sensor_value_to_float(&value);
    if (current > 78) {
        // man the EEs gotta be missing something
        current = 0;
    }

    sensor_channel_get(ina_dev, SENSOR_CHAN_VOLTAGE, &value);
    voltage = sensor_value_to_float(&value);
    return 0;
}

LOG_MODULE_REGISTER(flipping);

int Servo::disconnect() const { return pwm_set_pulse_dt(&pwm, 0); }
int Servo::open() const { return set_pulse(open_pulselen); }
int Servo::close() const { return set_pulse(closed_pulselen); }
int Servo::set_pulse(uint32_t pulse) const {
    state.last_ticks = pulse;
    return pwm_set_pulse_dt(&pwm, pulse);
}

float dot(const NTypes::AccelerometerData &a, const NTypes::AccelerometerData &b) {
    return a.X * b.X + a.Y * b.Y + a.Z * b.Z;
}

const char *string_face(PayloadFace p) {
    switch (p) {
        case PayloadFace::Face1:
            return "Face1";
        case PayloadFace::Face2:
            return "Face2";
        case PayloadFace::Face3:
            return "Face3";
        case PayloadFace::Upright:
            return "Upright";
        case PayloadFace::OnItsHead:
            return "On its head";
        case PayloadFace::StandingUp:
            return "StandingUp";
        default:
            return "Unknown side";
    }
    return "Unknown side";
}

// clang-format off
inline constexpr std::array<FaceAndId, PayloadFace::NumFaces> payload_faces = {
    FaceAndId{Face1, {1, 0, 0}}, 
    FaceAndId{Face2, {0, 1, 0}}, 
    FaceAndId{Face3, {-1, 0, 0}}, 
    FaceAndId{Upright, {0, -1, 0}},  
    FaceAndId{StandingUp, {0, 0, -1}}, 
    FaceAndId{OnItsHead, {0, 0, 1}},
};
// clang-format on

/**
 * Sort and get the orientation that the payload is facing
 * @param me normalized vector representing your orientation (gravity vector)
 * @param face_index index from most similar to least similar if most similar isnt working, maybe try second most similar
 */
PayloadFace find_orientation(const NTypes::AccelerometerData &me, size_t face_index) {
    struct FaceAndSimilarity {
        PayloadFace id;
        float similarity;
    };
    std::array<FaceAndSimilarity, PayloadFace::NumFaces> sims = {};
    for (int i = 0; i < PayloadFace::NumFaces; i++) {
        sims[i].id = payload_faces[i].id;
        sims[i].similarity = dot(me, payload_faces[i].direction);
    }
    std::sort(sims.begin(), sims.end(),
              [](const FaceAndSimilarity &a, const FaceAndSimilarity &b) { return a.similarity > b.similarity; });

    // for (auto s : sims) {
    // LOG_INF("%11s: %f", string_face(s.id), (double) s.similarity);
    // }
    return sims[face_index].id;
}

static constexpr uint32_t min_pulse = PWM_USEC(800);  //DT_PROP(DT_PARENT(DT_A LIAS(servo1)), min_pulse);
static constexpr uint32_t max_pulse = PWM_USEC(1700); //DT_PROP(DT_PARENT(DT_ALIAS(servo1)), max_pulse);

// States of the servos, initted in init_hw
ServoState state1{};
ServoState state2{};
ServoState state3{};

static constexpr Servo Servo1{
    .pwm = PWM_DT_SPEC_GET(DT_ALIAS(servo1)),
    .open_pulselen = PWM_USEC(930),
    .closed_pulselen = PWM_USEC(2010),
    .state = state1,
};
static constexpr Servo Servo2{
    .pwm = PWM_DT_SPEC_GET(DT_ALIAS(servo2)),
    .open_pulselen = PWM_USEC(1900),
    .closed_pulselen = PWM_USEC(985),
    .state = state2,
};
static constexpr Servo Servo3{
    .pwm = PWM_DT_SPEC_GET(DT_ALIAS(servo3)),
    .open_pulselen = PWM_USEC(1940),
    .closed_pulselen = PWM_USEC(800),
    .state = state3,
};

const Servo *servos[] = {&Servo1, &Servo2, &Servo3};

int init_flip_hw() {
    rail_item_disable(FiveVoltItem::Pump);
    rail_item_disable(FiveVoltItem::Servos);

    state1.last_ticks = Servo1.closed_pulselen;
    state2.last_ticks = Servo2.closed_pulselen;
    state3.last_ticks = Servo3.closed_pulselen;

    return 0;
}

void servo_at_boost() { Servo2.close(); }

int get_normed_orientation(const struct device *imu_dev, NTypes::AccelerometerData &vec) {

    int ret = sensor_sample_fetch(imu_dev);
    if (ret < 0) {
        printk("Failed to fetch imu: %d\n", ret);
        return ret;
    }
    struct sensor_value xyz[3] = {0};
    ret = sensor_channel_get(imu_dev, SENSOR_CHAN_ACCEL_XYZ, &xyz[0]);
    if (ret < 0) {
        LOG_WRN("Failed to get imu: %d\n", ret);
        return ret;
    }
    vec = {sensor_value_to_float(&xyz[0]), sensor_value_to_float(&xyz[1]), sensor_value_to_float(&xyz[2])};
    float norm = sqrt(vec.X * vec.X + vec.Y * vec.Y + vec.Z * vec.Z);
    vec.X /= norm;
    vec.Y /= norm;
    vec.Z /= norm;

    return 0;
}

// Best outcome
#define FLIPPED_AND_RIGHTED 0
// Ok, but need to put in some more work
#define FLIPPED_BUT_NOT_RIGHTED 1

static constexpr float servo_current_cutoff = 2.4;
constexpr int servo_steps = 120;

// #define CURRENT_LOG
#ifdef CURRENT_LOG
struct Shunt {
    float current;
    float voltage;
};

Shunt current_log[120] = {};
#endif
CMovingAverage<float, 5> filter{0};

int flip_one_side(const struct device *ina_dev, const Servo &servo, SweepStrategy strat, bool open, bool hold) {
    int msec = 20;
    if (strat == SweepStrategy::Fast) {
        msec = 5;
    } else if (strat == SweepStrategy::Faster) {
        msec = 2;
    }
    uint32_t start = servo.state.last_ticks;
    uint32_t end = servo.open_pulselen;
    if (!open) {
        end = servo.closed_pulselen;
    };

    filter.Fill(0);

    int delta = end - start;
    LOG_INF("Moving %d to %d", start, end);
    for (int i = 0; i < servo_steps; i++) {
        float current = 0;
        float voltage = 0;
        int ret = read_ina(ina_dev, voltage, current);

        filter.Feed(current);
        if (filter.Avg() > servo_current_cutoff) {
            LOG_WRN("Over currented");
            servo.disconnect();
            break;
        }
#ifdef CURRENT_LOG
        current_log[i].current = current;
        current_log[i].voltage = filter.Avg();
#endif
        int pulse = start + delta * i / servo_steps;

        ret = servo.set_pulse(pulse);
        if (ret < 0) {
            printk("Error %d: failed to set pulse width\n", ret);
        }
        k_msleep(msec);
    }
    k_msleep(100); // Wait to settle

#ifdef CURRENT_LOG
    LOG_INF("Current, Voltage\n");
    for (int i = 0; i < servo_steps; i++) {
        LOG_INF("%.4f %.4f", (double) current_log[i].current, (double) current_log[i].voltage);
        k_msleep(1);
    }
#endif
    if (!hold) {
        servo.disconnect();
    }
    return 0;
}

int set_lsm_sampling(const struct device *imu_dev, int odr) {
    struct sensor_value sampling = {0};
    sensor_value_from_float(&sampling, odr);
    int ret = sensor_attr_set(imu_dev, SENSOR_CHAN_ACCEL_XYZ, SENSOR_ATTR_SAMPLING_FREQUENCY, &sampling);
    if (ret < 0) {
        printk("LSM6DSL: Couldnt set accel sampling\n");
        return ret;
    }
    ret = sensor_attr_set(imu_dev, SENSOR_CHAN_GYRO_XYZ, SENSOR_ATTR_SAMPLING_FREQUENCY, &sampling);
    if (ret < 0) {
        printk("LSM6DSL: Couldnt set gyro sampling\n");
        return ret;
    }
    return 0;
}

int try_flipping(const struct device *imu_dev, const struct device *ina_dev, int attempts) {
    rail_item_enable(FiveVoltItem::Servos);
    int ret = set_lsm_sampling(imu_dev, 12); // dont need all that speed here
    if (ret < 0) {
        LOG_WRN("Couldn't set sampling");
    }

    PayloadFace last_face = PayloadFace::UnknownFace;
    NTypes::AccelerometerData vec = {0};
    int attempts_on_this_face = 0;

    for (int i = 0; i < attempts; i++) {
        k_msleep(2000); // just in case we're still wobbling around

        int ret = get_normed_orientation(imu_dev, vec);
        if (ret != 0) {
            LOG_WRN("Couldnt read IMU, trying again: %d", ret);
            continue;
        }
        PayloadFace face = find_orientation(vec);
        LOG_INF("Am on face %s", string_face(face));
        if (face == last_face) {
            attempts_on_this_face++;
            LOG_INF("Haven't moved %d times", attempts_on_this_face);
        } else {
            attempts_on_this_face = 0;
        }
        last_face = face;

        if (face == PayloadFace::OnItsHead || face == PayloadFace::StandingUp) {
            LOG_WRN("Oh its so over");
            continue;
        } else if (face == PayloadFace::Upright) {
            LOG_INF("All good");
            rail_item_disable(FiveVoltItem::Servos);
            return FLIPPED_AND_RIGHTED;
        }

        int index = face;
        SweepStrategy strategy = SweepStrategy::Slow;
        if (attempts_on_this_face > 8) {
            strategy = SweepStrategy::Faster;
        } else if (attempts_on_this_face > 3) {
            strategy = SweepStrategy::Fast;
        }
        ret = flip_one_side(ina_dev, *servos[index], strategy, true, false);
        if (ret != 0) {
            LOG_WRN("Error sweeping servo: %d", ret);
        }
        // Return
        flip_one_side(ina_dev, *servos[index], Slow, false, false);

        LOG_INF("Iteration %d complete", i);
    }
    rail_item_disable(FiveVoltItem::Servos);
    return FLIPPED_BUT_NOT_RIGHTED;
}

int servo_preflight(const struct shell *shell) {
    rail_item_enable(FiveVoltItem::Servos);
    for (int i = 0; i < 3; i++) {
        shell_print(shell, "Servo %d Open", i + 1);
        servos[i]->open();
        k_msleep(100);
        servos[i]->disconnect();
    }
    for (int i = 0; i < 3; i++) {
        shell_print(shell, "Servo %d Close", i + 1);
        servos[i]->close();
        k_msleep(100);
        servos[i]->disconnect();
    }
    rail_item_disable(FiveVoltItem::Servos);

    return 0;
}

int cmd_open(const struct shell *shell, size_t argc, char **argv) {
    if (argc != 2) {
        shell_error(shell, "SPecify which serv 1-3");
        return -1;
    }
    int servo = atoi(argv[1]);
    if (servo < 1 || servo > 3) {
        shell_error(shell, "Bad servo arg");
        return -1;
    }

    rail_item_enable(FiveVoltItem::Servos);
    shell_print(shell, "Opening %d", servo);
    servos[servo - 1]->open();
    k_msleep(1000);
    servos[servo - 1]->disconnect();
    rail_item_disable(FiveVoltItem::Servos);
    return 0;
}
int cmd_openhold(const struct shell *shell, size_t argc, char **argv) {
    if (argc != 2) {
        shell_error(shell, "SPecify which serv 1-3");
        return -1;
    }
    int servo = atoi(argv[1]);
    if (servo < 1 || servo > 3) {
        shell_error(shell, "Bad servo arg");
        return -1;
    }
    rail_item_enable(FiveVoltItem::Servos);
    flip_one_side(ina_dev, *servos[servo - 1], SweepStrategy::Fast, true, true);

    return 0;
}

int cmd_closehold(const struct shell *shell, size_t argc, char **argv) {
    if (argc != 2) {
        shell_error(shell, "SPecify which serv 1-3");
        return -1;
    }
    int servo = atoi(argv[1]);
    if (servo < 1 || servo > 3) {
        shell_error(shell, "Bad servo arg");
        return -1;
    }

    rail_item_enable(FiveVoltItem::Servos);
    flip_one_side(ina_dev, *servos[servo - 1], SweepStrategy::Fast, false, false);

    return 0;
}

int cmd_close(const struct shell *shell, size_t argc, char **argv) {
    if (argc != 2) {
        shell_error(shell, "SPecify which serv 1-3");
        return -1;
    }
    int servo = atoi(argv[1]);
    if (servo < 1 || servo > 3) {
        shell_error(shell, "Bad servo arg");
        return -1;
    }

    rail_item_enable(FiveVoltItem::Servos);
    shell_print(shell, "Opening %d", servo);
    servos[servo - 1]->close();
    k_msleep(1000);
    servos[servo - 1]->disconnect();
    rail_item_disable(FiveVoltItem::Servos);
    return 0;
}
int cmd_zeroall(const struct shell *shell, size_t argc, char **argv) {
    ARG_UNUSED(argc);
    ARG_UNUSED(argv);

    rail_item_enable(FiveVoltItem::Servos);
    shell_print(shell, "Closing 1");
    Servo1.close();
    k_msleep(1000);
    Servo1.disconnect();
    shell_print(shell, "Closing 2");
    Servo2.close();
    k_msleep(1000);
    Servo2.disconnect();
    shell_print(shell, "Closing 3");
    Servo3.close();
    k_msleep(1000);
    Servo3.disconnect();
    rail_item_disable(FiveVoltItem::Servos);
    return 0;
}

SHELL_STATIC_SUBCMD_SET_CREATE(servo_subcmds, SHELL_CMD(zero, NULL, "Zero all servos", cmd_zeroall),
                               SHELL_CMD(open, NULL, "Open servo", cmd_open),
                               SHELL_CMD(close, NULL, "Clos servo", cmd_close),
                               SHELL_CMD(openhold, NULL, "Open servo hold", cmd_openhold),
                               SHELL_CMD(closehold, NULL, "Clos servo hold", cmd_closehold), SHELL_SUBCMD_SET_END);

SHELL_CMD_REGISTER(servo, &servo_subcmds, "Servo Commands", NULL);
```

## src/flipping.h
```c
#include <cstdint>
#include <zephyr/device.h>
#include <zephyr/drivers/pwm.h>
#include <zephyr/shell/shell.h>

int servo_preflight(const struct shell *shell);
// Turn on the servo and lock it in place so that when apogee happens the door stays shut
void servo_at_boost();

enum SweepStrategy {
    Slow,
    Fast,
    Faster,
};

namespace NTypes {
struct AccelerometerData {

    float X, Y, Z;
};
} // namespace NTypes

struct ServoState {
    uint32_t last_ticks;
};

struct Servo {
    struct pwm_dt_spec pwm;
    uint32_t open_pulselen;
    uint32_t closed_pulselen;
    ServoState &state;

    int disconnect() const;
    int open() const;
    int close() const;
    int set_pulse(uint32_t pulse) const;
};

enum PayloadFace : uint8_t {
    Face1 = 0,
    Face2 = 1,
    Face3 = 2,
    Upright = 3,
    StandingUp = 4,
    OnItsHead = 5,
    NumFaces = 6,
    UnknownFace = 7,
};

PayloadFace find_orientation(const NTypes::AccelerometerData &me, size_t face_index = 0);

// Face ID and the unit vector that represents its direction
struct FaceAndId {
    PayloadFace id;
    NTypes::AccelerometerData direction;
};
/**
 * Return string representation of a face
 */
const char *string_face(PayloadFace p);

int init_flip_hw();

int do_flipping_and_pumping(const struct device *imu_dev, const struct device *barom_dev,
                            const struct device *ina_servo, const struct device *ina_pump);
```

## src/orient.cpp
```c
#include "orient.h"

#include <algorithm>
#include <math.h>
#include <zephyr/drivers/sensor.h>

#define IMU_NODE DT_ALIAS(imu)
static const struct device *imu_dev = DEVICE_DT_GET(IMU_NODE);

int Servo::open() const { return set_pulse(open_pulselen); }
int Servo::close() const { return set_pulse(closed_pulselen); }
int Servo::set_pulse(uint32_t pulse) const {
    state.last_ticks = pulse;
    return pwm_set_pulse_dt(&pwm, pulse);
}

int Servo::disconnect() const { return pwm_set_pulse_dt(&pwm, 0); }

bool Servo::was_fully_open() const { return state.last_ticks == open_pulselen; }
bool Servo::was_fully_closed() const { return state.last_ticks == closed_pulselen; }

float dot(const vec3 &a, const vec3 &b) { return a.x * b.x + a.y * b.y + a.z * b.z; }

const char *string_face(PayloadFace p) {
    switch (p) {
        case PayloadFace::Face1:
            return "Face1";
        case PayloadFace::Face2:
            return "Face2";
        case PayloadFace::Face3:
            return "Face3";
        case PayloadFace::Upright:
            return "Upright";
        case PayloadFace::OnItsHead:
            return "On its head";
        case PayloadFace::StandingUp:
            return "StandingUp";
        default:
            return "Unknown side";
    }
    return "Unknown side";
}

PayloadFace find_orientation(const vec3 &me) {
    struct FaceAndSimilarity {
        PayloadFace id;
        float similarity;
    };
    std::array<FaceAndSimilarity, PayloadFace::NumFaces> sims = {};
    for (int i = 0; i < PayloadFace::NumFaces; i++) {
        sims[i].id = payload_faces[i].id;
        sims[i].similarity = dot(me, payload_faces[i].direction);
    }
    std::sort(sims.begin(), sims.end(),
              [](const FaceAndSimilarity &a, const FaceAndSimilarity &b) { return a.similarity > b.similarity; });

    return sims[0].id;
}

int find_vector(vec3 &me) {

    int ret = sensor_sample_fetch(imu_dev);
    if (ret < 0) {
        printk("Failed to fetch imu: %d\n", ret);
        return ret;
    }
    struct sensor_value xyz[3] = {0};
    ret = sensor_channel_get(imu_dev, SENSOR_CHAN_ACCEL_XYZ, &xyz[0]);
    if (ret < 0) {
        printk("Failed to get imu: %d\n", ret);
        return ret;
    }
    me = {sensor_value_to_float(&xyz[0]), sensor_value_to_float(&xyz[1]), sensor_value_to_float(&xyz[2])};
    printk("[%f, %f, %f]", me.x, me.y, me.z);
    float norm = sqrt(me.x * me.x + me.y * me.y + me.z * me.z);
    me.x /= norm;
    me.y /= norm;
    me.z /= norm;

    return 0;
}
```

## src/orient.h
```c
#include <array>
#include <cstdint>
#include <zephyr/drivers/pwm.h>

struct ServoState {
    uint32_t last_ticks;
};
struct Servo {
    struct pwm_dt_spec pwm;
    uint32_t open_pulselen;
    uint32_t closed_pulselen;
    ServoState &state;

    int disconnect() const;
    int open() const;
    int close() const;
    int set_pulse(uint32_t ticks) const;

    bool was_fully_open() const;
    bool was_fully_closed() const;
};

struct vec3 {
    float x;
    float y;
    float z;
};

enum PayloadFace : uint8_t {
    Face1 = 0,
    Face2 = 1,
    Face3 = 2,
    Upright = 3,
    StandingUp = 4,
    OnItsHead = 5,
    NumFaces = 6,
};

const char *string_face(PayloadFace p);
struct FaceAndId {
    PayloadFace id;
    vec3 direction;
};

PayloadFace find_orientation(const vec3 &me);
int find_vector(vec3 &me);
// return true if rightside up
bool do_righting_once();

// clang-format off
inline constexpr std::array<FaceAndId, PayloadFace::NumFaces> payload_faces = {
    FaceAndId{Face1, {1, 0, 0}}, 
    FaceAndId{Face2, {0, 1, 0}}, 
    FaceAndId{Face3, {-1, 0, 0}}, 
    FaceAndId{Upright, {0, -1, 0}},  
    FaceAndId{StandingUp, {0, 0, -1}}, 
    FaceAndId{OnItsHead, {0, 0, 1}},
};
// clang-format on
```

## src/servo.cpp
```c
#include "orient.h"

#include <zephyr/drivers/gpio.h>
#include <zephyr/drivers/pwm.h>
#include <zephyr/drivers/sensor.h>
#include <zephyr/kernel.h>
#include <zephyr/shell/shell.h>

#define SERVO_EN DT_NODELABEL(servo_enable)
static const struct gpio_dt_spec servo_en = GPIO_DT_SPEC_GET(SERVO_EN, gpios);

#define LDO5V_EN DT_NODELABEL(ldo5v_enable)
static const struct gpio_dt_spec ldo5v_en = GPIO_DT_SPEC_GET(LDO5V_EN, gpios);

static constexpr uint32_t min_pulse = PWM_USEC(800);  //DT_PROP(DT_PARENT(DT_A LIAS(servo1)), min_pulse);
static constexpr uint32_t max_pulse = PWM_USEC(1700); //DT_PROP(DT_PARENT(DT_ALIAS(servo1)), max_pulse);

#define INA_NODE DT_ALIAS(inaservo)
const struct device *ina = DEVICE_DT_GET(INA_NODE);

// false when closed, true when open
ServoState state1{};
ServoState state2{};
ServoState state3{};

static constexpr Servo Servo1{
    .pwm = PWM_DT_SPEC_GET(DT_ALIAS(servo1)),
    .open_pulselen = min_pulse,
    .closed_pulselen = max_pulse,
    .state = state1,
};
static constexpr Servo Servo2{
    .pwm = PWM_DT_SPEC_GET(DT_ALIAS(servo2)),
    .open_pulselen = max_pulse,
    .closed_pulselen = min_pulse,
    .state = state2,
};
static constexpr Servo Servo3{
    .pwm = PWM_DT_SPEC_GET(DT_ALIAS(servo3)),
    .open_pulselen = max_pulse,
    .closed_pulselen = min_pulse,
    .state = state3,
};

const Servo *servos[] = {&Servo1, &Servo2, &Servo3};

void change_servo(const Servo &servo, bool newstate, bool stop_after = true) {
    int ret = 0;
    if (newstate) {
        servo.open();
        k_msleep(500);
    } else {
        servo.close();
        k_msleep(500);
    }

    if (ret < 0) {
        printk("Error %d: failed to set pulse width\n", ret);
        return;
    }

    if (stop_after) {
        servo.disconnect();
    }
}

struct Power {
    float current;
    float voltage;
    float power;
};

constexpr int servo_steps = 120;
Power current_log[120] = {};

void sweep_servo(const Servo &servo) {

    uint32_t start = servo.closed_pulselen;
    uint32_t end = servo.open_pulselen;
    if (servo.state.last_ticks == servo.open_pulselen) {
        start = servo.open_pulselen;
        end = servo.closed_pulselen;
    };

    int delta = end - start;
    printf("%d to %d\n", start, end);
    for (int i = 0; i < servo_steps; i++) {
        struct sensor_value current;
        sensor_sample_fetch(ina);
        sensor_channel_get(ina, SENSOR_CHAN_CURRENT, &current);
        float c = sensor_value_to_float(&current);
        current_log[i].current = c;

        sensor_sample_fetch(ina);
        sensor_channel_get(ina, SENSOR_CHAN_VOLTAGE, &current);
        c = sensor_value_to_float(&current);
        current_log[i].voltage = c;

        sensor_sample_fetch(ina);
        sensor_channel_get(ina, SENSOR_CHAN_POWER, &current);
        c = sensor_value_to_float(&current);
        current_log[i].power = c;

        int pulse = start + delta * i / servo_steps;

        int ret = pwm_set_pulse_dt(&servo.pwm, pulse);
        if (ret < 0) {
            printk("Error %d: failed to set pulse width\n", ret);
        }
        k_msleep(20);
    }
    printf("Current, Voltage, Power\n");
    for (int i = 0; i < servo_steps; i++) {
        printf("%.4f, %.4f, %.4f\n", current_log[i].current, current_log[i].voltage, current_log[i].power);
    }
    int ret = pwm_set_pulse_dt(&servo.pwm, end);
    if (ret < 0) {
        printk("Error %d: failed to set pulse width\n", ret);
    }
    k_msleep(100);
    ret = pwm_set_pulse_dt(&servo.pwm, 0);
    if (ret < 0) {
        printk("Error %d: failed to set pulse width\n", ret);
    }
}

int init_servo() {
    int ret;
    if (!gpio_is_ready_dt(&servo_en)) {
        printk("No servo enable :(\n");
        return 0;
    }
    if (!gpio_is_ready_dt(&ldo5v_en)) {
        printk("No ldo5v enable :(\n");
        return 0;
    }
    ret = gpio_pin_configure_dt(&servo_en, GPIO_OUTPUT_ACTIVE);
    if (ret < 0) {
        printk("Failed to conf servo_en :(\n");
        return 0;
    }
    ret = gpio_pin_configure_dt(&ldo5v_en, GPIO_OUTPUT_ACTIVE);
    if (ret < 0) {
        printk("Failed to conf ldo5v_en :(\n");
        return 0;
    }
    ret = gpio_pin_set_dt(&servo_en, 1);
    if (ret < 0) {
        printk("couldnt set servo_en: %d\n", ret);
    }

    ret = gpio_pin_set_dt(&ldo5v_en, 1);
    if (ret < 0) {
        printk("couldnt set ldo5v_en: %d\n", ret);
    }
    printk("Servos on\n");
    return 0;
}
int cmd_servo_freak(const struct shell *shell, size_t argc, char **argv) {
    ARG_UNUSED(shell);
    ARG_UNUSED(argc);
    ARG_UNUSED(argv);
    for (int i = 0; i < 10; i++) {
        change_servo(Servo1, false);
        k_msleep(1000);
        change_servo(Servo2, false);
        k_msleep(1000);
        change_servo(Servo3, false);
        k_msleep(1000);

        change_servo(Servo1, true);
        k_msleep(1000);
        change_servo(Servo2, true);
        k_msleep(1000);
        change_servo(Servo3, true);
        k_msleep(1000);
    }
    return 0;
}
int cmd_servo_on(const struct shell *shell, size_t argc, char **argv) {
    ARG_UNUSED(shell);
    ARG_UNUSED(argc);
    ARG_UNUSED(argv);
    return init_servo();
}
int cmd_servo_off(const struct shell *shell, size_t argc, char **argv) {
    ARG_UNUSED(shell);
    ARG_UNUSED(argc);
    ARG_UNUSED(argv);

    int ret = gpio_pin_set_dt(&servo_en, 0);
    if (ret < 0) {
        printk("couldnt set servo_en: %d\n", ret);
    }

    ret = gpio_pin_set_dt(&ldo5v_en, 0);
    if (ret < 0) {
        printk("couldnt set ldo5v_en: %d\n", ret);
    }
    return ret;
}

int parse_servo_args(const struct shell *shell, size_t argc, char **argv, int *const servoNum, bool *const state) {
    if (argc != 2 && argc != 3) {
        shell_print(shell, "Wrong number of args");
        shell_print(shell, "Help: servo 1/2/3 o/c");
        return -1;
    }
    char servoNumChar = argv[1][0];

    *servoNum = 0;
    if (servoNumChar == '1') {
        *servoNum = 0;
    } else if (servoNumChar == '2') {
        *servoNum = 1;
    } else if (servoNumChar == '3') {
        *servoNum = 2;
    } else {
        shell_print(shell, "Invalid servo number");
        return -1;
    }
    if (argc == 2) {
        if ((*servos[*servoNum]).was_fully_open()) {
            *state = false;
        } else {
            *state = true;
        }

    } else if (argc == 3) {

        char operationChar = argv[2][0];
        shell_print(shell, "Servo Control %c %c", servoNumChar, operationChar);
        *state = true;

        if (operationChar == 'o') {
            *state = true;
        } else if (operationChar == 'c') {
            *state = false;
        } else {
            shell_print(shell, "Invalid operation");
            return -1;
        }
    }
    return 0;
}

int cmd_servo_move(const struct shell *shell, size_t argc, char **argv) {
    int servoNum = 0;
    bool do_open = false;
    parse_servo_args(shell, argc, argv, &servoNum, &do_open);
    shell_print(shell, "Parsed: #%d doOpen: %d", servoNum, (int) do_open);
    change_servo(*(servos[servoNum]), do_open);

    return 0;
}

int cmd_servo_sweep(const struct shell *shell, size_t argc, char **argv) {
    int servoNum = 0;
    bool do_open = false;
    parse_servo_args(shell, argc, argv, &servoNum, &do_open);
    shell_print(shell, "Parsed: #%d doOpen: %d", servoNum, (int) do_open);
    sweep_servo(*(servos[servoNum]));

    return 0;
}

bool do_righting_once() {
    vec3 my_dir = {0};
    find_vector(my_dir);
    PayloadFace facing = find_orientation(my_dir);
    printk("Facing: %s\n", string_face(facing));
    if (facing == PayloadFace::Upright) {
        printk("All good smile :+1:\n");
        return true;
    } else if (facing == PayloadFace::OnItsHead || facing == PayloadFace::StandingUp) {
        // printk("We're boned, will try again in a second tho\n");
    } else {
        int servoIdx = (int) facing;
        change_servo(*servos[servoIdx], true);
        k_msleep(1000);
        change_servo(*servos[servoIdx], false);
    }
    k_msleep(1000);
    return false;
}

int cmd_servo_try_righting(const struct shell *shell, size_t argc, char **argv) {
    if (argc != 3) {
        shell_print(shell, "Wrong number of arguments: roll [ms delay before starting] [# of attempts]");
        return -1;
    }

    int ret = 0;
    int initDelay = shell_strtol(argv[1], 10, &ret);
    if (ret != 0) {
        shell_error(shell, "Failed to parse delay ms");
    }

    int attempts = shell_strtol(argv[2], 10, &ret);
    if (ret != 0) {
        shell_error(shell, "Failed to parse # of attempts: %d", ret);
        return ret;
    }
    shell_print(shell, "Waiting %d ms before starting", initDelay);
    shell_print(shell, "Giving %d attempts to flip", attempts);
    k_msleep(initDelay);

    for (int i = 0; i < attempts; i++) {
        vec3 my_dir = {0};
        find_vector(my_dir);
        PayloadFace facing = find_orientation(my_dir);
        printk("Facing: %s\n", string_face(facing));
        if (facing == PayloadFace::Upright) {
            printk("All good smile :+1:\n");
            break;
        } else if (facing == PayloadFace::OnItsHead || facing == PayloadFace::StandingUp) {
            printk("We're boned, will try again in a second tho\n");
        } else {
            int servoIdx = (int) facing;
            change_servo(*servos[servoIdx], true);
            k_msleep(1000);
            change_servo(*servos[servoIdx], false);
        }
        k_msleep(1000);
    }

    return 0;
}
```
