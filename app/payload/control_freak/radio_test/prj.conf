## CMakeLists.txt
```
cmake_minimum_required(VERSION 3.20.0)


find_package(Zephyr REQUIRED HINTS $ENV{ZEPHYR_BASE})
project(payload_board_bringup LANGUAGES CXX)


set(LORAMAC_SRC $ENV{ZEPHYR_BASE}/../modules/lib/loramac-node/src)


target_compile_options(app PRIVATE -Wall -Wextra -Wno-unused-function -Wno-ignored-qualifiers -Wno-missing-field-initializers)
FILE(GLOB app_sources src/*.cpp)
target_sources(app PRIVATE ${app_sources})
target_include_directories(app PRIVATE ${LORAMAC_SRC}/radio/ ${LORAMAC_SRC}/system/ ${LORAMAC_SRC}/boards/)
```

## Kconfig
```
source "Kconfig.zephyr"
config HORUS_PAYLOAD_ID
	int "Payload ID"
	default 0
```

## sample.yaml
```
sample:
  description:
  name: control_freak bring up and debugging
common:
  build_only: true
  platform_allow:
    - control_freak
tests:
  control_freak.radio-testing.default: {}
```

## prj.conf
```kconfig
CONFIG_HORUS_PAYLOAD_ID=808

CONFIG_CORTEX_M_SYSTICK_64BIT_CYCLE_COUNTER=y

 # outputs
CONFIG_SERIAL=y
CONFIG_SENSOR_INFO=y
CONFIG_SENSOR_SHELL=y

CONFIG_IDLE_STACK_SIZE=2048
CONFIG_SYSTEM_WORKQUEUE_STACK_SIZE=8192

CONFIG_DEBUG=y
CONFIG_HORUSV2=y
CONFIG_HORUS_INTERLEAVER=y
CONFIG_HORUS_SCRAMBLER=y

CONFIG_F_CORE_PROTOCOLS=y
CONFIG_F_CORE=y

CONFIG_HORUS_LOG_LEVEL_WRN=y

CONFIG_PWM=y
CONFIG_LORA_SHELL=y
CONFIG_LORA_LOG_LEVEL_INF=y
CONFIG_BOOT_BANNER=y

CONFIG_GNSS_LOG_LEVEL_DBG=y
CONFIG_MODEM_MODULES_LOG_LEVEL_INF=y

CONFIG_DEBUG=y
CONFIG_LOG=y
CONFIG_LOG_PRINTK=y
# CONFIG_LOG_BACKEND_UART=y

# CONFIG_LOG_MODE_IMMEDIATE=y
CONFIG_CBPRINTF_FP_SUPPORT=y
CONFIG_SPI_NOR_SFDP_RUNTIME=y

# Filesystem
CONFIG_FILE_SYSTEM=y
CONFIG_FILE_SYSTEM_LITTLEFS=y
CONFIG_FS_LITTLEFS_FMP_DEV=y


# LittleFS's buffers get large
CONFIG_MAIN_STACK_SIZE=8192


CONFIG_SHELL=y
CONFIG_GPIO_SHELL=y
CONFIG_HEAP_MEM_POOL_SIZE=8192

CONFIG_LOG_BUFFER_SIZE=8192

CONFIG_GNSS=y
CONFIG_GNSS_SATELLITES=y
# CONFIG_GNSS_DUMP=y
CONFIG_GNSS_LOG_LEVEL_DBG=y
CONFIG_LOG_CMDS=y

CONFIG_SYSTEM_WORKQUEUE_STACK_SIZE=8192
```

## src/main.cpp
```c
#include "f_core/radio/protocols/horus/horus.h"
#include "orient.h"
#include "ublox_m10.h"

#include <errno.h>
#include <math.h>
#include <stdio.h>
#include <stdlib.h>
#include <zephyr/drivers/gnss.h>
#include <zephyr/drivers/gpio.h>
#include <zephyr/drivers/lora.h>
#include <zephyr/drivers/pwm.h>
#include <zephyr/drivers/sensor.h>
#include <zephyr/drivers/spi.h>
#include <zephyr/kernel.h>
#include <zephyr/shell/shell.h>
#include <zephyr/types.h>

#define IMU_NODE DT_ALIAS(imu)
static const struct device *imu_dev = DEVICE_DT_GET(IMU_NODE);

#define PUMPEN_NODE DT_NODELABEL(pump_enable)
static const struct gpio_dt_spec pump_enable = GPIO_DT_SPEC_GET(PUMPEN_NODE, gpios);

#define RADIORST_NODE DT_ALIAS(radioreset)
static const struct gpio_dt_spec radioreset = GPIO_DT_SPEC_GET(RADIORST_NODE, gpios);

#define GNSS_NODE DT_ALIAS(gnss)

#define DEFAULT_RADIO_NODE DT_ALIAS(lora0)

const uint32_t time_sync_period = 15;                 // transmit every `time_sync_period` seconds
const uint32_t time_sync_seconds_from_hour_start = 0; // transmit this many seconds off the start of the hour

// General Data
struct gnss_data last_data = {};
#define MAX_SATS 20
int current_sats = 0;
int current_tracked_sats = 0;
struct gnss_satellite last_sats[MAX_SATS] = {};
k_ticks_t last_fix_uptime_ticks = 0;

uint32_t millis_till_next_timeslot() {
    k_ticks_t timepulse_uptime = 0;
    gnss_get_latest_timepulse(DEVICE_DT_GET(GNSS_NODE), &timepulse_uptime);

    if (timepulse_uptime == 0 || last_data.info.fix_status == GNSS_FIX_STATUS_NO_FIX || last_fix_uptime_ticks == 0) {
        printf("No valid time data, delaying by a made up number (%d seconds)\n", time_sync_period);
        return time_sync_period * 1000;
    }
    printf("Valid Time data, can calculate\n");
    // Assume timepulse was for the last NMEA time sentence, correct later if
    // not
    uint32_t seconds_from_hour_start_of_last_timepulse = last_data.utc.minute * 60 + last_data.utc.millisecond / 1000;
    if (last_fix_uptime_ticks < timepulse_uptime) {
        // A time pulse has come in after that NMEA sentence
        // Add 1 second to compensate
        seconds_from_hour_start_of_last_timepulse++;
    }
    int32_t seconds_from_time_sync_start =
        seconds_from_hour_start_of_last_timepulse - time_sync_seconds_from_hour_start;

    if (seconds_from_time_sync_start < 0) {
        // if before time slice time, pretend we're going from the previous hour
        seconds_from_time_sync_start += 60 * 60;
    }

    uint32_t periods_so_far = seconds_from_time_sync_start / time_sync_period;

    uint32_t offset_into_this_period = seconds_from_time_sync_start - (time_sync_period * periods_so_far);

    uint32_t seconds_from_timepulse_to_next_slot = time_sync_period - offset_into_this_period;

    int64_t now_ms = k_uptime_get();
    int64_t tp_ms = k_ticks_to_ms_near64(timepulse_uptime);

    int64_t uptime_ms_of_next_slot = tp_ms + seconds_from_timepulse_to_next_slot * 1000;
    int32_t ms_left = uptime_ms_of_next_slot - now_ms;
    if (ms_left < 0 || ms_left > (int) (time_sync_period * 1000)) {
        printf("ERROR calculating time sync: %d wanted < %d\n", ms_left, (int) (time_sync_period * 1000));
        return time_sync_period * 1000;
    }

    return ms_left;
}

static void gnss_data_cb(const struct device *dev, const struct gnss_data *data) {
    ARG_UNUSED(dev);

    last_data = *data;
    printf("GNSS DATA\n");
    if (data->info.fix_status != GNSS_FIX_STATUS_NO_FIX) {
        last_fix_uptime_ticks = k_uptime_ticks();
    }
}
GNSS_DATA_CALLBACK_DEFINE(DEVICE_DT_GET(GNSS_NODE), gnss_data_cb);

static void gnss_satellites_cb(const struct device *dev, const struct gnss_satellite *satellites, uint16_t size) {
    ARG_UNUSED(dev);

    unsigned int tracked_count = 0;
    current_sats = size;
    for (unsigned int i = 0; i != size; ++i) {
        tracked_count += satellites[i].is_tracked;
        last_sats[i] = satellites[i];
    }
}
GNSS_SATELLITES_CALLBACK_DEFINE(DEVICE_DT_GET(GNSS_NODE), gnss_satellites_cb);

uint16_t horus_seq_number = 0;

horus_packet_v2 get_telemetry() {
    int8_t temp = 30;
    uint8_t volts = 0;
    float lat = (float) (((double) last_data.nav_data.latitude) / 1e9);
    float lon = (float) (((double) last_data.nav_data.longitude) / 1e9);
    uint16_t alt = last_data.nav_data.altitude / 1000;                       // mm to m
    uint8_t speed = (uint8_t) (((float) last_data.nav_data.speed) * 0.0036); // mm/sec to km/hr

    horus_seq_number++;
    horus_packet_v2 pac{
        .payload_id = CONFIG_HORUS_PAYLOAD_ID,
        .counter = horus_seq_number,
        .hours = last_data.utc.hour,
        .minutes = last_data.utc.minute,
        .seconds = (uint8_t) (last_data.utc.millisecond / 1000),
        .latitude = lat,
        .longitude = lon,
        .altitude = alt,
        .speed = speed,
        .sats = (uint8_t) last_data.info.satellites_cnt,
        .temp = temp,
        .battery_voltage = volts,
        .custom_data = {last_data.info.fix_status, last_data.info.fix_quality},
    };
    return pac;
}
bool do_lora = false;
bool do_horus = false;
bool do_lorarx = false;

const char noradio_prompt[] = "( )uart:~$";
const char lora_prompt[] = "(L)uart:~$";
const char horus_prompt[] = "(H)uart:~$";
const char both_prompt[] = "(B)uart:~$";

void set_prompt(const struct shell *shell) {
    if (do_lora && do_horus) {
        shell_prompt_change(shell, both_prompt);
    } else if (do_lora) {
        shell_prompt_change(shell, lora_prompt);
    } else if (do_horus) {
        shell_prompt_change(shell, horus_prompt);
    } else {
        shell_prompt_change(shell, noradio_prompt);
    }
}

static const char *gnss_system_to_str(enum gnss_system system) {
    switch (system) {
        case GNSS_SYSTEM_GPS:
            return "GPS";
        case GNSS_SYSTEM_GLONASS:
            return "GLONASS";
        case GNSS_SYSTEM_GALILEO:
            return "GALILEO";
        case GNSS_SYSTEM_BEIDOU:
            return "BEIDOU";
        case GNSS_SYSTEM_QZSS:
            return "QZSS";
        case GNSS_SYSTEM_IRNSS:
            return "IRNSS";
        case GNSS_SYSTEM_SBAS:
            return "SBAS";
        case GNSS_SYSTEM_IMES:
            return "IMES";
    }

    return "unknown";
}
static int cmd_fix_info(const struct shell *shell, size_t argc, char **argv) {
    ARG_UNUSED(argc);
    ARG_UNUSED(argv);
    const struct device *gnss_dev = DEVICE_DT_GET(GNSS_NODE);

    struct ublox_m10_data *data = (struct ublox_m10_data *) gnss_dev->data;

    uint64_t now = k_uptime_get();
    int elapsed = (now - last_fix_uptime_ticks);
    if (last_fix_uptime_ticks != 0) {
        shell_print(shell, "Got a fix %d ms ago", elapsed);
    } else {
        shell_print(shell, "Never got a gps fix");
    }
    shell_print(shell, "Cyc of pulse: %lld delta %lld us", data->last_tick,
                k_ticks_to_us_near64(data->last_tick_delta));

    int64_t last_tp_uptime_ms = k_ticks_to_ms_near64(data->last_tick);
    shell_print(shell, "Got a pulse at %lld ms uptime (%d ms ago)", last_tp_uptime_ms, (int) (now - last_tp_uptime_ms));
    int64_t sec_len = k_ticks_to_ns_near64(data->last_tick_delta);
    shell_print(shell, "Second Length %lld ns", sec_len);

    return 0;
}

static const char *gnss_fix_status_to_str(enum gnss_fix_status fix_status) {
    switch (fix_status) {
        case GNSS_FIX_STATUS_NO_FIX:
            return "NO_FIX";
        case GNSS_FIX_STATUS_GNSS_FIX:
            return "GNSS_FIX";
        case GNSS_FIX_STATUS_DGNSS_FIX:
            return "DGNSS_FIX";
        case GNSS_FIX_STATUS_ESTIMATED_FIX:
            return "ESTIMATED_FIX";
    }

    return "unknown";
}

static const char *gnss_fix_quality_to_str(enum gnss_fix_quality fix_quality) {
    switch (fix_quality) {
        case GNSS_FIX_QUALITY_INVALID:
            return "INVALID";
        case GNSS_FIX_QUALITY_GNSS_SPS:
            return "GNSS_SPS";
        case GNSS_FIX_QUALITY_DGNSS:
            return "DGNSS";
        case GNSS_FIX_QUALITY_GNSS_PPS:
            return "GNSS_PPS";
        case GNSS_FIX_QUALITY_RTK:
            return "RTK";
        case GNSS_FIX_QUALITY_FLOAT_RTK:
            return "FLOAT_RTK";
        case GNSS_FIX_QUALITY_ESTIMATED:
            return "ESTIMATED";
    }

    return "unknown";
}

int gnss_dump_nav_data(char *str, uint16_t strsize, const struct navigation_data *nav_data) {
    int ret;
    const char *fmt = "nav_data:\n  lat: %s%lli.%09lli,\n  long : %s%lli.%09lli\n  "
                      "bearing %u.%03u\n  speed %u.%03u\n  altitude: %s%i.%03i";
    const char *lat_sign = nav_data->latitude < 0 ? "-" : "";
    const char *lon_sign = nav_data->longitude < 0 ? "-" : "";
    const char *alt_sign = nav_data->altitude < 0 ? "-" : "";

    ret = snprintk(str, strsize, fmt, lat_sign, llabs(nav_data->latitude) / 1000000000,
                   llabs(nav_data->latitude) % 1000000000, lon_sign, llabs(nav_data->longitude) / 1000000000,
                   llabs(nav_data->longitude) % 1000000000, nav_data->bearing / 1000, nav_data->bearing % 1000,
                   nav_data->speed / 1000, nav_data->speed % 1000, alt_sign, abs(nav_data->altitude) / 1000,
                   abs(nav_data->altitude) % 1000);

    return (strsize < ret) ? -ENOMEM : 0;
}

int gnss_dump_time(char *str, uint16_t strsize, const struct gnss_time *utc) {
    int ret;
    const char *fmt = "time:\n  hour: %u\n  minute: %u\n  millisecond %u\n  month_day %u, "
                      "month: %u\n  year: %u";

    ret = snprintk(str, strsize, fmt, utc->hour, utc->minute, utc->millisecond, utc->month_day, utc->month,
                   utc->century_year);

    return (strsize < ret) ? -ENOMEM : 0;
}

int gnss_dump_info(char *str, uint16_t strsize, const struct gnss_info *info) {
    int ret;
    const char *fmt = "gnss_info:\n  satellites_cnt: %u\n  hdop: %u.%u\n  fix_status: %s, "
                      "\n  fix_quality: %s";

    ret = snprintk(str, strsize, fmt, info->satellites_cnt, info->hdop / 1000, info->hdop % 1000,
                   gnss_fix_status_to_str(info->fix_status), gnss_fix_quality_to_str(info->fix_quality));

    return (strsize < ret) ? -ENOMEM : 0;
}

static int cmd_gnss_info(const struct shell *shell, size_t argc, char **argv) {
    ARG_UNUSED(argc);
    ARG_UNUSED(argv);
    shell_print(shell, "gnss info:");
    static char dumpstr[256] = {0};
    const struct gnss_info *info = &last_data.info;
    const struct gnss_time *time = &last_data.utc;
    const struct navigation_data *nav_data = &last_data.nav_data;
    gnss_dump_nav_data(dumpstr, sizeof(dumpstr), nav_data);
    shell_print(shell, "%s", dumpstr);

    gnss_dump_time(dumpstr, sizeof(dumpstr), time);
    shell_print(shell, "%s", dumpstr);

    gnss_dump_info(dumpstr, sizeof(dumpstr), info);
    shell_print(shell, "%s", dumpstr);
    return 0;
}

static int cmd_sat_info(const struct shell *shell, size_t argc, char **argv) {
    ARG_UNUSED(argc);
    ARG_UNUSED(argv);

    shell_print(shell, "(tracked)(prn, snr) (elavation, azimuth) - system");
    if (current_sats == 0) {
        shell_print(shell, "No satelites");
    }
    for (int i = 0; i < current_sats; i++) {
        struct gnss_satellite *sat = &last_sats[i];
        shell_print(shell, "Sat(%d): (%d,%d), (%d %d) - %s", (int) sat->is_tracked, sat->prn, sat->snr, sat->elevation,
                    sat->azimuth, gnss_system_to_str(sat->system));
    }
    return 0;
}

// Radio transmission
extern void make_and_transmit_horus();
extern void make_and_send_lora();

// Radio Commands
extern int cmd_horustx(const struct shell *shell, size_t argc, char **argv);
extern int cmd_loracfg(const struct shell *shell, size_t argc, char **argv);
extern int cmd_loratx(const struct shell *shell, size_t argc, char **argv);
int cmd_lorarx(const struct shell *shell, size_t argc, char **argv) {
    ARG_UNUSED(argc);
    ARG_UNUSED(argv);
    do_lorarx = !do_lorarx;
    shell_print(shell, "LoraRX: %d", (int) do_lorarx);
    return 0;
}

extern int cmd_servo_sweep(const struct shell *shell, size_t argc, char **argv);
extern int cmd_servo_move(const struct shell *shell, size_t argc, char **argv);
extern int cmd_servo_off(const struct shell *shell, size_t argc, char **argv);
extern int cmd_servo_on(const struct shell *shell, size_t argc, char **argv);
extern int cmd_servo_freak(const struct shell *shell, size_t argc, char **argv);
extern int cmd_servo_try_righting(const struct shell *shell, size_t argc, char **argv);

int cmd_pump_off(const struct shell *shell, size_t argc, char **argv) {
    ARG_UNUSED(shell);
    ARG_UNUSED(argc);
    ARG_UNUSED(argv);
    printk("Pump Off\n");
    return gpio_pin_set_dt(&pump_enable, 0);
}
int cmd_pump_on(const struct shell *shell, size_t argc, char **argv) {
    ARG_UNUSED(shell);
    ARG_UNUSED(argc);
    ARG_UNUSED(argv);

    printk("Pump On\n");
    return gpio_pin_set_dt(&pump_enable, 1);
}

int cmd_orient(const struct shell *shell, size_t argc, char **argv) {
    ARG_UNUSED(shell);
    ARG_UNUSED(argv);
    ARG_UNUSED(argc);
    vec3 me = {0, 0, 0};
    int ret = find_vector(me);
    (void) ret;
    PayloadFace to_actuate = find_orientation(me);
    if (to_actuate == PayloadFace::Upright) {
        shell_print(shell, "Already upright");
    } else if (to_actuate == PayloadFace::OnItsHead || to_actuate == PayloadFace::StandingUp) {
        shell_print(shell, "We're boned");
    } else {
        shell_print(shell, "To actuate: %d", to_actuate);
        // look up servo
    }
    return 0;
}

extern void init_lora_modem();
extern int init_servo();

#define SERVO_EN DT_NODELABEL(servo_enable)
static const struct gpio_dt_spec servo_en = GPIO_DT_SPEC_GET(SERVO_EN, gpios);

#define LDO5V_EN DT_NODELABEL(ldo5v_enable)
static const struct gpio_dt_spec ldo5v_en = GPIO_DT_SPEC_GET(LDO5V_EN, gpios);

#define BUZZ_EN DT_NODELABEL(buzzer)
static const struct gpio_dt_spec buzzer = GPIO_DT_SPEC_GET(BUZZ_EN, gpios);

int cmd_buzzer_toggle(const struct shell *shell, size_t argc, char **argv) {
    ARG_UNUSED(shell);
    ARG_UNUSED(argc);
    ARG_UNUSED(argv);
    gpio_pin_set_dt(&ldo5v_en, 1);
    gpio_pin_toggle_dt(&buzzer);
    return 0;
}
// clang-format off
SHELL_STATIC_SUBCMD_SET_CREATE(buzzer_subcmds, 
        SHELL_CMD(buzz, NULL, "Turn on buzzer", cmd_buzzer_toggle),
        SHELL_SUBCMD_SET_END);
SHELL_CMD_REGISTER(buzzer, &buzzer_subcmds, "Control Freak Control Commands", NULL);

SHELL_STATIC_SUBCMD_SET_CREATE(freak_subcmds, 
        SHELL_CMD(info, NULL, "GNSS Info to shell", cmd_gnss_info),
        SHELL_CMD(sat, NULL, "Sat Info to shell", cmd_sat_info),
        SHELL_CMD(fixstat, NULL, "Fix info", cmd_fix_info),
        SHELL_CMD(orient, NULL, "Orientation info", cmd_orient),
        SHELL_CMD(roll, NULL, "Attempt to flip: [# of attempts]", cmd_servo_try_righting),
        SHELL_SUBCMD_SET_END);

SHELL_CMD_REGISTER(freak, &freak_subcmds, "Control Freak Control Commands", NULL);

SHELL_STATIC_SUBCMD_SET_CREATE(radio_subcmds, 
        SHELL_CMD(rxlora, NULL, "Receive lora packets", cmd_lorarx),
        SHELL_CMD(loratx, NULL, "Enable LoRa transmission", cmd_loratx),
        SHELL_CMD(horustx, NULL, "Enable Horus transmission", cmd_horustx),
        SHELL_CMD(cfglora, NULL, "Configure lora (BW SF CR FREQ)", cmd_loracfg),
        SHELL_SUBCMD_SET_END);

SHELL_CMD_REGISTER(radio, &radio_subcmds, "Radio Commands", NULL);

SHELL_STATIC_SUBCMD_SET_CREATE(servo_subcmds, 
        SHELL_CMD(sweep, NULL, "sweep servo", cmd_servo_sweep),
        SHELL_CMD(move, NULL, "move servo", cmd_servo_move),
        SHELL_CMD(on, NULL, "Turn on servo power", cmd_servo_on),
        SHELL_CMD(off, NULL, "Turn off servo power", cmd_servo_off),
        SHELL_CMD(freak, NULL, "Freak servos", cmd_servo_freak),
        SHELL_SUBCMD_SET_END);

SHELL_CMD_REGISTER(servo, &servo_subcmds, "Servo Commands", NULL);

SHELL_STATIC_SUBCMD_SET_CREATE(pump_subcmds, 
        SHELL_CMD(on, NULL, "Pump on", cmd_pump_on),
        SHELL_CMD(off, NULL, "Pump off", cmd_pump_off),
        SHELL_SUBCMD_SET_END);

SHELL_CMD_REGISTER(pump, &pump_subcmds, "Pump Commands", NULL);


void wait_for_timeslot(){

    uint32_t towait = millis_till_next_timeslot();
    k_msleep(towait);
}

extern void lorarx(struct fs_file_t *fil);

int radio_thread(){
    while (true){
        // Maybe make packet AOT and only transmit at timeslot
        if (do_horus){
            wait_for_timeslot();
            printk("Horus\n");
            make_and_transmit_horus();
        }
        if(do_lora) {
            wait_for_timeslot();
            // lora
            printk("Lora\n");
            make_and_send_lora();
        }
        if (do_lorarx){
            lorarx(nullptr);
            k_msleep(500);
        } else if (!do_lora && !do_horus){
            k_msleep(500);
        }
    }
    return 0;
}


int main() {
    struct sensor_value sampling = {0};
     sensor_value_from_float(&sampling, 208);
    int ret = sensor_attr_set(imu_dev, SENSOR_CHAN_ACCEL_XYZ, SENSOR_ATTR_SAMPLING_FREQUENCY, &sampling);
    if (ret < 0){
        printk("Couldnt set sampling\n");
    }
    init_servo();
    // reset_gps();
    // gps_timepulse_cb();
    init_lora_modem();

    if (!gpio_is_ready_dt(&pump_enable)) {
        printk("No pump pin :(\n");
        return 0;
    }

    ret = gpio_pin_configure_dt(&pump_enable, GPIO_OUTPUT_INACTIVE);
    if (ret < 0) {
        printk("Failed to conf pump pin:(\n");
        return 0;
    }


    radio_thread();
    return 0;
}
```

## src/buzzer.h
```c
void buzzer_on();
```

## src/horus.cpp
```c
#include "f_core/radio/protocols/horus/horus.h"

#include <errno.h>
#include <stdio.h>
#include <stdlib.h>
#include <zephyr/drivers/gnss.h>
#include <zephyr/drivers/gpio.h>
#include <zephyr/drivers/lora.h>
#include <zephyr/drivers/pwm.h>
#include <zephyr/drivers/spi.h>
#include <zephyr/kernel.h>
#include <zephyr/shell/shell.h>
#include <zephyr/types.h>
#define FXOSC_HZ                       32000000
#define RFM_FSTEP_HZ                   61.03515625
#define RFM_MAX_FREQUENCY_DEVIATION_HZ 999879

// BS ALERT
#include "sx1276/sx1276.h"

#define RADIORST_NODE DT_ALIAS(radioreset)
static const struct gpio_dt_spec radioreset = GPIO_DT_SPEC_GET(RADIORST_NODE, gpios);

#define MAX_SATS 20
extern struct gnss_data last_data;
extern int current_sats;
extern int current_tracked_sats;
extern struct gnss_satellite last_sats[MAX_SATS];
extern uint64_t last_fix_uptime;

extern bool do_horus;
extern void set_prompt(const struct shell *shell);
extern horus_packet_v2 get_telemetry();

int32_t set_pramble_len(uint16_t preamble_len) {
    uint8_t msb = (preamble_len >> 8) & 0xff;
    uint8_t lsb = (preamble_len >> 8) & 0xff;
    SX1276Write(REG_PREAMBLEMSB, msb);
    SX1276Write(REG_PREAMBLELSB, lsb);
    return 0;
}

/**
 * Calculate the values needed for Fdev registers from a frequency in Hertz
 * @return -ERANGE if the frequency is out of range. 0 if its in range
 */
static int32_t frequency_dev_regs_from_fdev(uint32_t fdev, uint8_t *msb, uint8_t *lsb) {
    if (fdev > 200000) {
        return -ERANGE;
    }
    // Fdev = Fstep * Fdev[15,0]
    // Fdev / Fstep = Fdev[15,0]
    // Fstep = FX_OSC / 2^19
    // (Fdev * 2^19) / FX_OSC = Fdev[15,0]
    uint16_t val = (uint16_t) ((double) fdev / RFM_FSTEP_HZ);
    *msb = (val >> 8) & 0xff;
    *lsb = val & 0xff;
    return 0;
}

static int32_t set_frequency_deviation_by_reg(uint8_t msb, uint8_t lsb) {
    uint8_t data[2] = {msb, lsb};
    SX1276WriteBuffer(REG_FDEVMSB, data, 2);
    return 0;
}
static int32_t set_frequency_deviation(uint32_t freq_dev) {
    uint8_t msb = 0;
    uint8_t lsb = 0;
    if (frequency_dev_regs_from_fdev(freq_dev, &msb, &lsb) < 0) {
        return -ERANGE;
    }

    return set_frequency_deviation_by_reg(msb, lsb);
}

/**
 * Sets the RF carrier frequency registers on the module.
 * This does not immediately change the frequency that the module is transmitting at or receiving from.
 * The in use RF Carrier frequency is only changed when:
 * - Entering FSRX/FSTX modes
 * - Restarting the receiver 
 * Datasheet pg. 89
 */
int32_t set_frequency_by_reg(uint8_t msb, uint8_t mid, uint8_t lsb) {
    uint8_t reg_frf[3] = {msb, mid, lsb};
    SX1276WriteBuffer(REG_FRFMSB, reg_frf, 3);
    return 0;
}

int32_t frf_reg_from_frequency(uint32_t freq, uint8_t *msb, uint8_t *mid, uint8_t *lsb) {

    ////Frf = Fstep x Frf(23,0)
    // Frf(23,0) = Frf / Fstep
    const double fstep = 61.03515625;
    uint32_t frf = freq / fstep;
    *msb = (frf >> 16) & 0xff;
    *mid = (frf >> 8) & 0xff;
    *lsb = (frf) & 0xff;

    return 0;
}

/**
 * Sets the RF carrier frequency.
 * This does not immediately change the frequency that the module is transmitting at or receiving from.
 * The in use RF Carrier frequency is only changed when:
 * - Entering FSRX/FSTX modes
 * - Restarting the receiver 
 * Datasheet pg. 89
 * @param dev the radio device
 * @param freq the frequency to set to
 * @return -ERANGE if the requested frequency is out of range for this model
 * 0 if the frequency was succesfully set
 * other sub 0 error codes from spi interaction errors.
 */
int32_t set_carrier_frequency(uint32_t freq) {
    uint8_t msb = 0;
    uint8_t mid = 0;
    uint8_t lsb = 0;
    int32_t res = frf_reg_from_frequency(freq, &msb, &mid, &lsb);
    if (res < 0) {
        return res;
    }
    res = set_frequency_by_reg(msb, mid, lsb);
    if (res < 0) {
        return res;
    }
    return res;
}

#define DT_DRV_COMPAT semtech_sx1276

struct sx127x_config {
    struct spi_dt_spec bus;
    struct gpio_dt_spec reset;
#if DT_INST_NODE_HAS_PROP(0, antenna_enable_gpios)
    struct gpio_dt_spec antenna_enable;
#endif
#if DT_INST_NODE_HAS_PROP(0, rfi_enable_gpios)
    struct gpio_dt_spec rfi_enable;
#endif
#if DT_INST_NODE_HAS_PROP(0, rfo_enable_gpios)
    struct gpio_dt_spec rfo_enable;
#endif
#if DT_INST_NODE_HAS_PROP(0, pa_boost_enable_gpios)
    struct gpio_dt_spec pa_boost_enable;
#endif
#if DT_INST_NODE_HAS_PROP(0, tcxo_power_gpios)
    struct gpio_dt_spec tcxo_power;
#endif
};

/**
 * Perform a 'Manual Reset' of the module 
 * (Datasheet pg.111 section 7.2.2)
 * @param config the module config 
 * @return any errors from configuring GPIO
 */
int32_t rfm9xw_software_reset() {
    printk("Software resetting radio with %s pin %d\n", radioreset.port->name, (int) radioreset.pin);

    if (gpio_pin_configure_dt(&radioreset, GPIO_OUTPUT | GPIO_PULL_DOWN) < 0) {
        printk("Failed to set pin to 0 to reset chip\n");
    }

    k_usleep(150); // >100us

    if (gpio_pin_configure_dt(&radioreset, GPIO_DISCONNECTED) < 0) {
        printk("Failed to set pin to 0 to reset chip\n");
    }
    k_msleep(5);

    return 0;
}
void transmit_horus(uint8_t *buf, int len) {
    const uint32_t carrier = 434000000;
    const float deviation = 405;

    const uint32_t bitrate = 100;
    const int usec_per_symbol = 10079; //1000000 / bitrate;

    const uint32_t high = carrier + deviation;
    const uint32_t step = (uint32_t) ((float) deviation * 2.f / 3.f);
    const uint32_t symbols_fdev[4] = {3 * step, 2 * step, step, 0};

    SX1276Write(REG_OPMODE,
                RF_OPMODE_LONGRANGEMODE_OFF | RF_OPMODE_MODULATIONTYPE_FSK | RF_OPMODE_SLEEP); // Standby FSK

    SX1276Write(REG_OPMODE,
                RF_OPMODE_LONGRANGEMODE_OFF | RF_OPMODE_MODULATIONTYPE_FSK | RF_OPMODE_STANDBY); // Standby FSK
    SX1276Write(REG_PLLHOP, RF_PLLHOP_FASTHOP_ON | 0x2d); // Fast hop on | default value
    SX1276Write(REG_PACONFIG, 0b11111111);
    set_pramble_len(0);
    set_carrier_frequency(high);

    // start transmitting
    set_frequency_deviation(symbols_fdev[3]);
    SX1276Write(REG_OPMODE, RF_OPMODE_LONGRANGEMODE_OFF | RF_OPMODE_MODULATIONTYPE_FSK | RF_OPMODE_TRANSMITTER);

    struct k_timer bitrate_timer;
    k_timer_init(&bitrate_timer, NULL, NULL);
    k_timer_start(&bitrate_timer, K_USEC(usec_per_symbol), K_USEC(usec_per_symbol));
    int preamble_len = 16;
    // transmit preamble 0,1,2,3 (low, 2nd lowest, 2nfd highest, highest)
    for (int i = 0; i < preamble_len; i++) {
        for (int j = 0; j < 4; j++) {
            k_timer_status_sync(&bitrate_timer);
            set_frequency_deviation(symbols_fdev[3 - j]);
        }
    }

    for (int byte_index = 0; byte_index < len; byte_index++) {
        const uint8_t byte = buf[byte_index];
        const uint8_t syms[4] = {
            (uint8_t) ((byte >> 6) & 0b11),
            (uint8_t) ((byte >> 4) & 0b11),
            (uint8_t) ((byte >> 2) & 0b11),
            (uint8_t) ((byte >> 0) & 0b11),
        };
        for (int sym_index = 0; sym_index < 4; sym_index++) {
            uint8_t sym = syms[sym_index];
            uint32_t fdev = symbols_fdev[sym];
            k_timer_status_sync(&bitrate_timer);
            set_frequency_deviation(fdev);
        }
    }
    // Last symbol
    k_timer_status_sync(&bitrate_timer);
    // Then turn off
    SX1276Write(REG_OPMODE,
                RF_OPMODE_LONGRANGEMODE_OFF | RF_OPMODE_MODULATIONTYPE_FSK | RF_OPMODE_STANDBY); // Standby FSK
    k_timer_stop(&bitrate_timer);

    return;
}

void make_and_transmit_horus() {
    struct horus_packet_v2 data = get_telemetry();

    horus_packet_v2_encoded_buffer_t packet = {0};
    horusv2_encode(&data, &packet);

    transmit_horus(&packet[0], sizeof(packet));
}

int cmd_horustx(const struct shell *shell, size_t argc, char **argv) {
    ARG_UNUSED(argc);
    ARG_UNUSED(argv);
    if (do_horus) {
        shell_print(shell, "Stop Horus");
        do_horus = false;
        set_prompt(shell);
    } else {
        shell_print(shell, "Sending Horus");
        do_horus = true;
        set_prompt(shell);
    }

    return 0;
}
```

## src/lora.cpp
```c
#include "f_core/radio/protocols/horus/horus.h"

#include <stdlib.h>
#include <zephyr/drivers/gnss.h>
#include <zephyr/drivers/gpio.h>
#include <zephyr/drivers/lora.h>
#include <zephyr/shell/shell.h>
#include <zephyr/types.h>
// BS ALERT
#include "sx1276/sx1276.h"

#define DEFAULT_RADIO_NODE DT_ALIAS(lora0)

#define MAX_SATS 20
extern struct gnss_data last_data;
extern int current_sats;
extern int current_tracked_sats;
extern struct gnss_satellite last_sats[MAX_SATS];
extern uint64_t last_fix_uptime;

extern bool do_lora;

extern void set_prompt(const struct shell *shell);
extern horus_packet_v2 get_telemetry();

static struct lora_modem_config mymodem_config = {
    .frequency = 434000000,
    .bandwidth = BW_125_KHZ,
    .datarate = SF_12,
    .coding_rate = CR_4_5,
    .preamble_len = 8,
    .tx_power = 3,
    .tx = true,
    .iq_inverted = false,
    .public_network = true,
};

void init_lora_modem() {
    const struct device *dev = DEVICE_DT_GET(DEFAULT_RADIO_NODE);
    int ret = lora_config(dev, &mymodem_config);
    if (ret < 0) {
        printk("Bad lora cfg: %d", ret);
    }
}

extern void lorarx(struct fs_file_t *fil) {
    const struct device *dev = DEVICE_DT_GET(DEFAULT_RADIO_NODE);
    mymodem_config.tx = false;
    init_lora_modem();
    horus_packet_v2 packet = {0};
    int16_t rssi;
    int8_t snr;

    int ret = lora_recv(dev, (unsigned char *) &packet, sizeof(packet), K_MSEC(5000), &rssi, &snr);
    if (ret < 0 && ret != -11) {
        printk("LoRa recv failed: %i", ret);
        return;
    }
    horus_packet_v2 me = get_telemetry();
    // Us
    static char write_buf[100] = {0};
    snprintf(write_buf, sizeof(write_buf), "%d:%d:%d, %f, %f, %d, %f, %f, %d, %d, %d\n", me.hours, me.minutes,
             me.seconds, me.latitude, me.longitude, me.altitude, packet.latitude, packet.longitude, packet.altitude,
             (int) rssi, (int) snr);
    printk("%s", write_buf);
    if (fil == nullptr) {
        return;
    }
}
static void loracfg_help(const struct shell *shell) {
    shell_print(shell, "Usage: cfg BW SF CR freq");
    shell_print(shell, "BW:\n 1: 125 khz\n 2: 250 khz\n 5: 500 khz");
    shell_print(shell, "SF:\n 6: SF6\n ...\n a: SF10\n b: SF11\n c: SF12");
    shell_print(shell, "CR:\n 5: 4/5\n 6: 4/6\n 7: 4/7\n 8: 4/8");
    shell_print(shell, "Freq: Just a number");
}
static int parse_freq(uint32_t *out, const struct shell *sh, const char *arg) {
    char *eptr;
    unsigned long val;

    val = strtoul(arg, &eptr, 0);
    if (*eptr != '\0') {
        shell_error(sh, "Invalid frequency, '%s' is not an integer", arg);
        return -EINVAL;
    }

    if (val == ULONG_MAX) {
        shell_error(sh, "Frequency %s out of range", arg);
        return -EINVAL;
    }

    *out = (uint32_t) val;
    return 0;
}

int cmd_loracfg(const struct shell *shell, size_t argc, char **argv) {
    if (argc != 5) {
        loracfg_help(shell);
        return -1;
    }
    char bwc = argv[1][0];
    char sfc = argv[2][0];
    char crc = argv[3][0];
    const char *freqStr = argv[4];
    shell_print(shell, "bw: %c, sf: %c, cr: %c", bwc, sfc, crc);
    if (bwc == '1') {
        mymodem_config.bandwidth = BW_125_KHZ;
    } else if (bwc == '2') {
        mymodem_config.bandwidth = BW_250_KHZ;
    } else if (bwc == '5') {
        mymodem_config.bandwidth = BW_500_KHZ;
    } else {
        loracfg_help(shell);
        return 0;
    }

    if (sfc == '6') {
        mymodem_config.datarate = SF_6;
    } else if (sfc == '7') {
        mymodem_config.datarate = SF_7;
    } else if (sfc == '8') {
        mymodem_config.datarate = SF_8;
    } else if (sfc == '9') {
        mymodem_config.datarate = SF_9;
    } else if (sfc == 'a') {
        mymodem_config.datarate = SF_10;
    } else if (sfc == 'b') {
        mymodem_config.datarate = SF_11;
    } else if (sfc == 'c') {
        mymodem_config.datarate = SF_12;
    } else {
        loracfg_help(shell);
        return 0;
    }
    uint32_t freq = 0;
    int ret = parse_freq(&freq, shell, freqStr);
    if (ret != 0) {
        shell_print(shell, "Invalid Freq");
        return ret;
    }
    mymodem_config.frequency = freq;
    return 0;
}
uint16_t lora_seq_number = 0;

void make_and_send_lora() {
    const struct device *dev = DEVICE_DT_GET(DEFAULT_RADIO_NODE);
    mymodem_config.tx = true;
    int ret = lora_config(dev, &mymodem_config);
    if (ret < 0) {
        printk("Bad lora cfg: %d", ret);
        return;
    }
    struct horus_packet_v2 data = get_telemetry();

    ret = lora_send(dev, (uint8_t *) &data, sizeof(data));
}

int cmd_loratx(const struct shell *shell, size_t argc, char **argv) {
    ARG_UNUSED(argc);
    ARG_UNUSED(argv);
    if (do_lora) {
        shell_print(shell, "Stopping lora");
        do_lora = false;
        set_prompt(shell);
    } else {
        shell_print(shell, "Starting Lora");
        do_lora = true;
        set_prompt(shell);
    }
    return 0;
}
```

## src/orient.cpp
```c
#include "orient.h"

#include <algorithm>
#include <math.h>
#include <zephyr/drivers/sensor.h>

#define IMU_NODE DT_ALIAS(imu)
static const struct device *imu_dev = DEVICE_DT_GET(IMU_NODE);

int Servo::close() const int Servo::set_pulse(uint32_t pulse)

    int Servo::disconnect() const {
    return pwm_set_pulse_dt(&pwm, 0);
}

bool Servo::was_fully_open() const { return state.last_ticks == open_pulselen; }
bool Servo::was_fully_closed() const { return state.last_ticks == closed_pulselen; }

int find_vector(vec3 &me) {

    int ret = sensor_sample_fetch(imu_dev);
    if (ret < 0) {
        printk("Failed to fetch imu: %d\n", ret);
        return ret;
    }
    struct sensor_value xyz[3] = {0};
    ret = sensor_channel_get(imu_dev, SENSOR_CHAN_ACCEL_XYZ, &xyz[0]);
    if (ret < 0) {
        printk("Failed to get imu: %d\n", ret);
        return ret;
    }
    me = {sensor_value_to_float(&xyz[0]), sensor_value_to_float(&xyz[1]), sensor_value_to_float(&xyz[2])};
    printk("[%f, %f, %f]", me.x, me.y, me.z);
    float norm = sqrt(me.x * me.x + me.y * me.y + me.z * me.z);
    me.x /= norm;
    me.y /= norm;
    me.z /= norm;

    return 0;
}
```

## src/orient.h
```c
#include <array>
#include <cstdint>
#include <zephyr/drivers/pwm.h>

struct ServoState {
    uint32_t last_ticks;
};
struct Servo {
    struct pwm_dt_spec pwm;
    uint32_t open_pulselen;
    uint32_t closed_pulselen;
    ServoState &state;

    int disconnect() const;
    int open() const;
    int close() const;
    int set_pulse(uint32_t ticks) const;

    bool was_fully_open() const;
    bool was_fully_closed() const;
};

struct vec3 {
    float x;
    float y;
    float z;
};

enum PayloadFace : uint8_t {
    Face1 = 0,
    Face2 = 1,
    Face3 = 2,
    Upright = 3,
    StandingUp = 4,
    OnItsHead = 5,
    NumFaces = 6,
};

const char *string_face(PayloadFace p);
struct FaceAndId {
    PayloadFace id;
    vec3 direction;
};

PayloadFace find_orientation(const vec3 &me);
int find_vector(vec3 &me);

// clang-format off
inline constexpr std::array<FaceAndId, PayloadFace::NumFaces> payload_faces = {
    FaceAndId{Face1, {1, 0, 0}}, 
    FaceAndId{Face2, {0, 1, 0}}, 
    FaceAndId{Face3, {-1, 0, 0}}, 
    FaceAndId{Upright, {0, -1, 0}},  
    FaceAndId{StandingUp, {0, 0, -1}}, 
    FaceAndId{OnItsHead, {0, 0, 1}},
};
// clang-format on
```

## src/servo.cpp
```c
#include "orient.h"

#include <zephyr/drivers/gpio.h>
#include <zephyr/drivers/pwm.h>
#include <zephyr/drivers/sensor.h>
#include <zephyr/kernel.h>
#include <zephyr/shell/shell.h>

#define SERVO_EN DT_NODELABEL(servo_enable)
static const struct gpio_dt_spec servo_en = GPIO_DT_SPEC_GET(SERVO_EN, gpios);

#define LDO5V_EN DT_NODELABEL(ldo5v_enable)
static const struct gpio_dt_spec ldo5v_en = GPIO_DT_SPEC_GET(LDO5V_EN, gpios);

static constexpr uint32_t min_pulse = PWM_USEC(800);  //DT_PROP(DT_PARENT(DT_A LIAS(servo1)), min_pulse);
static constexpr uint32_t max_pulse = PWM_USEC(1700); //DT_PROP(DT_PARENT(DT_ALIAS(servo1)), max_pulse);

#define INA_NODE DT_ALIAS(inaservo)
const struct device *ina = DEVICE_DT_GET(INA_NODE);

// false when closed, true when open
ServoState state1{};
ServoState state2{};
ServoState state3{};

static constexpr Servo Servo1{
    .pwm = PWM_DT_SPEC_GET(DT_ALIAS(servo1)),
    .open_pulselen = min_pulse,
    .closed_pulselen = max_pulse,
    .state = state1,
};
static constexpr Servo Servo2{
    .pwm = PWM_DT_SPEC_GET(DT_ALIAS(servo2)),
    .open_pulselen = max_pulse,
    .closed_pulselen = min_pulse,
    .state = state2,
};
static constexpr Servo Servo3{
    .pwm = PWM_DT_SPEC_GET(DT_ALIAS(servo3)),
    .open_pulselen = max_pulse,
    .closed_pulselen = min_pulse,
    .state = state3,
};

const Servo *servos[] = {&Servo1, &Servo2, &Servo3};

void change_servo(const Servo &servo, bool newstate, bool stop_after = true) {
    int ret = 0;
    if (newstate) {
        servo.open();
        k_msleep(500);
    } else {
        servo.close();
        k_msleep(500);
    }

    if (ret < 0) {
        printk("Error %d: failed to set pulse width\n", ret);
        return;
    }

    if (stop_after) {
        servo.disconnect();
    }
}

struct Power {
    float current;
    float voltage;
    float power;
};

constexpr int servo_steps = 120;
Power current_log[120] = {};

void sweep_servo(const Servo &servo) {

    uint32_t start = servo.closed_pulselen;
    uint32_t end = servo.open_pulselen;
    if (servo.state.last_ticks == servo.open_pulselen) {
        start = servo.open_pulselen;
        end = servo.closed_pulselen;
    };

    int delta = end - start;
    printf("%d to %d\n", start, end);
    for (int i = 0; i < servo_steps; i++) {
        struct sensor_value current;
        sensor_sample_fetch(ina);
        sensor_channel_get(ina, SENSOR_CHAN_CURRENT, &current);
        float c = sensor_value_to_float(&current);
        current_log[i].current = c;

        sensor_sample_fetch(ina);
        sensor_channel_get(ina, SENSOR_CHAN_VOLTAGE, &current);
        c = sensor_value_to_float(&current);
        current_log[i].voltage = c;

        sensor_sample_fetch(ina);
        sensor_channel_get(ina, SENSOR_CHAN_POWER, &current);
        c = sensor_value_to_float(&current);
        current_log[i].power = c;

        int pulse = start + delta * i / servo_steps;

        int ret = pwm_set_pulse_dt(&servo.pwm, pulse);
        if (ret < 0) {
            printk("Error %d: failed to set pulse width\n", ret);
        }
        k_msleep(20);
    }
    printf("Current, Voltage, Power\n");
    for (int i = 0; i < servo_steps; i++) {
        printf("%.4f, %.4f, %.4f\n", current_log[i].current, current_log[i].voltage, current_log[i].power);
    }
    int ret = pwm_set_pulse_dt(&servo.pwm, end);
    if (ret < 0) {
        printk("Error %d: failed to set pulse width\n", ret);
    }
    k_msleep(100);
    ret = pwm_set_pulse_dt(&servo.pwm, 0);
    if (ret < 0) {
        printk("Error %d: failed to set pulse width\n", ret);
    }
}

int init_servo() {
    int ret;
    if (!gpio_is_ready_dt(&servo_en)) {
        printk("No servo enable :(\n");
        return 0;
    }
    if (!gpio_is_ready_dt(&ldo5v_en)) {
        printk("No ldo5v enable :(\n");
        return 0;
    }
    ret = gpio_pin_configure_dt(&servo_en, GPIO_OUTPUT_ACTIVE);
    if (ret < 0) {
        printk("Failed to conf servo_en :(\n");
        return 0;
    }
    ret = gpio_pin_configure_dt(&ldo5v_en, GPIO_OUTPUT_ACTIVE);
    if (ret < 0) {
        printk("Failed to conf ldo5v_en :(\n");
        return 0;
    }
    ret = gpio_pin_set_dt(&servo_en, 1);
    if (ret < 0) {
        printk("couldnt set servo_en: %d\n", ret);
    }

    ret = gpio_pin_set_dt(&ldo5v_en, 1);
    if (ret < 0) {
        printk("couldnt set ldo5v_en: %d\n", ret);
    }
    printk("Servos on\n");
    return 0;
}
int cmd_servo_freak(const struct shell *shell, size_t argc, char **argv) {
    ARG_UNUSED(shell);
    ARG_UNUSED(argc);
    ARG_UNUSED(argv);
    for (int i = 0; i < 10; i++) {
        change_servo(Servo1, false);
        k_msleep(1000);
        change_servo(Servo2, false);
        k_msleep(1000);
        change_servo(Servo3, false);
        k_msleep(1000);

        change_servo(Servo1, true);
        k_msleep(1000);
        change_servo(Servo2, true);
        k_msleep(1000);
        change_servo(Servo3, true);
        k_msleep(1000);
    }
    return 0;
}
int cmd_servo_on(const struct shell *shell, size_t argc, char **argv) {
    ARG_UNUSED(shell);
    ARG_UNUSED(argc);
    ARG_UNUSED(argv);
    return init_servo();
}
int cmd_servo_off(const struct shell *shell, size_t argc, char **argv) {
    ARG_UNUSED(shell);
    ARG_UNUSED(argc);
    ARG_UNUSED(argv);

    int ret = gpio_pin_set_dt(&servo_en, 0);
    if (ret < 0) {
        printk("couldnt set servo_en: %d\n", ret);
    }

    ret = gpio_pin_set_dt(&ldo5v_en, 0);
    if (ret < 0) {
        printk("couldnt set ldo5v_en: %d\n", ret);
    }
    return ret;
}

int parse_servo_args(const struct shell *shell, size_t argc, char **argv, int *const servoNum, bool *const state) {
    if (argc != 2 && argc != 3) {
        shell_print(shell, "Wrong number of args");
        shell_print(shell, "Help: servo 1/2/3 o/c");
        return -1;
    }
    char servoNumChar = argv[1][0];

    *servoNum = 0;
    if (servoNumChar == '1') {
        *servoNum = 0;
    } else if (servoNumChar == '2') {
        *servoNum = 1;
    } else if (servoNumChar == '3') {
        *servoNum = 2;
    } else {
        shell_print(shell, "Invalid servo number");
        return -1;
    }
    if (argc == 2) {
        if ((*servos[*servoNum]).was_fully_open()) {
            *state = false;
        } else {
            *state = true;
        }

    } else if (argc == 3) {

        char operationChar = argv[2][0];
        shell_print(shell, "Servo Control %c %c", servoNumChar, operationChar);
        *state = true;

        if (operationChar == 'o') {
            *state = true;
        } else if (operationChar == 'c') {
            *state = false;
        } else {
            shell_print(shell, "Invalid operation");
            return -1;
        }
    }
    return 0;
}

int cmd_servo_move(const struct shell *shell, size_t argc, char **argv) {
    int servoNum = 0;
    bool do_open = false;
    parse_servo_args(shell, argc, argv, &servoNum, &do_open);
    shell_print(shell, "Parsed: #%d doOpen: %d", servoNum, (int) do_open);
    change_servo(*(servos[servoNum]), do_open);

    return 0;
}

int cmd_servo_sweep(const struct shell *shell, size_t argc, char **argv) {
    int servoNum = 0;
    bool do_open = false;
    parse_servo_args(shell, argc, argv, &servoNum, &do_open);
    shell_print(shell, "Parsed: #%d doOpen: %d", servoNum, (int) do_open);
    sweep_servo(*(servos[servoNum]));

    return 0;
}

int cmd_servo_try_righting(const struct shell *shell, size_t argc, char **argv) {
    if (argc != 3) {
        shell_print(shell, "Wrong number of arguments: roll [ms delay before starting] [# of attempts]");
        return -1;
    }

    int ret = 0;
    int initDelay = shell_strtol(argv[1], 10, &ret);
    if (ret != 0) {
        shell_error(shell, "Failed to parse delay ms");
    }

    int attempts = shell_strtol(argv[2], 10, &ret);
    if (ret != 0) {
        shell_error(shell, "Failed to parse # of attempts: %d", ret);
        return ret;
    }
    shell_print(shell, "Waiting %d ms before starting", initDelay);
    shell_print(shell, "Giving %d attempts to flip", attempts);
    k_msleep(initDelay);

    for (int i = 0; i < attempts; i++) {
        vec3 my_dir = {0};
        find_vector(my_dir);
        PayloadFace facing = find_orientation(my_dir);
        printk("Facing: %s\n", string_face(facing));
        if (facing == PayloadFace::Upright) {
            printk("All good smile :+1:\n");
            break;
        } else if (facing == PayloadFace::OnItsHead || facing == PayloadFace::StandingUp) {
            printk("We're boned, will try again in a second tho\n");
        } else {
            int servoIdx = (int) facing;
            change_servo(*servos[servoIdx], true);
            k_msleep(1000);
            change_servo(*servos[servoIdx], false);
        }
        k_msleep(1000);
    }

    return 0;
}
```
