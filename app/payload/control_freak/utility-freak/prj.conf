## prj.conf
```kconfig
CONFIG_PWM_SHELL=y
CONFIG_CPP=y
CONFIG_REQUIRES_FULL_LIBCPP=y
CONFIG_STD_CPP20=y

CONFIG_F_CORE=y
CONFIG_F_CORE_OS=y

CONFIG_MAIN_STACK_SIZE=8192


# CONFIG_NO_OPTIMIZATIONS=y
CONFIG_SIZE_OPTIMIZATIONS=y

CONFIG_REBOOT=y

CONFIG_LOG=y
CONFIG_APP_FREAK_LOG_LEVEL_INF=y
CONFIG_CBPRINTF_FP_SUPPORT=y
CONFIG_LOG_PRINTK=y
CONFIG_SHELL_LOG_BACKEND=y

CONFIG_POLL=y
CONFIG_BASE64=y
CONFIG_SERIAL=y
CONFIG_SPI=y
CONFIG_I2C=y


CONFIG_EVENTS=y

#CONFIG_UART_ASYNC_API=y

CONFIG_UART_CONSOLE=y
CONFIG_SHELL=y

CONFIG_GPIO_SHELL=y
CONFIG_I2C_SHELL=y
CONFIG_SENSOR_SHELL=y
CONFIG_FLASH_SHELL=y
CONFIG_FILE_SYSTEM_SHELL=y
CONFIG_HEAP_MEM_POOL_SIZE=8192

# Flash chip is SPI
CONFIG_FLASH=y
CONFIG_FLASH_MAP=y
CONFIG_FLASH_PAGE_LAYOUT=y

# Use filesystem
CONFIG_FILE_SYSTEM=y
# Use LittleFS as the filesystem
CONFIG_FILE_SYSTEM_LITTLEFS=y
# LittleFS is mounted on a flash map device
CONFIG_FS_LITTLEFS_FMP_DEV=y 




CONFIG_SENSOR=y
CONFIG_SENSOR_INFO=y

CONFIG_PWM=y

CONFIG_LORA=y
CONFIG_LORA_SHELL=y
CONFIG_LORA_SX127X=y
#CONFIG_LORA_LOG_LEVEL_DBG=y
CONFIG_HORUSV2=y
CONFIG_HORUS_LOG_LEVEL_WRN=y

CONFIG_GNSS=y
CONFIG_GNSS_SATELLITES=n
CONFIG_GNSS_LOG_LEVEL_INF=y

#CONFIG_GNSS_DUMP_TO_LOG=y
#CONFIG_GNSS_DUMP_TO_LOG_BUF_SIZE=1024

CONFIG_SYSTEM_WORKQUEUE_STACK_SIZE=8096
CONFIG_FLASH_SHELL_BUFFER_SIZE=1024

CONFIG_SHELL_STACK_SIZE=4096
CONFIG_STORAGE_THREAD_STACK_SIZE=1536
CONFIG_LOG_BUFFER_SIZE=4096
```

## src/main.cpp
```c
#include "5v_ctrl.h"
#include "cameras.h"
#include "common.h"
#include "flipping.h"

#include <zephyr/drivers/gnss.h>
#include <zephyr/drivers/sensor.h>
#include <zephyr/logging/log.h>
#include <zephyr/logging/log_ctrl.h>
#include <zephyr/shell/shell.h>
#include <zephyr/sys/base64.h>
#include <zephyr/sys/reboot.h>
LOG_MODULE_REGISTER(main, CONFIG_APP_FREAK_LOG_LEVEL);

#include <zephyr/kernel.h>

int main() {
    int ret = 0;

    ret = five_volt_rail_init();
    if (ret != 0) {
        LOG_ERR("Failed to init 5v rail control");
    }

    const struct device *imu_dev = DEVICE_DT_GET(DT_ALIAS(imu));
    const struct device *barom_dev = DEVICE_DT_GET(DT_ALIAS(barom));

    const struct device *ina_servo = DEVICE_DT_GET(DT_ALIAS(inaservo));
    const struct device *ina_pump = DEVICE_DT_GET(DT_ALIAS(inapump));

    if (!device_is_ready(imu_dev) || !device_is_ready(barom_dev)) {
        LOG_ERR("Sensor devices not ready");
        return -1;
    }
    if (!device_is_ready(ina_servo) || !device_is_ready(ina_pump)) {
        LOG_ERR("Sensor devices not ready");
        return -1;
    }

    ret = init_flip_hw();
    if (ret != 0) {
        LOG_ERR("Error initializing servo hardware");
    }
    rail_item_enable(FiveVoltItem::Servos);
    return 0;
}

// SHELL_STATIC_SUBCMD_SET_CREATE(test_subcmds, SHELL_CMD(stop, NULL, "Stop Test", cmd_stop),
//    SHELL_CMD(unlocl, NULL, "Unlock flight data partition", cmd_unlock),
//    SHELL_CMD(boost, NULL, "fake boost detect", cmd_boost),
//    SHELL_CMD(inflated, NULL, "fake inflated", cmd_inflated), SHELL_SUBCMD_SET_END);
//
// SHELL_CMD_REGISTER(test, &test_subcmds, "Test Commands", NULL);
//
// SHELL_STATIC_SUBCMD_SET_CREATE(gorb_subcmds, SHELL_CMD(dumpfast, NULL, "Dump fast partition", cmd_readfast),
//    SHELL_CMD(dumpfast, NULL, "Dump slow partition", cmd_readslow), SHELL_SUBCMD_SET_END);
//
// SHELL_CMD_REGISTER(gorb, &gorb_subcmds, "Gorbfs Commands", NULL);
```

## src/cameras.cpp
```c
#include "flight.h"

#include <zephyr/drivers/gpio.h>
#include <zephyr/logging/log.h>
#include <zephyr/shell/shell.h>

LOG_MODULE_REGISTER(cameras);

static constexpr uint32_t millis_off = (15 * 60 * 1000);
static constexpr uint32_t millis_on = (40 * 1000);
static constexpr float no_cam_voltage_thresshold = 7.9;

static float last_battery_voltage = 8.0;

int update_battery_voltage(const float &bat_voltage);
bool should_turnon_cam() { return last_battery_voltage > no_cam_voltage_thresshold; }

int camera_on(const struct gpio_dt_spec *cam) { return gpio_pin_set_dt(cam, 1); }
int camera_off(const struct gpio_dt_spec *cam) { return gpio_pin_set_dt(cam, 0); }

static const struct gpio_dt_spec antenna_cam = GPIO_DT_SPEC_GET(DT_ALIAS(groundcam), gpios);
static const struct gpio_dt_spec ground_cam = GPIO_DT_SPEC_GET(DT_ALIAS(antennacam), gpios);

int cmd_upcam(const struct shell *shell, size_t argc, char **argv) {
    if (argc != 2) {
        shell_error(shell, "Need 0 or 1 to turn on or off");
        return -1;
    }
    bool turnon = false;
    if (argv[1][0] == '1') {
        turnon = true;
    } else if (argv[1][0] == '0') {
        turnon = false;
    } else {
        shell_error(shell, "Couldnt parse second arg");
        return -1;
    }
    if (turnon) {
        return camera_on(&antenna_cam);
    } else {
        return camera_off(&antenna_cam);
    }
}

int cmd_downcam(const struct shell *shell, size_t argc, char **argv) {
    if (argc != 2) {
        shell_error(shell, "Need 0 or 1 to turn on or off");
        return -1;
    }
    bool turnon = false;
    if (argv[1][0] == '1') {
        turnon = true;
    } else if (argv[1][0] == '0') {
        turnon = false;
    } else {
        shell_error(shell, "Couldnt parse second arg");
        return -1;
    }
    if (turnon) {
        return camera_on(&ground_cam);
    } else {
        return camera_off(&ground_cam);
    }
}

SHELL_STATIC_SUBCMD_SET_CREATE(cam_subcmds, SHELL_CMD(up, NULL, "Up Camera 0/1", cmd_upcam),
                               SHELL_CMD(down, NULL, "Down Camera 0/1", cmd_downcam), SHELL_SUBCMD_SET_END);
SHELL_CMD_REGISTER(cam, &cam_subcmds, "Camera Commands", NULL);
```

## src/cameras.h
```c
#pragma once
int camera_thread_entry(void *v_fc, void *, void *);

int update_battery_voltage(const float &bat_voltage);
```

## src/common.cpp
```c
#include "common.h"

#include <cmath>
#include <zephyr/drivers/sensor.h>

int read_ina(const struct device *ina_dev, float &voltage, float &current) {

    struct sensor_value value;
    int ret = sensor_sample_fetch(ina_dev);
    if (ret != 0) {
        return ret;
    }
    sensor_channel_get(ina_dev, SENSOR_CHAN_CURRENT, &value);
    current = sensor_value_to_float(&value);
    if (voltage > 78) {
        // man the EEs gotta be missing something
        current = 0;
    }

    sensor_channel_get(ina_dev, SENSOR_CHAN_VOLTAGE, &value);
    voltage = sensor_value_to_float(&value);
    return 0;
}

int set_lsm_sampling(const struct device *imu_dev, int odr) {
    struct sensor_value sampling = {0};
    sensor_value_from_float(&sampling, odr);
    int ret = sensor_attr_set(imu_dev, SENSOR_CHAN_ACCEL_XYZ, SENSOR_ATTR_SAMPLING_FREQUENCY, &sampling);
    if (ret < 0) {
        printk("LSM6DSL: Couldnt set accel sampling\n");
        return ret;
    }
    ret = sensor_attr_set(imu_dev, SENSOR_CHAN_GYRO_XYZ, SENSOR_ATTR_SAMPLING_FREQUENCY, &sampling);
    if (ret < 0) {
        printk("LSM6DSL: Couldnt set gyro sampling\n");
        return ret;
    }
    return 0;
}

NTypes::AccelerometerData normalize(NTypes::AccelerometerData acc) {
    float magn = sqrtf(acc.X * acc.X + acc.Y * acc.Y + acc.Z * acc.Z);
    return {acc.X / magn, acc.Y / magn, acc.Z / magn};
}
```

## src/common.h
```c
#ifndef FREAK_GORBFS_H
#define FREAK_GORBFS_H

#include "n_autocoder_types.h"

#include <stdbool.h>
#include <stdint.h>
#include <zephyr/device.h>

typedef uint8_t FlipState;
#define FLIP_STATE_NOT_TRYING 0xff

#define FLIP_STATE(current_face, attempts) (((current_face & 0b111) << 5) | (attempts > 30 ? 30 : attempts))

#define IMU_SAMPLES_PER_PACKET                                                                                         \
    (sizeof(((NTypes::SuperFastPacket *) 0)->GyroData) / sizeof(((NTypes::SuperFastPacket *) 0)->GyroData[0]))

#define SLOW_DATA_PER_PACKET 8
using SuperSlowPacket = NTypes::SlowInfo[SLOW_DATA_PER_PACKET];

/**
 * @param ina_dev ina device
 * @param[out] voltage voltage that was read or unchanged on error
 * @param[out] current current that was read or unchanged on error
 */
int read_ina(const struct device *ina_dev, float &voltage, float &current);

int set_lsm_sampling(const struct device *imu_dev, int odr);

NTypes::AccelerometerData normalize(NTypes::AccelerometerData acc);

#endif
```

## src/flight.h
```c
#ifndef FREAK_FLIGHT_H
#define FREAK_FLIGHT_H
#include "f_core/flight/c_phase_controller.h"

#include <array>

// Boost
// IMU
static constexpr float imuBoostThresholdMPerS2 = 5 * 9.8;  // m/s^2
static constexpr uint32_t imuBoostTimeThreshold = 250;     // millis

// Barometer - sustained velocity of 100 m/s over 1 second
static constexpr float baromBoostThresholdMPerS = 100;    // m/s
static constexpr uint32_t baromBoostTimeThreshold = 1000; // millis

enum Events {
    PadReady,
    Unlocked,
    Boost,
    Coast,
    GroundHit,
    InitialInflation,
    NumEvents,
};

inline constexpr std::array<const char *, Events::NumEvents> eventNames = {
    "PadReady",
    "Unlocked",
    "Boost",
    "Coast",
    "InitialInflation"
    "GroundHit",
};
enum Sources {
    // Flight Controlling Sources
    LSM6DSL,
    BMP390,
    BoostTimer,
    GroundHitTimer,
    InflationSubsys,
    NumSources,
};
inline constexpr std::array<const char *, Sources::NumSources> sourceNames = {
    "LSM6DSL", "BMP390", "BoostTimer", "GroundHitTimer", "InflationSubsys",
};

inline constexpr size_t numTimerEvents = 2;
using FreakFlightController = CPhaseController<Events, Events::NumEvents, Sources, Sources::NumSources, 2>;

inline std::array<FreakFlightController::TimerEvent, numTimerEvents> timerEvents = {
    // We only need to measure a lot of data super fast during boost
    // After that, we can chill out until we hit the ground
    FreakFlightController::TimerEvent{
        .start = Events::Boost,
        .event = Events::Coast,
        .time = K_SECONDS(3),
        .source = Sources::BoostTimer,
    },
    FreakFlightController::TimerEvent{
        .start = Events::Boost,
        .event = Events::GroundHit,
        .time = K_SECONDS(5), // 400
        .source = Sources::GroundHitTimer,
    },
};

inline constexpr std::array<FreakFlightController::DecisionFunc, Events::NumEvents> decisionFuncs = [] {
    std::array<FreakFlightController::DecisionFunc, Events::NumEvents> arr = {nullptr};

    arr[Events::PadReady] = [](FreakFlightController::SourceStates states) -> bool {
        return states[Sources::BMP390] && states[Sources::LSM6DSL];
    };

    arr[Events::Boost] = [](FreakFlightController::SourceStates states) -> bool {
        return (states[Sources::LSM6DSL] || states[Sources::BMP390]);
    };

    arr[Events::Coast] = [](FreakFlightController::SourceStates states) -> bool { return states[Sources::BoostTimer]; };

    arr[Events::GroundHit] = [](FreakFlightController::SourceStates states) -> bool {
        return states[Sources::GroundHitTimer];
    };
    arr[Events::InitialInflation] = [](FreakFlightController::SourceStates states) -> bool {
        return states[Sources::InflationSubsys];
    };
    return arr;
}();

#endif
```

## src/flipping.cpp
```c
#include "flipping.h"

#include "5v_ctrl.h"
#include "common.h"

#include <algorithm>
#include <array>
#include <cmath>
#include <cstdint>
#include <zephyr/device.h>
#include <zephyr/drivers/pwm.h>
#include <zephyr/drivers/sensor.h>
#include <zephyr/logging/log.h>
#include <zephyr/shell/shell.h>

LOG_MODULE_REGISTER(flipping);

struct ServoState {
    uint32_t last_ticks;
};
struct Servo {
    struct pwm_dt_spec pwm;
    uint32_t open_pulselen;
    uint32_t closed_pulselen;
    ServoState &state;

    int disconnect() const { return pwm_set_pulse_dt(&pwm, 0); }
    int open() const { return set_pulse(open_pulselen); }
    int close() const { return set_pulse(closed_pulselen); }
    int set_pulse(uint32_t pulse) const {
        state.last_ticks = pulse;
        return pwm_set_pulse_dt(&pwm, pulse);
    }

    bool was_fully_open() const { return state.last_ticks == open_pulselen; }
    bool was_fully_closed() const { return state.last_ticks == closed_pulselen; }
};

enum PayloadFace : uint8_t {
    Face1 = 0,
    Face2 = 1,
    Face3 = 2,
    Upright = 3,
    StandingUp = 4,
    OnItsHead = 5,
    NumFaces = 6,
    UnknownFace = 7,
};

const char *string_face(PayloadFace p);
struct FaceAndId {
    PayloadFace id;
    NTypes::AccelerometerData direction;
};

float dot(const NTypes::AccelerometerData &a, const NTypes::AccelerometerData &b) {
    return a.X * b.X + a.Y * b.Y + a.Z * b.Z;
}

const char *string_face(PayloadFace p) {
    switch (p) {
        case PayloadFace::Face1:
            return "Face1";
        case PayloadFace::Face2:
            return "Face2";
        case PayloadFace::Face3:
            return "Face3";
        case PayloadFace::Upright:
            return "Upright";
        case PayloadFace::OnItsHead:
            return "On its head";
        case PayloadFace::StandingUp:
            return "StandingUp";
        default:
            return "Unknown side";
    }
    return "Unknown side";
}

// clang-format off
inline constexpr std::array<FaceAndId, PayloadFace::NumFaces> payload_faces = {
    FaceAndId{Face1, {1, 0, 0}}, 
    FaceAndId{Face2, {0, 1, 0}}, 
    FaceAndId{Face3, {-1, 0, 0}}, 
    FaceAndId{Upright, {0, -1, 0}},  
    FaceAndId{StandingUp, {0, 0, -1}}, 
    FaceAndId{OnItsHead, {0, 0, 1}},
};
// clang-format on

PayloadFace find_orientation(const NTypes::AccelerometerData &me, size_t face_index = 0) {
    struct FaceAndSimilarity {
        PayloadFace id;
        float similarity;
    };
    std::array<FaceAndSimilarity, PayloadFace::NumFaces> sims = {};
    for (int i = 0; i < PayloadFace::NumFaces; i++) {
        sims[i].id = payload_faces[i].id;
        sims[i].similarity = dot(me, payload_faces[i].direction);
    }
    std::sort(sims.begin(), sims.end(),
              [](const FaceAndSimilarity &a, const FaceAndSimilarity &b) { return a.similarity > b.similarity; });

    for (auto s : sims) {
        LOG_INF("%11s: %f", string_face(s.id), (double) s.similarity);
    }
    return sims[face_index].id;
}

static constexpr uint32_t min_pulse = PWM_USEC(800);  //DT_PROP(DT_PARENT(DT_A LIAS(servo1)), min_pulse);
static constexpr uint32_t max_pulse = PWM_USEC(1700); //DT_PROP(DT_PARENT(DT_ALIAS(servo1)), max_pulse);

// false when closed, true when open
ServoState state1{};
ServoState state2{};
ServoState state3{};

static constexpr Servo Servo1{
    .pwm = PWM_DT_SPEC_GET(DT_ALIAS(servo1)),
    .open_pulselen = PWM_USEC(930),
    .closed_pulselen = PWM_USEC(2010),
    .state = state1,
};
static constexpr Servo Servo2{
    .pwm = PWM_DT_SPEC_GET(DT_ALIAS(servo2)),
    .open_pulselen = PWM_USEC(1900),
    .closed_pulselen = PWM_USEC(985),
    .state = state2,
};
static constexpr Servo Servo3{
    .pwm = PWM_DT_SPEC_GET(DT_ALIAS(servo3)),
    .open_pulselen = PWM_USEC(1940),
    .closed_pulselen = PWM_USEC(800),
    .state = state3,
};

const Servo *servos[] = {&Servo1, &Servo2, &Servo3};

int init_flip_hw() {
    rail_item_disable(FiveVoltItem::Pump);
    rail_item_disable(FiveVoltItem::Servos);

    return 0;
}

int get_normed_orientation(const struct device *imu_dev, NTypes::AccelerometerData &vec) {

    int ret = sensor_sample_fetch(imu_dev);
    if (ret < 0) {
        printk("Failed to fetch imu: %d\n", ret);
        return ret;
    }
    struct sensor_value xyz[3] = {0};
    ret = sensor_channel_get(imu_dev, SENSOR_CHAN_ACCEL_XYZ, &xyz[0]);
    if (ret < 0) {
        LOG_WRN("Failed to get imu: %d\n", ret);
        return ret;
    }
    vec = {sensor_value_to_float(&xyz[0]), sensor_value_to_float(&xyz[1]), sensor_value_to_float(&xyz[2])};
    float norm = sqrt(vec.X * vec.X + vec.Y * vec.Y + vec.Z * vec.Z);
    vec.X /= norm;
    vec.Y /= norm;
    vec.Z /= norm;

    return 0;
}

// Best outcome
#define FLIPPED_AND_RIGHTED 0
// Ok, but need to put in some more work
#define FLIPPED_BUT_NOT_RIGHTED 1

enum SweepStrategy {
    Slow,
    Fast,
};

struct Shunt {
    float current;
    float voltage;
};

constexpr int servo_steps = 120;
Shunt current_log[120] = {};

int flip_one_side(const struct device *ina_dev, const Servo &servo, SweepStrategy strat, float &current_before,
                  float &voltage_before) {

    uint32_t start = servo.closed_pulselen;
    uint32_t end = servo.open_pulselen;
    if (servo.state.last_ticks == servo.open_pulselen) {
        start = servo.open_pulselen;
        end = servo.closed_pulselen;
    };

    int delta = end - start;
    LOG_INF("Moving %d to %d", start, end);
    for (int i = 0; i < servo_steps; i++) {
        float current = 0;
        float voltage = 0;
        int ret = read_ina(ina_dev, current, voltage);
        current_log[i].current = current;
        current_log[i].voltage = voltage;

        int pulse = start + delta * i / servo_steps;

        ret = servo.set_pulse(pulse);
        if (ret < 0) {
            printk("Error %d: failed to set pulse width\n", ret);
        }
        k_msleep(5);
    }
    // LOG_INF("Current, Voltage\n");
    // for (int i = 0; i < servo_steps; i++) {
    // LOG_INF("%.4f, %.4f\n", (double) current_log[i].current, (double) current_log[i].voltage);
    // }
    int ret = servo.set_pulse(end);
    if (ret < 0) {
        LOG_WRN("Error %d: failed to set pulse width\n", ret);
    }
    k_msleep(100);
    ret = servo.disconnect();
    if (ret < 0) {
        LOG_WRN("Error %d: failed to disable servo\n", ret);
        return ret;
    }
    return 0;
}

int try_flipping(const struct device *imu_dev, const struct device *ina_dev, int attempts) {
    rail_item_enable(FiveVoltItem::Servos);
    int ret = set_lsm_sampling(imu_dev, 12); // dont need all that speed here
    if (ret < 0) {
        LOG_WRN("Couldn't set sampling");
    }

    NTypes::AccelerometerData vec = {0};
    PayloadFace last_face = PayloadFace::UnknownFace;
    int attempts_on_this_face = 0;

    for (int i = 0; i < attempts; i++) {
        k_msleep(2000); // just in case we're still wobbling around

        int ret = get_normed_orientation(imu_dev, vec);
        if (ret != 0) {
            LOG_WRN("Couldnt read IMU, trying again: %d", ret);
            continue;
        }

        PayloadFace face = find_orientation(vec);
        LOG_INF("Am on face %s", string_face(face));
        if (face == last_face) {
            attempts_on_this_face++;
            LOG_INF("Haven't moved %d times", attempts_on_this_face);
        } else {
            attempts_on_this_face = 0;
        }
        last_face = face;

        if (face == PayloadFace::OnItsHead || face == PayloadFace::StandingUp) {
            LOG_WRN("Oh its so over");
            continue;
        } else if (face == PayloadFace::Upright) {
            LOG_INF("All good");
            rail_item_disable(FiveVoltItem::Servos);
            return FLIPPED_AND_RIGHTED;
        }

        float current_before = 0;
        float voltage_before = 0;
        if (face == PayloadFace::Face1) {
            ret = flip_one_side(ina_dev, Servo1, Slow, current_before, voltage_before);
        } else if (face == PayloadFace::Face1) {
            ret = flip_one_side(ina_dev, Servo2, Slow, current_before, voltage_before);
        } else if (face == PayloadFace::Face1) {
            ret = flip_one_side(ina_dev, Servo3, Slow, current_before, voltage_before);
        }
        if (ret != 0) {
            LOG_WRN("Error sweeping servo: %d", ret);
        }
        if (ret < 0) {
            LOG_WRN("Failed to send slowdata");
        }
        LOG_INF("Iteration %d complete", i);
    }
    rail_item_disable(FiveVoltItem::Servos);
    return FLIPPED_BUT_NOT_RIGHTED;
}

int do_flipping_and_pumping(const struct device *imu_dev, const struct device *barom_dev,
                            const struct device *ina_servo, const struct device *ina_pump) {

    // Initial flipping
    int ret = try_flipping(imu_dev, ina_servo, 10);
    if (ret != FLIPPED_AND_RIGHTED) {
        LOG_INF("Bad news, we'll worry about this later");
    }
    LOG_INF("Low Power");
    set_lsm_sampling(imu_dev, 1);
    while (true) {
        k_msleep(1000);
    }

    return -ENOTSUP;
}

int cmd_zeroall(const struct shell *shell, size_t argc, char **argv) {
    rail_item_enable(FiveVoltItem::Servos);
    shell_print(shell, "Closing 1");
    Servo1.close();
    k_msleep(1000);
    Servo1.disconnect();
    shell_print(shell, "Closing 2");
    Servo2.close();
    k_msleep(1000);
    Servo2.disconnect();
    shell_print(shell, "Closing 3");
    Servo3.close();
    k_msleep(1000);
    Servo3.disconnect();
    rail_item_disable(FiveVoltItem::Servos);
    return 0;
}

const struct device *imu_dev = DEVICE_DT_GET(DT_ALIAS(imu));
const struct device *barom_dev = DEVICE_DT_GET(DT_ALIAS(barom));

const struct device *ina_dev = DEVICE_DT_GET(DT_ALIAS(inaservo));

int cmd_open(const struct shell *shell, size_t argc, char **argv) {
    if (argc != 2) {
        shell_error(shell, "SPecify which serv 1-3");
        return -1;
    }
    int servo = atoi(argv[1]);
    if (servo < 1 || servo > 3) {
        shell_error(shell, "Bad servo arg");
        return -1;
    }

    rail_item_enable(FiveVoltItem::Servos);
    shell_print(shell, "Opening %d", servo);
    float c, v;
    flip_one_side(ina_dev, *servos[servo - 1], SweepStrategy::Fast, v, c);
    // servos[servo - 1]->open();
    k_msleep(1000);
    servos[servo - 1]->disconnect();
    rail_item_disable(FiveVoltItem::Servos);
    return 0;
}

int cmd_close(const struct shell *shell, size_t argc, char **argv) {
    if (argc != 2) {
        shell_error(shell, "SPecify which serv 1-3");
        return -1;
    }
    int servo = atoi(argv[1]);
    if (servo < 1 || servo > 3) {
        shell_error(shell, "Bad servo arg");
        return -1;
    }

    rail_item_enable(FiveVoltItem::Servos);
    shell_print(shell, "Opening %d", servo);
    servos[servo - 1]->close();
    k_msleep(1000);
    servos[servo - 1]->disconnect();
    rail_item_disable(FiveVoltItem::Servos);
    return 0;
}

SHELL_STATIC_SUBCMD_SET_CREATE(servo_subcmds, SHELL_CMD(zero, NULL, "Zero all servos", cmd_zeroall),
                               SHELL_CMD(open, NULL, "Open servo", cmd_open),
                               SHELL_CMD(close, NULL, "Clos servo", cmd_close), SHELL_SUBCMD_SET_END);

SHELL_CMD_REGISTER(servo, &servo_subcmds, "Servo Commands", NULL);
```

## src/flipping.h
```c
int init_flip_hw();

int do_flipping_and_pumping(const struct device *imu_dev, const struct device *barom_dev,
                            const struct device *ina_servo, const struct device *ina_pump);
```

## src/pump.c
```c
#include "pump.h"
int attempt_inflation_iteration(const struct device *ina_pump) { return 0; }
```

## src/pump.h
```c
#include <zephyr/device.h>
#define PUMP_DUTY_ON_MS  10000
#define PUMP_DUTY_OFF_MS 20000

int attempt_inflation_iteration(const struct device *ina_pump);
```
