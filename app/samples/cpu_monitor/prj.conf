## CMakeLists.txt
```
cmake_minimum_required(VERSION 3.20.0)
find_package(Zephyr REQUIRED HINTS $ENV{ZEPHYR_BASE})

project(cpu-monitor LANGUAGES C CXX)

FILE(GLOB sources src/*.c src/*.cpp)
target_sources(app PRIVATE ${sources})
```

## sample.yaml
```
sample:
  description: Sample application monitoring CPU utilization, uptime and die temperature
  name: cpu-monitor
common:
  build_only: true
  platform_allow:
    - native_sim
    - nucleo_f446re
tests:
  samples.cpu_monitor.default: {}
```

## prj.conf
```kconfig
# Copyright (c) 2025 RIT Launch Initiative
# SPDX-License-Identifier: Apache-2.0

# CPP
CONFIG_CPP=y
CONFIG_REQUIRES_FULL_LIBCPP=y
CONFIG_STD_CPP20=y

CONFIG_F_CORE=y
CONFIG_F_CORE_OS=y
CONFIG_F_CORE_CPU_MONITOR=y

CONFIG_MAIN_STACK_SIZE=2048
CONFIG_LOG=y
```

## boards/nucleo_f446re.overlay
```dts
/ {
	aliases {
		die-temp = &die_temp;
	};
};

&die_temp {
	status = "okay";
};

&adc1 {
	pinctrl-0 = <&adc1_in0_pa0>;
	pinctrl-names = "default";
	st,adc-prescaler = <4>;
	status = "okay";
};
```

## src/main.cpp
```c
#include <f_core/messaging/c_msgq_message_port.h>
#include <f_core/os/tenants/c_cpu_monitor_tenant.h>
#include <zephyr/kernel.h>

K_MSGQ_DEFINE(cpuMonitorQueue, sizeof(CpuMonitorData), 1, 4);

int main() {
    static auto cpuMonitorMsgQueue = CMsgqMessagePort<CpuMonitorData>(cpuMonitorQueue);
    static CCpuMonitorTenant cpuMonitorTenant(cpuMonitorMsgQueue);

    cpuMonitorTenant.Startup();

    while (true) {
        CpuMonitorData cpuMonitorData{};

        // Busy wait for a bit so there is some utilization to report
        k_busy_wait(250000);
        k_msleep(750);

        cpuMonitorTenant.Run();
        cpuMonitorMsgQueue.Receive(cpuMonitorData, K_FOREVER);
        printk("Uptime: %u ms, Utilization: %u%%, Die Temperature: %d C\n", cpuMonitorData.Uptime,
               cpuMonitorData.Utilization, cpuMonitorData.DieTemperature);
    }

    return 0;
}
```
