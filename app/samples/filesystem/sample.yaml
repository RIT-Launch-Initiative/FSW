## app/samples/filesystem/sample.yaml
```yaml
sample:
  description:
  name: filesystem
common:
  build_only: true
  platform_allow:
    - native_sim
tests:
  samples.soft_timer.default: {}
```

## app/samples/littlefs/sample.yaml
```yaml
sample:
  description:
  name: littlefs
common:
  build_only: true
  platform_allow:
    - nucleo_f446re
tests:
  littlefs.default: {}
```

## app/samples/sensor/sample.yaml
```yaml
sample:
  description:
  name: sensor
common:
  build_only: true
  platform_allow:
    - nucleo_f446re
tests:
  samples.sensors.default:
    extra_args: SHIELD="launch_mikroe"
```

## app/tests/f_core/gnss_utils/testcase.yaml
```yaml
common:
  tags:
    - f_core
    - utilities
    - gnss
tests:
  f_core.gnss_utils:
    type: unit
```

## app/tests/f_core/golay/testcase.yaml
```yaml
common:
  tags:
    - f_core
    - radio
    - protocols
    - golay
tests:
  f_core.golay:
    type: unit
```

## app_potato/boards/arm/potato/potato_defconfig
```kconfig
# CONFIG_NET_IPV6 is not set

# System
CONFIG_CLOCK_CONTROL=y
CONFIG_PINCTRL=y
CONFIG_GPIO=y
CONFIG_SOC_SERIES_STM32F4X=y
CONFIG_SOC_STM32F446XX=y
CONFIG_ARM_MPU=y
CONFIG_HW_STACK_PROTECTION=y
```

## app_power_module/boards/arm/power_module/power_module_defconfig
```kconfig
# SPDX-License-Identifier: Apache-2.0

CONFIG_SOC_SERIES_STM32F4X=y
CONFIG_SOC_STM32F446XX=y

# Enable MPU
CONFIG_ARM_MPU=y

# Enable HW stack protection
CONFIG_HW_STACK_PROTECTION=y

# enable pin controller
CONFIG_PINCTRL=y

# Clocks
CONFIG_CLOCK_CONTROL=y

# GPIO
CONFIG_GPIO=y
CONFIG_LED=y

# IO
CONFIG_GPIO=y

CONFIG_SPI=y
CONFIG_SPI_ASYNC=y
#CONFIG_SPI_RTIO=y

CONFIG_I2C=y
CONFIG_I2C_CALLBACK=y
#CONFIG_I2C_RTIO=y

CONFIG_SENSOR_ASYNC_API=y
CONFIG_SENSOR=y

# Random
CONFIG_TEST_RANDOM_GENERATOR=y
```

## app_radio_module/boards/arm/radio_module/Kconfig.defconfig
```kconfig
if BOARD_RADIO_MODULE

config BOARD
	default "radio_module"

config SPI_STM32_INTERRUPT
	default y
	depends on SPI

endif # BOARD_RADIO_MODULE
```

## app_radio_module/boards/arm/radio_module/radio_module_defconfig
```kconfig
# SPDX-License-Identifier: Apache-2.0

CONFIG_SOC_SERIES_STM32F4X=y
CONFIG_SOC_STM32F446XX=y

# Enable MPU
CONFIG_ARM_MPU=y

# Enable HW stack protection
CONFIG_HW_STACK_PROTECTION=y

CONFIG_SERIAL=y

# console
CONFIG_CONSOLE=y
CONFIG_UART_CONSOLE=y
CONFIG_CBPRINTF_FP_SUPPORT=y

# enable GPIO
CONFIG_GPIO=y

# Enable Clocks
CONFIG_CLOCK_CONTROL=y

# Threads (ubxlib fails without this)
CONFIG_DEBUG_THREAD_INFO=y
CONFIG_INIT_STACKS=y
CONFIG_THREAD_STACK_INFO=y
CONFIG_THREAD_NAME=y
CONFIG_KERNEL_MEM_POOL=y

# Heap (ubxlib fails without this)
CONFIG_HEAP_MEM_POOL_SIZE=1

# enable pin controller
CONFIG_PINCTRL=y
CONFIG_LED=y

# I2C
CONFIG_I2C=y
#CONFIG_I2C_CALLBACK=y

# SPI
CONFIG_SPI=y
# CONFIG_SPI_RTIO=y


# GNSS (MAX-M10S)
CONFIG_UBXLIB=y
CONFIG_GNSS=y
CONFIG_GNSS_SATELLITES=y
CONFIG_GNSS_NMEA0183=y

# LORA
CONFIG_LORA=y
CONFIG_LORA_SX127X=y
CONFIG_LORA_LOG_LEVEL_DBG=y

# Networking
CONFIG_NET_L2_ETHERNET=y
CONFIG_NETWORKING=y
CONFIG_NET_L2_ETHERNET_MGMT=y
CONFIG_NET_IPV4=y
CONFIG_NET_STATISTICS=y
CONFIG_SHELL=y
CONFIG_PTP_CLOCK=y


# Non-Volatile Memory
CONFIG_FLASH=y

# RNG
CONFIG_ENTROPY_GENERATOR=y
CONFIG_TEST_RANDOM_GENERATOR=y
```

## boards/arm/blt_plane/Kconfig.blt_plane
```kconfig
# SPDX-License-Identifier: Apache-2.0

config BOARD_BLT_PLANE
	select SOC_STM32F446XX
```

## boards/arm/blt_plane/Kconfig.defconfig
```kconfig
if BOARD_BLT_PLANE

config SPI_STM32_INTERRUPT
	default y
	depends on SPI

endif # BOARD_BLT_PLANE
```

## boards/arm/blt_plane/board.yml
```yaml
board:
  name: blt_plane
  full_name: BLTPlane
  vendor: launch
  socs:
    - name: stm32f446xx
```

## boards/arm/control_freak/Kconfig.control_freak
```kconfig
# SPDX-License-Identifier: Apache-2.0

config BOARD_CONTROL_FREAK
	select SOC_STM32F446XX
```

## boards/arm/control_freak/Kconfig.defconfig
```kconfig
if BOARD_CONTROL_FREAK

config SPI_STM32_INTERRUPT
	default y
	depends on SPI

endif # BOARD_CONTROL_FREAK
```

## boards/arm/control_freak/board.yml
```yaml
board:
  name: control_freak
  full_name: Control Freak
  vendor: launch
  socs:
    - name: stm32f446xx
```

## boards/arm/control_freak/control_freak_defconfig
```kconfig
# Copyright (c) 2024 RIT Launch Initiative
# SPDX-License-Identifier: Apache-2.0

# System
CONFIG_CLOCK_CONTROL=y
CONFIG_ARM_MPU=y
CONFIG_HW_STACK_PROTECTION=y

# IO
CONFIG_GPIO=y
CONFIG_PINCTRL=y
CONFIG_SERIAL=y
CONFIG_SPI=y
CONFIG_SPI_ASYNC=y
CONFIG_LED=y
```

## boards/arm/controls_module/Kconfig.controls_module
```kconfig
# SPDX-License-Identifier: Apache-2.0

config BOARD_CONTROLS_MODULE
	select SOC_STM32F446XX
```

## boards/arm/controls_module/Kconfig.defconfig
```kconfig
if BOARD_CONTROLS_MODULE

config SPI_STM32_INTERRUPT
	default y
	depends on SPI

endif # BOARD_CONTROLS_MODULE
```

## boards/arm/controls_module/board.yml
```yaml
board:
  name: controls_module
  full_name: Controls Module
  vendor: launch
  socs:
    - name: stm32f446xx
```

## boards/arm/crashout/Kconfig.crashout
```kconfig
# SPDX-License-Identifier: Apache-2.0
config BOARD_CRASHOUT
	select SOC_STM32F103X8
```

## boards/arm/crashout/board.yml
```yaml
board:
  name: crashout
  full_name: CRASHOUT
  vendor: Launch Initiative
  socs:
    - name: stm32f103xb #lying voice. this is just to make west happy. memory map and peripherals are x8
```

## boards/arm/crashout/crashout_defconfig
```kconfig
# SPDX-License-Identifier: Apache-2.0

# enable uart driver
CONFIG_SERIAL=y
# enable console
CONFIG_CONSOLE=y
CONFIG_UART_CONSOLE=y

# enable GPIO
CONFIG_GPIO=y


CONFIG_SENSOR_ASYNC_API=n
CONFIG_SENSOR=y

CONFIG_QDEC_STM32=y
CONFIG_PWM=y
CONFIG_I2C=y
```

## boards/arm/deployment_module/Kconfig.defconfig
```kconfig
if BOARD_DEPLOYMENT_MODULE

config SPI_STM32_INTERRUPT
	default y
	depends on SPI

endif # BOARD_DEPLOYMENT_MODULE
```
