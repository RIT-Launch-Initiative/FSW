## CMakeLists.txt
```
cmake_minimum_required(VERSION 3.13.1)
find_package(Zephyr REQUIRED HINTS $ENV{ZEPHYR_BASE})

project(gpio-blinky LANGUAGES C CXX)

FILE(GLOB sources src/*.c src/*.cpp)
target_sources(app PRIVATE ${sources})
```

## sample.yaml
```
sample:
  description: gpio-blinky
  name: gpio-blinky
common:
  build_only: true
  platform_allow:
    - nucleo_f446re
tests:
  samples.gpio_blinky.default: {}
```

## prj.conf
```kconfig
# Copyright (c) 2024 RIT Launch Initiative
# SPDX-License-Identifier: Apache-2.0

# CPP
CONFIG_CPP=y
CONFIG_REQUIRES_FULL_LIBCPP=y
CONFIG_STD_CPP20=y

CONFIG_F_CORE=y
CONFIG_F_CORE_DEVICE=y

# OS
CONFIG_POLL=y
CONFIG_MAIN_STACK_SIZE=1024
CONFIG_STACK_USAGE=y

CONFIG_TIMESLICING=y
CONFIG_TIMESLICE_SIZE=20
CONFIG_TIMESLICE_PRIORITY=0
CONFIG_THREAD_STACK_INFO=y

CONFIG_SHELL=y
CONFIG_LOG=y
```

## src/main.cpp
```c
/*
* Copyright (c) 2024 RIT Launch Initiative
 *
 * SPDX-License-Identifier: Apache-2.0
 */
#include <f_core/device/c_gpio.h>
#include <f_core/os/n_rtos.h>
#include <zephyr/kernel.h>
#include <zephyr/logging/log.h>

LOG_MODULE_REGISTER(main);

int main() {
    gpio_dt_spec ledPin = GPIO_DT_SPEC_GET(DT_ALIAS(led0), gpios);
    CGpio led(ledPin);

    while (true) {
        led.SetPin(1);
        k_msleep(1000);
        led.SetPin(0);
        k_msleep(1000);
    }

    return 0;
}
```
