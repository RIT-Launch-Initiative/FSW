## CMakeLists.txt
```
cmake_minimum_required(VERSION 3.13.1)
find_package(Zephyr REQUIRED HINTS $ENV{ZEPHYR_BASE})

project(lock-guard LANGUAGES C CXX)

FILE(GLOB sources src/*.c src/*.cpp)
target_include_directories(app PRIVATE include)
target_sources(app PRIVATE ${sources})
```

## sample.yaml
```
sample:
  description:
  name: lock-guard
common:
  build_only: true
  platform_allow:
    - native_sim
tests:
  samples.tenants_and_taks.default: {}
```

## prj.conf
```kconfig
# Copyright (c) 2024 RIT Launch Initiative
# SPDX-License-Identifier: Apache-2.0

# CPP
CONFIG_CPP=y
CONFIG_REQUIRES_FULL_LIBCPP=y
CONFIG_STD_CPP20=y

CONFIG_F_CORE=y
CONFIG_F_CORE_OS=y

# OS
CONFIG_POLL=y
CONFIG_MAIN_STACK_SIZE=1024
CONFIG_STACK_USAGE=y

CONFIG_TIMESLICING=y
CONFIG_TIMESLICE_SIZE=1
CONFIG_TIMESLICE_PRIORITY=0
CONFIG_THREAD_STACK_INFO=y

CONFIG_DYNAMIC_THREAD=y
# Max stack size for dynamic threads
CONFIG_DYNAMIC_THREAD_STACK_SIZE=512
# Number of threads in the dynamic thread pool
CONFIG_DYNAMIC_THREAD_POOL_SIZE=3
CONFIG_SHELL=y
CONFIG_LOG=y
```

## src/main.cpp
```c
/*
* Copyright (c) 2025 RIT Launch Initiative
 *
 * SPDX-License-Identifier: Apache-2.0
 */
#include <zephyr/kernel.h>
#include <f_core/os/n_rtos.h>
#include <f_core/os/c_task.h>
#include <f_core/os/c_tenant.h>

#include <zephyr/logging/log.h>

LOG_MODULE_REGISTER(main);

static constexpr int maxCount = 10000;

class CIncrementor : public CTenant {
public:
    CIncrementor(const char *name, int &counter) : CTenant(name), counter(counter) {
    }

    void Run() override {
        counter++;
    }

private:
    static int id;
    int &counter;
    bool finished = false;
};

int main() {
    int counter = 0;
    static CIncrementor incrementerOne("One", counter);
    static CIncrementor incrementerTwo("Two", counter);
    static CIncrementor incrementerThree("Three", counter);

    static CTask taskOne("One", 15, 512, 0);
    static CTask taskTwo("Two", 15, 512, 0);
    static CTask taskThree("Three", 15, 512, 0);

    taskOne.AddTenant(incrementerOne);
    taskTwo.AddTenant(incrementerTwo);
    taskThree.AddTenant(incrementerThree);

    NRtos::AddTask(taskOne);
    NRtos::AddTask(taskTwo);
    NRtos::AddTask(taskThree);

    NRtos::StartRtos();
    k_msleep(5000); // More than enough time to finish counting to a "small" enough number (i.e. 10000)
    NRtos::StopRtos();

    LOG_INF("%d", counter);

    return 0;
}
```
