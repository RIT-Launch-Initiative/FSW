## Kconfig
```
# Copyright (c) 2024 Aaron Chan
# SPDX-License-Identifier: Apache-2.0

menu "Zephyr"
source "Kconfig.zephyr"
endmenu

module = APP
module-str = APP
source "subsys/logging/Kconfig.template.log_config"

menuconfig RECEIVER
	bool "Run receiver code"
	default n
```

## prj.conf
```kconfig
# Copyright (c) 2024 RIT Launch Initiative
# SPDX-License-Identifier: Apache-2.0

# CPP
CONFIG_CPP=y
CONFIG_REQUIRES_FULL_LIBCPP=y
CONFIG_STD_CPP20=y

CONFIG_F_CORE=y

# OS
CONFIG_POLL=y
CONFIG_MAIN_STACK_SIZE=1024
CONFIG_STACK_USAGE=y

CONFIG_TIMESLICING=y
CONFIG_TIMESLICE_SIZE=50000
CONFIG_TIMESLICE_PRIORITY=0
CONFIG_THREAD_STACK_INFO=y

CONFIG_DYNAMIC_THREAD=y
# Max stack size for dynamic threads
CONFIG_DYNAMIC_THREAD_STACK_SIZE=512
# Number of threads in the dynamic thread pool
# (Zephyr wants 4 for some reason instead of 2)
CONFIG_DYNAMIC_THREAD_POOL_SIZE=4
CONFIG_SHELL=y
CONFIG_LOG=y
CONFIG_LORA=y
CONFIG_LORA_SX127X=y
```

## src/main.cpp
```c
/*
* Copyright (c) 2024 RIT Launch Initiative
 *
 * SPDX-License-Identifier: Apache-2.0
 */

// std Includes
#include <string>

// F-Core Includes
#include <f_core/net/device/c_lora.h>

// Zephyr Includes
#include <zephyr/kernel.h>
#include <zephyr/drivers/gpio.h>
#include <zephyr/logging/log.h>
#include <zephyr/drivers/lora.h>

LOG_MODULE_REGISTER(main);


bool sentFinished = true;
bool receiveFinished = true;

int main() {
    static constexpr std::string payload = "Launch!";

    gpio_dt_spec led0 = GPIO_DT_SPEC_GET(DT_ALIAS(led0), gpios);
    const device* dev = DEVICE_DT_GET(DT_ALIAS(lora));
    CLora lora(*dev);

    while (true) {
        gpio_pin_toggle_dt(&led0);

        if (receiveFinished) {
        lora.ReceiveAsynchronous(
            [](const device*, uint8_t* data, uint16_t size, int16_t rssi, int8_t snr) {
                LOG_INF("Async Received: %s\tRSSI: %d\t SNR:%d\n", data, rssi, snr);
                receiveFinished = true;
            }
            );

            receiveFinished = false;
        }

        if (sentFinished) {
            lora.TransmitAsynchronous(payload.c_str(), payload.size(), nullptr);
            LOG_INF("Async Sent: %s\n", payload.c_str());
            sentFinished = false;
        }

        k_sleep(K_SECONDS(1));
    }

    return 0;
}
```
