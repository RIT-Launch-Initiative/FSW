## CMakeLists.txt
```
cmake_minimum_required(VERSION 3.13.1)
find_package(Zephyr REQUIRED HINTS $ENV{ZEPHYR_BASE})

project(lora-back-and-forth LANGUAGES C CXX)

FILE(GLOB sources src/*.c src/*.cpp)
target_include_directories(app PRIVATE include)
target_sources(app PRIVATE ${sources})
```

## Kconfig
```
# Copyright (c) 2024 RIT Launch Initiative
# SPDX-License-Identifier: Apache-2.0

menu "Zephyr"
source "Kconfig.zephyr"
endmenu

module = APP
module-str = APP
source "subsys/logging/Kconfig.template.log_config"

menuconfig RECEIVER
	bool "Run receiver code"
	default n
```

## sample.yaml
```
sample:
  description: lora-back-and-forth
  name: lora-back-and-forth
common:
  build_only: true
  platform_allow:
    - radio_module
tests:
  samples.lora_back_and_forth.default: {}
```

## prj.conf
```kconfig
# Copyright (c) 2024 RIT Launch Initiative
# SPDX-License-Identifier: Apache-2.0

# CPP
CONFIG_CPP=y
CONFIG_REQUIRES_FULL_LIBCPP=y
CONFIG_STD_CPP20=y

CONFIG_F_CORE=y
CONFIG_F_CORE_RADIO=y

# OS
CONFIG_POLL=y
CONFIG_MAIN_STACK_SIZE=1024
CONFIG_STACK_USAGE=y

CONFIG_TIMESLICING=y
CONFIG_TIMESLICE_SIZE=20
CONFIG_TIMESLICE_PRIORITY=0
CONFIG_THREAD_STACK_INFO=y

CONFIG_DYNAMIC_THREAD=y
# Max stack size for dynamic threads
CONFIG_DYNAMIC_THREAD_STACK_SIZE=512
# Number of threads in the dynamic thread pool
# (Zephyr wants 4 for some reason instead of 2)
CONFIG_DYNAMIC_THREAD_POOL_SIZE=4
CONFIG_SHELL=y
CONFIG_LOG=y
CONFIG_LORA=y
CONFIG_LORA_SX127X=y
```

## src/main.cpp
```c
/*
* Copyright (c) 2024 RIT Launch Initiative
 *
 * SPDX-License-Identifier: Apache-2.0
 */

// std Includes
#include <string>

// F-Core Includes
#include <f_core/radio/c_lora.h>

// Zephyr Includes
#include <zephyr/drivers/gpio.h>
#include <zephyr/drivers/lora.h>
#include <zephyr/kernel.h>
#include <zephyr/logging/log.h>

LOG_MODULE_REGISTER(main);

#ifdef CONFIG_RECEIVER
static bool receiveFinished = true;
#endif

int main() {
    CLora lora(*DEVICE_DT_GET(DT_ALIAS(lora)));

    while (true) {
#ifdef CONFIG_RECEIVER
        if (receiveFinished) {
            LOG_INF("Attempting to receive");
            lora.ReceiveAsynchronous([](const device*, uint8_t* data, uint16_t size, int16_t rssi, int8_t snr) {
                LOG_INF("Async Received: %s\tRSSI: %d\t SNR:%d", data, rssi, snr);
                receiveFinished = true;
            });

            receiveFinished = false;
        }
#else
        static constexpr std::string payload = "Launch!";
        lora.TransmitSynchronous(payload.c_str(), payload.size());
        LOG_INF("Sent: %s", payload.c_str());
#endif
        k_msleep(100);
    }

    return 0;
}
```
