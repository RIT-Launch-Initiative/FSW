## CMakeLists.txt
```
cmake_minimum_required(VERSION 3.13.1)
find_package(Zephyr REQUIRED HINTS $ENV{ZEPHYR_BASE})

project(message-passing LANGUAGES C CXX)

FILE(GLOB sources src/*.c src/*.cpp)
target_include_directories(app PRIVATE include)
target_sources(app PRIVATE ${sources})
```

## sample.yaml
```
sample:
  description: message-passing
  name: message-passing
common:
  build_only: true
  platform_allow:
    - native_sim
tests:
  samples.message_passing.default: {}
```

## prj.conf
```kconfig
# Copyright (c) 2024 RIT Launch Initiative
# SPDX-License-Identifier: Apache-2.0

# CPP
CONFIG_CPP=y
CONFIG_REQUIRES_FULL_LIBCPP=y
CONFIG_STD_CPP20=y

CONFIG_F_CORE=y
CONFIG_F_CORE_OS=y

# OS
CONFIG_POLL=y
CONFIG_MAIN_STACK_SIZE=1024
CONFIG_STACK_USAGE=y

CONFIG_TIMESLICING=y
CONFIG_TIMESLICE_SIZE=20
CONFIG_TIMESLICE_PRIORITY=0
CONFIG_THREAD_STACK_INFO=y

CONFIG_DYNAMIC_THREAD=y
# Max stack size for dynamic threads
CONFIG_DYNAMIC_THREAD_STACK_SIZE=512
# Number of threads in the dynamic thread pool
# (Zephyr wants 4 for some reason instead of 2)
CONFIG_DYNAMIC_THREAD_POOL_SIZE=4
CONFIG_SHELL=y
CONFIG_LOG=y
```

## src/main.cpp
```c
/*
* Copyright (c) 2024 RIT Launch Initiative
 *
 * SPDX-License-Identifier: Apache-2.0
 */
#include "c_publisher.h"
#include "c_receiver.h"
#include "message.h"

#include <f_core/messaging/c_msgq_message_port.h>
#include <f_core/os/c_task.h>
#include <f_core/os/n_rtos.h>
#include <zephyr/kernel.h>
#include <zephyr/logging/log.h>

LOG_MODULE_REGISTER(main);

K_MSGQ_DEFINE(messageQueue, sizeof(Message), 10, 4);
K_MSGQ_DEFINE(completedQueue, sizeof(bool), 1, 4);

static void stackAllocatedMessagePortCheck(void) {
    CMsgqMessagePort<int> messagePort(messageQueue);
    messagePort.Send(10, K_FOREVER);
}

int main() {
    stackAllocatedMessagePortCheck();
    static CMsgqMessagePort<Message> messagePort(messageQueue);
    static CMsgqMessagePort<bool> completedPort(completedQueue);

    static CPublisher publisher(messagePort);
    static CTask publisherTask("Publisher Task", 15, 512);
    publisherTask.AddTenant(publisher);

    static CReceiver receiver(messagePort, completedPort, 10);
    static CTask receiverTask("Receiver Task", 15, 512);
    receiverTask.AddTenant(receiver);

    NRtos::AddTask(publisherTask);
    NRtos::AddTask(receiverTask);

    NRtos::StartRtos();

    bool completed = false;
    LOG_INF("Waiting for completion");
    do {
        completedPort.Receive(completed, K_FOREVER);
        if (completed == true) {
            break;
        }

        LOG_WRN("Completed flag not set. Waiting for another message.");
    } while (true);

    NRtos::StopRtos();

    return 0;
}
```

## include/c_publisher.h
```c
#pragma once

#include "message.h"

// F-Core Includes
#include <f_core/messaging/c_message_port.h>
#include <f_core/os/c_runnable_tenant.h>

/**
 * Increments and prints the current count for a given integer.
 */
class CPublisher : public CRunnableTenant {
  public:
    /**
     * Constructor.
     * @param name The name of the tenant.
     * @param count The integer to increment and print.
     */
    explicit CPublisher(CMessagePort<Message> &messagePort);

    /**
     * See parent docs
     */
    void Startup() override;

    /**
     * See parent docs
     */
    void Run() override;

  private:
    using CBase = CRunnableTenant;

    CMessagePort<Message> &messagePort;
    Message message;
};
```

## include/c_receiver.h
```c
#pragma once

#include "message.h"

// F-Core Includes
#include <f_core/messaging/c_message_port.h>
#include <f_core/os/c_runnable_tenant.h>

class CReceiver : public CRunnableTenant {
  public:
    /**
     * Constructor
     * @param messagePort port to receive data from
     * @param completedPort port to receive data from
     * @param messageCountToReceive The number of messages to receive before stopping the RTOS
     */
    explicit CReceiver(CMessagePort<Message> &messagePort, CMessagePort<bool> &completedPort,
                       int messageCountToReceive);

    /**
     * See parent docs
     */
    void Run() override;

  private:
    using CBase = CRunnableTenant;

    CMessagePort<Message> &messagePort;
    CMessagePort<bool> &completedPort;

    int messageCountToReceive;
};
```

## include/message.h
```c
#pragma once

struct Message {
    int count;
    char message[32];
};
```

## src/c_publisher.cpp
```c
#include "c_publisher.h"

#include <zephyr/logging/log.h>

LOG_MODULE_REGISTER(Publisher);

CPublisher::CPublisher(CMessagePort<Message> &messagePort)
    : CRunnableTenant("Publisher"), messagePort(messagePort), message({}) {}

void CPublisher::Startup() {
    CBase::Startup();

    message.count = 0;
    strncpy(message.message, "Hello, World!", sizeof(message.message));
}

void CPublisher::Run() {
    message.count++;
    messagePort.Send(message, K_NO_WAIT);
}
```

## src/c_receiver.cpp
```c
#include "c_receiver.h"

#include <f_core/os/c_runnable_tenant.h>
#include <zephyr/kernel.h>
#include <zephyr/logging/log.h>

LOG_MODULE_REGISTER(Receiver);

CReceiver::CReceiver(CMessagePort<Message>& messagePort, CMessagePort<bool>& completedPort, int messageCountToReceive)
    : CRunnableTenant("Receiver"), messagePort(messagePort), completedPort(completedPort),
      messageCountToReceive(messageCountToReceive) {}

void CReceiver::Run() {
    if (messageCountToReceive == 0) {
        completedPort.Send(true);
        return;
    }

    Message message{};
    messagePort.Receive(message, K_NO_WAIT);
    LOG_INF("%d - %s", message.count, message.message);

    messageCountToReceive--;
}
```
