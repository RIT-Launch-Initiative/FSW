## CMakeLists.txt
```
cmake_minimum_required(VERSION 3.13.1)
find_package(Zephyr REQUIRED HINTS $ENV{ZEPHYR_BASE})

project(sntp-client LANGUAGES C CXX)

FILE(GLOB sources src/*.c src/*.cpp)
target_include_directories(app PRIVATE include)
target_sources(app PRIVATE ${sources})
```

## sample.yaml
```
sample:
  description: sntp-client
  name: sntp-client
common:
  build_only: true
  platform_allow:
    - native_sim
tests:
  samples.sntp_client.default: {}
```

## prj.conf
```kconfig
# Copyright (c) 2024 RIT Launch Initiative
# SPDX-License-Identifier: Apache-2.0

# CPP
CONFIG_CPP=y
CONFIG_REQUIRES_FULL_LIBCPP=y
CONFIG_STD_CPP20=y

CONFIG_F_CORE=y
CONFIG_F_CORE_DEVICE=y
CONFIG_F_CORE_NET=y
CONFIG_F_CORE_OS=y
CONFIG_F_CORE_UTILS=y

# OS
CONFIG_POLL=y
CONFIG_MAIN_STACK_SIZE=4096
CONFIG_STACK_USAGE=y

CONFIG_TIMESLICING=y
CONFIG_TIMESLICE_SIZE=50000
CONFIG_TIMESLICE_PRIORITY=0
CONFIG_THREAD_STACK_INFO=y

CONFIG_DYNAMIC_THREAD=y
# Max stack size for dynamic threads
CONFIG_DYNAMIC_THREAD_STACK_SIZE=512
# Number of threads in the dynamic thread pool
# (Zephyr wants 4 for some reason instead of 2)
CONFIG_DYNAMIC_THREAD_POOL_SIZE=4
CONFIG_SHELL=y
CONFIG_LOG=y

# F-Core
CONFIG_F_CORE=y
CONFIG_F_CORE_NET=y
CONFIG_F_CORE_OS=y

# Networking
CONFIG_NETWORKING=y
CONFIG_NET_NATIVE=y
CONFIG_NET_UDP=y
CONFIG_NET_SOCKETS=y
CONFIG_NET_IPV4=y
CONFIG_NET_L2_ETHERNET=y
CONFIG_NET_MAX_CONN=10
CONFIG_TEST_RANDOM_GENERATOR=y
CONFIG_SNTP=y

# Filesystem
CONFIG_FILE_SYSTEM=y
CONFIG_FILE_SYSTEM_LITTLEFS=y
CONFIG_FS_LITTLEFS_FMP_DEV=y
CONFIG_FLASH=y
CONFIG_FLASH_MAP=y
CONFIG_FLASH_PAGE_LAYOUT=y
```

## src/main.cpp
```c
/*
* Copyright (c) 2025 RIT Launch Initiative
 *
 * SPDX-License-Identifier: Apache-2.0
 */
#include <f_core/device/c_rtc.h>
#include <f_core/utils/n_time_utils.h>
#include <zephyr/logging/log.h>

LOG_MODULE_REGISTER(main, LOG_LEVEL_DBG);

int main() {
    CRtc rtc{*DEVICE_DT_GET(DT_ALIAS(rtc))};
    const char* sntpServerAddr = "10.2.1.1";

    if (NTimeUtils::SntpSynchronize(rtc, sntpServerAddr, 5)) {
        LOG_ERR("Failed to synchronize over SNTP");
    } else {
        LOG_INF("Time synchronized over NTP");
    }

    while (true) {
        rtc_time time{0};
        rtc.GetTime(time);

        LOG_INF("%d-%02d-%02d %02d:%02d:%02d", time.tm_year + 1900, time.tm_mon + 1, time.tm_mday, time.tm_hour,
                time.tm_min, time.tm_sec);
        k_sleep(K_SECONDS(1));
    }

    return 0;
}
```
