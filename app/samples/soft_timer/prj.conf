## CMakeLists.txt
```
cmake_minimum_required(VERSION 3.13.1)
find_package(Zephyr REQUIRED HINTS $ENV{ZEPHYR_BASE})

project(soft-timer LANGUAGES C CXX)

FILE(GLOB sources src/*.c src/*.cpp)
target_sources(app PRIVATE ${sources})
```

## sample.yaml
```
sample:
  description: soft-timer
  name: soft-timer
common:
  build_only: true
  platform_allow:
    - native_sim
tests:
  samples.soft_timer.default: {}
```

## prj.conf
```kconfig
# Copyright (c) 2024 RIT Launch Initiative
# SPDX-License-Identifier: Apache-2.0

# CPP
CONFIG_CPP=y
CONFIG_REQUIRES_FULL_LIBCPP=y
CONFIG_STD_CPP20=y

CONFIG_F_CORE=y
CONFIG_F_CORE_UTILS=y

# OS
CONFIG_POLL=y
CONFIG_MAIN_STACK_SIZE=1024
CONFIG_STACK_USAGE=y

CONFIG_TIMESLICING=y
CONFIG_TIMESLICE_SIZE=20
CONFIG_TIMESLICE_PRIORITY=0
CONFIG_THREAD_STACK_INFO=y

CONFIG_DYNAMIC_THREAD=y
# Max stack size for dynamic threads
CONFIG_DYNAMIC_THREAD_STACK_SIZE=512
# Number of threads in the dynamic thread pool
# (Zephyr wants 4 for some reason instead of 2)
CONFIG_DYNAMIC_THREAD_POOL_SIZE=4
CONFIG_SHELL=y
CONFIG_LOG=y
```

## src/main.cpp
```c
/*
* Copyright (c) 2024 RIT Launch Initiative
 *
 * SPDX-License-Identifier: Apache-2.0
 */
#include <f_core/os/n_rtos.h>
#include <f_core/utils/c_soft_timer.h>
#include <zephyr/kernel.h>
#include <zephyr/logging/log.h>

LOG_MODULE_REGISTER(main);

volatile int interruptCount = 0;

static void timerExpirationFn(k_timer*) {
    LOG_INF("Timer expired");
    interruptCount++;
}

static void timerStopFn(k_timer*) { LOG_INF("Timer stopped"); }

int main() {
    CSoftTimer timer(timerExpirationFn, timerStopFn);

    timer.StartTimer(100);
    LOG_INF("Starting 100ms timer");

    while (interruptCount < 5) {
        k_msleep(80);
        LOG_INF("\tRemaining time: %d ms %d ticks", timer.GetRemainingMillis(), timer.GetRemainingTicks());
    }

    LOG_INF("Setting 100ms timer to 1s");

    timer.StartTimer(1000);
    LOG_INF("Blocking wait for 1s timer");

    timer.BlockUntilExpired();

    LOG_INF("Expired! Tests complete. Stopping timer.");
    // Intentionally don't call StopTimer to test destructor

    return 0;
}
```
