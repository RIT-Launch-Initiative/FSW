## CMakeLists.txt
```
cmake_minimum_required(VERSION 3.13.1)
find_package(Zephyr REQUIRED HINTS $ENV{ZEPHYR_BASE})

project(tenants-and-tasks LANGUAGES C CXX)

FILE(GLOB sources src/*.c src/*.cpp)
target_include_directories(app PRIVATE include)
target_sources(app PRIVATE ${sources})
```

## Kconfig
```
# Copyright (c) 2024 Aaron Chan
# SPDX-License-Identifier: Apache-2.0

menu "Zephyr"
source "Kconfig.zephyr"
endmenu

module = APP
module-str = APP
source "subsys/logging/Kconfig.template.log_config"
```

## sample.yaml
```
sample:
  description: tenants-and-tasks
  name: tenants-and-tasks
common:
  build_only: true
  platform_allow:
    - native_sim
tests:
  samples.tenants_and_taks.default: {}
```

## prj.conf
```kconfig
# Copyright (c) 2024 RIT Launch Initiative
# SPDX-License-Identifier: Apache-2.0

# CPP
CONFIG_CPP=y
CONFIG_REQUIRES_FULL_LIBCPP=y
CONFIG_STD_CPP20=y

CONFIG_F_CORE=y
CONFIG_F_CORE_OS=y

# OS
CONFIG_POLL=y
CONFIG_MAIN_STACK_SIZE=1024
CONFIG_STACK_USAGE=y

CONFIG_TIMESLICING=y
CONFIG_TIMESLICE_SIZE=50000
CONFIG_TIMESLICE_PRIORITY=0
CONFIG_THREAD_STACK_INFO=y

CONFIG_DYNAMIC_THREAD=y
# Max stack size for dynamic threads
CONFIG_DYNAMIC_THREAD_STACK_SIZE=512
# Number of threads in the dynamic thread pool
CONFIG_DYNAMIC_THREAD_POOL_SIZE=2
CONFIG_SHELL=y
CONFIG_LOG=y
```

## src/main.cpp
```c
/*
* Copyright (c) 2024 RIT Launch Initiative
 *
 * SPDX-License-Identifier: Apache-2.0
 */
#include "c_hello_tenant.h"
#include "c_print_count.h"

#include <f_core/os/c_task.h>
#include <f_core/os/n_rtos.h>
#include <zephyr/kernel.h>
#include <zephyr/logging/log.h>

LOG_MODULE_REGISTER(main);

int main() {
    // Tenants and Tasks are expected to be statically allocated, since exiting main will call their destructors
    // Calling the tasks destructors will stop the tasks and free up the allocated stacks
    // This can lead to a double free too if StopRtos is called before main exits
    static CHelloTenant printWorldTenant("World");
    static CHelloTenant printLaunchTenant("Launch");
    static CTask printTask("Print Task", 15, 512, 1000);

    printTask.AddTenant(printWorldTenant);
    printTask.AddTenant(printLaunchTenant);
    NRtos::AddTask(printTask);

    int count = 0;
    static CPrintCount counterTenantOne("Counter 1", &count);
    static CPrintCount counterTenantTwo("Counter 2", &count);
    static CTask counterTask("Counter Task", 15, 512, 80);

    counterTask.AddTenant(counterTenantOne);
    counterTask.AddTenant(counterTenantTwo);
    NRtos::AddTask(counterTask);

    NRtos::StartRtos();
    k_msleep(5000);
    NRtos::StopRtos();

    return 0;
}
```

## include/HelloTenant.h
```c
#ifndef HELLOTENANT_H
#define HELLOTENANT_H

// F-Core Includes
#include <f_core/os/c_tenant.h>

class HelloTenant : public CTenant {
public:
    HelloTenant(const char* name, int priority, int stack_size, uint64_t time_slice);

    void Run() override;
};

#endif //HELLOTENANT_H
```

## include/c_hello_tenant.h
```c
#pragma once

// F-Core Includes
#include <f_core/os/c_runnable_tenant.h>

/**
 * Print "Hello, " followed by a name.
 */
class CHelloTenant : public CRunnableTenant {
  public:
    /**
     * Constructor
     * @param name The name to print after "Hello, ".
     */
    explicit CHelloTenant(const char *name);

    /**
     * See parent docs
     */
    void Run() override;
};
```

## include/c_print_count.h
```c
#pragma once

// F-Core Includes
#include <f_core/os/c_runnable_tenant.h>

/**
 * Increments and prints the current count for a given integer.
 */
class CPrintCount : public CRunnableTenant {
  public:
    /**
     * Constructor.
     * @param name The name of the tenant.
     * @param count The integer to increment and print.
     */
    explicit CPrintCount(const char* name, int* count);

    /**
     * See parent docs
     */
    void Startup() override;

    /**
     * See parent docs
     */
    void Run() override;

  private:
    using CBase = CRunnableTenant;

    int* count;
};
```

## src/c_hello_tenant.cpp
```c
#include "c_hello_tenant.h"

#include <f_core/os/c_runnable_tenant.h>
#include <zephyr/kernel.h>
#include <zephyr/logging/log.h>

LOG_MODULE_REGISTER(CHelloTenant);

CHelloTenant::CHelloTenant(const char* name) : CRunnableTenant(name) {}

void CHelloTenant::Run() { LOG_INF("Hello, %s", name); }
```

## src/c_print_count.cpp
```c
#include "c_print_count.h"

#include <zephyr/logging/log.h>

LOG_MODULE_REGISTER(counter);

CPrintCount::CPrintCount(const char* name, int* count) : CRunnableTenant(name), count(count) {}

void CPrintCount::Startup() {
    CBase::Startup(); // Initialize any parent functionality

    *count = 0;
}

void CPrintCount::Run() {
    *count += 1;
    LOG_INF("%s: %d", name, *count);
}
```
