## CMakeLists.txt
```
cmake_minimum_required(VERSION 3.13.1)
find_package(Zephyr REQUIRED HINTS $ENV{ZEPHYR_BASE})

project(timeslicing LANGUAGES C CXX)

FILE(GLOB sources src/*.c src/*.cpp)
target_sources(app PRIVATE ${sources})
```

## sample.yaml
```
sample:
  description:
  name: timeslicing
common:
  build_only: true
  platform_allow:
    - native_sim
    - nucleo_f446re
tests:
  samples.timeslicing.default: {}
```

## prj.conf
```kconfig
# Copyright (c) 2024 RIT Launch Initiative
# SPDX-License-Identifier: Apache-2.0

# CPP
CONFIG_CPP=y
CONFIG_REQUIRES_FULL_LIBCPP=y
CONFIG_STD_CPP20=y

CONFIG_F_CORE=y
CONFIG_F_CORE_OS=y
CONFIG_F_CORE_UTILS=y

# OS
CONFIG_POLL=y
CONFIG_MAIN_STACK_SIZE=1024
CONFIG_STACK_USAGE=y

CONFIG_TIMESLICING=y
CONFIG_TIMESLICE_SIZE=50000
CONFIG_TIMESLICE_PRIORITY=0
CONFIG_THREAD_STACK_INFO=y

CONFIG_DYNAMIC_THREAD=y
# Max stack size for dynamic threads
CONFIG_DYNAMIC_THREAD_STACK_SIZE=512
# Number of threads in the dynamic thread pool
CONFIG_DYNAMIC_THREAD_POOL_SIZE=5
#CONFIG_NO_OPTIMIZATIONS=y
CONFIG_SHELL=y
CONFIG_LOG=y

CONFIG_THREAD_ANALYZER=y
CONFIG_THREAD_ANALYZER_USE_LOG=y
CONFIG_THREAD_ANALYZER_AUTO=y
CONFIG_THREAD_ANALYZER_AUTO_INTERVAL=3
```

## src/main.cpp
```c
/*
* Copyright (c) 2025 RIT Launch Initiative
 *
 * SPDX-License-Identifier: Apache-2.0
 */
#include <array>
#include <string>
#include <zephyr/kernel.h>
#include <f_core/os/n_rtos.h>
#include <f_core/os/c_tenant.h>
#include <zephyr/logging/log.h>
#include <memory>


LOG_MODULE_REGISTER(main);

static int counter = 0;

class CTimeHogTenant : public CTenant {
public:
    CTimeHogTenant()
        : CTenant(("TimeHogTenant " + std::to_string(counter++)).data()), id(counter) {}

    void Startup() override {};

    void PostStartup() override {};

    void Run() override {
        uint32_t startTime = k_uptime_get_32();
        for (int32_t i = 0; i < max; i++) {
            long long randomMath = max / .1f;
            (void) randomMath;
        }

        LOG_INF("TimeHogTenant %d finished in %d ms", id, k_uptime_get_32() - startTime);
    };

private:
    static constexpr int32_t max = 0x7FFFFFFF;
    const int id;
};


int main() {
    static std::array<std::unique_ptr<CTenant>, 5> hogs;
    static std::array<std::unique_ptr<CTask>, 5> tasks;

    for (int i = 0; i < 5; i++) {
        tasks[i] = std::make_unique<CTask>(("Task " + std::to_string(i)).c_str(), 15, 512, 0);
        hogs[i] = std::make_unique<CTimeHogTenant>();

        hogs[i]->Startup();
        tasks[i]->AddTenant(*hogs[i]);
        tasks[i]->Initialize();
    }

    NRtos::StartRtos();

    return 0;
}
```
