## CMakeLists.txt
```
cmake_minimum_required(VERSION 3.13.1)
find_package(Zephyr REQUIRED HINTS $ENV{ZEPHYR_BASE})

project(udp-bcast LANGUAGES C CXX)

FILE(GLOB sources src/*.c src/*.cpp)
target_include_directories(app PRIVATE include)
target_sources(app PRIVATE ${sources})
```

## sample.yaml
```
sample:
  description: udp-bcast
  name: udp-bcast
common:
  build_only: true
  platform_allow:
    - native_sim
tests:
  samples.udp_bcast.default: {}
```

## prj.conf
```kconfig
# Copyright (c) 2024 RIT Launch Initiative
# SPDX-License-Identifier: Apache-2.0

# CPP
CONFIG_CPP=y
CONFIG_STD_CPP20=y
CONFIG_REQUIRES_FULL_LIBCPP=y

CONFIG_F_CORE=y
CONFIG_F_CORE_NET=y
CONFIG_F_CORE_OS=y

# OS
CONFIG_POLL=y
CONFIG_MAIN_STACK_SIZE=1024
CONFIG_STACK_USAGE=y

CONFIG_TIMESLICING=y
CONFIG_TIMESLICE_SIZE=20
CONFIG_TIMESLICE_PRIORITY=0
CONFIG_THREAD_STACK_INFO=y

CONFIG_LOG=y
CONFIG_NETWORKING=y
CONFIG_NET_NATIVE=y
CONFIG_NET_UDP=y
CONFIG_NET_SOCKETS=y
CONFIG_NET_IPV4=y
CONFIG_NET_L2_ETHERNET=y
CONFIG_NET_MAX_CONN=10
CONFIG_TEST_RANDOM_GENERATOR=y
```

## src/main.cpp
```c
/*
* Copyright (c) 2024 RIT Launch Initiative
 *
 * SPDX-License-Identifier: Apache-2.0
 */

// F-Core Includes
#include <f_core/messaging/c_msgq_message_port.h>
#include <f_core/net/application/c_udp_broadcast_tenant.h>
#include <f_core/net/network/c_ipv4.h>
#include <f_core/net/transport/c_udp_socket.h>

// Zephyr Includes
#include <zephyr/kernel.h>
#include <zephyr/logging/log.h>

LOG_MODULE_REGISTER(main);
static constexpr char broadcastStr[] = "Hello, Launch!";
static constexpr char secondBroadcastStr[] = "Hello, World!";

static constexpr size_t BROADCAST_STRLEN = sizeof(broadcastStr);
static constexpr size_t SECOND_BROADCAST_STRLEN = sizeof(secondBroadcastStr);

K_MSGQ_DEFINE(broadcastQueue, sizeof(const char[BROADCAST_STRLEN]), 10, 4);
K_MSGQ_DEFINE(secondBroadcastQueue, sizeof(const char[SECOND_BROADCAST_STRLEN]), 10, 4);

int main() {
    static constexpr char ipAddrStr[] = "10.0.0.0";
    static constexpr int udpPort = 10000;
    static constexpr int secondBroadcasterSrcPort = 11000;
    static constexpr int secondBroadcasterDstPort = 12001;

    auto messagePort = CMsgqMessagePort<char[BROADCAST_STRLEN]>(broadcastQueue);
    CUdpBroadcastTenant broadcaster("Broadcast Tenant", ipAddrStr, udpPort, udpPort, messagePort);

    auto secondMessagePort = CMsgqMessagePort<char[SECOND_BROADCAST_STRLEN]>(secondBroadcastQueue);
    CUdpBroadcastTenant secondBroadcaster("Second Broadcast Tenant", ipAddrStr, secondBroadcasterSrcPort,
                                          secondBroadcasterDstPort, secondMessagePort);

    while (true) {
        messagePort.Send(broadcastStr, K_NO_WAIT);
        secondMessagePort.Send(secondBroadcastStr, K_NO_WAIT);
        broadcaster.Run();
        secondBroadcaster.Run();

        LOG_INF("Transmitted");
        k_sleep(K_SECONDS(1));
    }

    // The code below is effectively the same

    // CIPv4 ip("10.0.0.0");
    // CUdpSocket udp(ip, 10000, 10000);
    //
    // while (true) {
    //     udp.TransmitSynchronous("Hello, Launch!", 14);
    //     LOG_INF("Transmitted");
    //     k_sleep(K_SECONDS(1));
    // }

    return 0;
}
```
