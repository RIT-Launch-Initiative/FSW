## CMakeLists.txt
```
cmake_minimum_required(VERSION 3.13.1)
find_package(Zephyr REQUIRED HINTS $ENV{ZEPHYR_BASE})

project(udp-rcv LANGUAGES C CXX)

FILE(GLOB sources src/*.c src/*.cpp)
target_include_directories(app PRIVATE include)
target_sources(app PRIVATE ${sources})
```

## Kconfig
```
# Copyright (c) 2024 Launch Initiative
# SPDX-License-Identifier: Apache-2.0

menu "Zephyr"
source "Kconfig.zephyr"
endmenu

module = APP
module-str = APP
source "subsys/logging/Kconfig.template.log_config"
```

## sample.yaml
```
sample:
  description: udp-rcv
  name: udp-rcv
common:
  build_only: true
  platform_allow:
    - native_sim
tests:
  samples.udp_rcv.default: {}
```

## prj.conf
```kconfig
# Copyright (c) 2024 RIT Launch Initiative
# SPDX-License-Identifier: Apache-2.0

# CPP
CONFIG_CPP=y
CONFIG_STD_CPP20=y
CONFIG_REQUIRES_FULL_LIBCPP=y

CONFIG_F_CORE=y
CONFIG_F_CORE_NET=y
CONFIG_F_CORE_OS=y

# OS
CONFIG_POLL=y
CONFIG_MAIN_STACK_SIZE=1024
CONFIG_STACK_USAGE=y

CONFIG_TIMESLICING=y
CONFIG_TIMESLICE_SIZE=50000
CONFIG_TIMESLICE_PRIORITY=0
CONFIG_THREAD_STACK_INFO=y

CONFIG_LOG=y
CONFIG_NETWORKING=y
CONFIG_NET_NATIVE=y
CONFIG_NET_UDP=y
CONFIG_NET_SOCKETS=y
CONFIG_NET_SOCKETS_SERVICE=y
CONFIG_NET_IPV4=y
CONFIG_NET_L2_ETHERNET=y
CONFIG_NET_MAX_CONN=10
CONFIG_TEST_RANDOM_GENERATOR=y
```

## src/main.cpp
```c
/*
* Copyright (c) 2024 RIT Launch Initiative
 *
 * SPDX-License-Identifier: Apache-2.0
 */

// F-Core Includes
#include <f_core/messaging/c_msgq_message_port.h>
#include <f_core/net/network/c_ipv4.h>
#include <f_core/net/transport/c_udp_socket.h>

// Zephyr Includes
#include <zephyr/kernel.h>
#include <zephyr/logging/log.h>

LOG_MODULE_REGISTER(main);

K_MSGQ_DEFINE(receiveQueue, sizeof(const char[32]), 10, 4);

int main() {
    static constexpr char ipAddrStr[] = "10.0.0.0";
    static constexpr int udpPort = 10000;
    static auto messagePort = CMsgqMessagePort<char[32]>(receiveQueue);

    while (true) {
        k_msleep(10000);
    }

    return 0;
}
```
