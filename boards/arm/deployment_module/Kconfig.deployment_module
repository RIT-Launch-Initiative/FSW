## boards/arm/deployment_module/Kconfig.deployment_module
```kconfig
# SPDX-License-Identifier: Apache-2.0

config BOARD_DEPLOYMENT_MODULE
	select SOC_STM32F446XX
```

## boards/arm/deployment_module/board.yml
```yaml
board:
  name: deployment_module
  full_name: Deployment Module
  vendor: launch
  socs:
    - name: stm32f446xx
```

## boards/arm/deployment_module/deployment_module_defconfig
```kconfig
# Copyright (c) 2024 RIT Launch Initiative
# SPDX-License-Identifier: Apache-2.0

# System
CONFIG_CLOCK_CONTROL=y
CONFIG_ARM_MPU=y
CONFIG_HW_STACK_PROTECTION=y
CONFIG_ENTROPY_STM32_RNG=y
CONFIG_ENTROPY_DEVICE_RANDOM_GENERATOR=y

# IO
CONFIG_GPIO=y
CONFIG_PINCTRL=y
CONFIG_RTC=y
CONFIG_SERIAL=y
CONFIG_SPI=y
CONFIG_SPI_STM32_INTERRUPT=y
CONFIG_SPI_ASYNC=y
# CONFIG_SPI_RTIO=y
CONFIG_LED=y
CONFIG_SERIAL=y
CONFIG_UART_INTERRUPT_DRIVEN=y
```

## boards/arm/grim_reefer/Kconfig.defconfig
```kconfig
if BOARD_GRIM_REEFER

config SPI_STM32_INTERRUPT
	default y
	depends on SPI


endif # BOARD_GRIM_REEFER
```

## boards/arm/grim_reefer/board.yml
```yaml
board:
  name: grim_reefer
  full_name: GRIM Reefer
  vendor: launch
  socs:
    - name: stm32f446xx
```

## boards/arm/grim_reefer/grim_reefer_defconfig
```kconfig
# SPDX-License-Identifier: Apache-2.0

CONFIG_SOC_SERIES_STM32F4X=y
CONFIG_SOC_STM32F446XX=y

# Enable MPU
CONFIG_ARM_MPU=y


# Enable HW stack protection
CONFIG_HW_STACK_PROTECTION=y

# enable pin controller
CONFIG_PINCTRL=y

# ADC
CONFIG_ADC=y
CONFIG_ADC_ASYNC=y

# Clocks
CONFIG_CLOCK_CONTROL=y

# Console
CONFIG_CONSOLE=y
CONFIG_UART_CONSOLE=y

# GPIO
CONFIG_GPIO=y
CONFIG_LED=y

# IO
CONFIG_GPIO=y

CONFIG_SERIAL=y

CONFIG_SPI=y
CONFIG_SPI_ASYNC=y

CONFIG_I2C=y
CONFIG_I2C_CALLBACK=y

CONFIG_SENSOR=y

# Random
CONFIG_TEST_RANDOM_GENERATOR=y

# Filesystem
CONFIG_FLASH=y
CONFIG_FLASH_MAP=y
CONFIG_FLASH_PAGE_LAYOUT=y
CONFIG_DISK_ACCESS=y
CONFIG_FILE_SYSTEM=y
CONFIG_FILE_SYSTEM_LITTLEFS=y
CONFIG_FS_LITTLEFS_FMP_DEV=y
```

## boards/arm/l1_board/Kconfig
```kconfig
# Copyright (c) 2025 Launch Initiative
# SPDX-License-Identifier: Apache-2.0

config BOARD_L1_BOARD
	select RP2_FLASH_W25Q080
```

## boards/arm/l1_board/Kconfig.defconfig
```kconfig
# Copyright (c) 2021 Yonatan Schachter
# SPDX-License-Identifier: Apache-2.0

if BOARD_L1_BOARD

if I2C_DW

config I2C_DW_CLOCK_SPEED
	default 125

endif # I2C_DW

config USB_SELF_POWERED
	default n

endif # BOARD_L1_BOARD
```

## boards/arm/l1_board/Kconfig.l1_board
```kconfig
# Copyright (c) 2021 Yonatan Schachter
# SPDX-License-Identifier: Apache-2.0

config BOARD_L1_BOARD
	select SOC_RP2040
```

## boards/arm/l1_board/board.yml
```yaml
board:
  name: l1_board
  full_name: Launch Initiative Hardware Onboarding Test Board
  vendor: launch
  socs:
  - name: rp2040
```

## boards/arm/liquids_module/Kconfig.liquids_module
```kconfig
# SPDX-License-Identifier: Apache-2.0

config BOARD_LIQUIDS_MODULE
	select SOC_STM32F446XX
```

## boards/arm/liquids_module/liquids_module_defconfig
```kconfig
# Copyright (c) 2024 RIT Launch Initiative
# SPDX-License-Identifier: Apache-2.0

# System
CONFIG_CLOCK_CONTROL=y
CONFIG_ARM_MPU=y
CONFIG_HW_STACK_PROTECTION=y

# IO
CONFIG_GPIO=y
CONFIG_PINCTRL=y
CONFIG_RTC=y
CONFIG_SERIAL=y
CONFIG_SPI=y
CONFIG_SPI_ASYNC=y
CONFIG_SPI_STM32_DMA=y
CONFIG_LED=y

CONFIG_USB_DEVICE_STACK_NEXT=y
# USB Serial
CONFIG_CDC_ACM_SERIAL_VID=0x181c
CONFIG_CDC_ACM_SERIAL_PID=0x0005
CONFIG_CDC_ACM_SERIAL_MANUFACTURER_STRING="Launch Initiative"
CONFIG_CDC_ACM_SERIAL_PRODUCT_STRING="Liquids Module"

# USB Serial Console
CONFIG_USBD_CDC_ACM_CLASS=y
CONFIG_CDC_ACM_SERIAL_INITIALIZE_AT_BOOT=y
CONFIG_CONSOLE=y
CONFIG_UART_CONSOLE=y
CONFIG_STDOUT_CONSOLE=y
CONFIG_UART_LINE_CTRL=y
```

## boards/arm/potato/potato_defconfig
```kconfig
# System
CONFIG_CLOCK_CONTROL=y
CONFIG_SOC_SERIES_STM32F4X=y
CONFIG_SOC_STM32F446XX=y
CONFIG_ARM_MPU=y
CONFIG_HW_STACK_PROTECTION=y
```

## boards/arm/power_module/Kconfig.defconfig
```kconfig
if BOARD_POWER_MODULE

config SPI_STM32_INTERRUPT
	default y
	depends on SPI

endif # BOARD_POWER_MODULE
```

## boards/arm/power_module/Kconfig.power_module
```kconfig
# SPDX-License-Identifier: Apache-2.0

config BOARD_POWER_MODULE
	select SOC_STM32F446XX
```

## boards/arm/power_module/board.yml
```yaml
board:
  name: power_module
  full_name: Power Module
  vendor: launch
  socs:
    - name: stm32f446xx
  revision:
    format: number
    default: "2"
    revisions:
      - name: "1"
      - name: "2"
```

## boards/arm/radio_module/Kconfig.radio_module
```kconfig
# SPDX-License-Identifier: Apache-2.0

config BOARD_RADIO_MODULE
	select SOC_STM32F446XX
```

## boards/arm/radio_module/board.yml
```yaml
board:
  name: radio_module
  full_name: Radio Module
  vendor: launch
  socs:
    - name: stm32f446xx
```

## boards/arm/radio_module/radio_module_defconfig
```kconfig
# Copyright (c) 2024 RIT Launch Initiative
# SPDX-License-Identifier: Apache-2.0

# System
CONFIG_CLOCK_CONTROL=y
CONFIG_ARM_MPU=y
CONFIG_FPU=y
CONFIG_HW_STACK_PROTECTION=y

# IO
CONFIG_GPIO=y
CONFIG_I2C=y
#CONFIG_I2C_CALLBACK=y
CONFIG_PINCTRL=y
CONFIG_RTC=y
CONFIG_SERIAL=y
CONFIG_SPI=y
CONFIG_SPI_STM32_DMA=y
# CONFIG_SPI_RTIO=y
CONFIG_LED=y
CONFIG_WATCHDOG=y

# Devices
CONFIG_LORA=y
CONFIG_LORA_SX127X=y
```
