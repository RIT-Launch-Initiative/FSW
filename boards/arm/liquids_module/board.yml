## boards/arm/liquids_module/board.yml
```yaml
board:
  name: liquids_module
  full_name: Liquids Module
  vendor: launch
  socs:
    - name: stm32f446xx
```

## dts/bindings/sensor/maxim,max31856.yaml
```yaml
description: Maxim MAX31856 thermocouple-to-digital converter

compatible: "maxim,max31856"

include: [sensor-device.yaml, spi-device.yaml]

properties:
  thermocouple-type:
    type: int
    required: true
    description: Thermocouple type (3 = Type K)
```
