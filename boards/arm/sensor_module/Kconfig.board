## boards/arm/sensor_module/Kconfig.defconfig
```kconfig
if BOARD_SENSOR_MODULE

config BOARD
	default "sensor_module"

config SPI_STM32_INTERRUPT
	default y
	depends on SPI

endif # BOARD_SENSOR_MODULE
```

## boards/arm/sensor_module/board.yml
```yaml
board:
  name: sensor_module
  full_name: Sensor Module
  vendor: launch
  socs:
    - name: stm32f446xx
```

## boards/arm/sensor_module/sensor_module_defconfig
```kconfig
# Copyright (c) 2024 RIT Launch Initiative
# SPDX-License-Identifier: Apache-2.0

# System
CONFIG_CLOCK_CONTROL=y
CONFIG_ARM_MPU=y
CONFIG_HW_STACK_PROTECTION=y
CONFIG_ENTROPY_STM32_RNG=y
CONFIG_ENTROPY_DEVICE_RANDOM_GENERATOR=y

# IO
CONFIG_GPIO=y
CONFIG_I2C=y
#CONFIG_I2C_CALLBACK=y
#CONFIG_I2C_RTIO=y
CONFIG_PINCTRL=y
CONFIG_RTC=y
CONFIG_SERIAL=y
CONFIG_SPI=y
CONFIG_SPI_ASYNC=y
CONFIG_SPI_STM32_DMA=y
CONFIG_SPI_NOR_SLEEP_WHILE_WAITING_UNTIL_READY=y
# sector erase time typical is 45ms
#CONFIG_SPI_NOR_SLEEP_ERASE_MS=20
#CONFIG_SPI_NOR_SFDP_RUNTIME=y
# CONFIG_SPI_RTIO=y
CONFIG_LED=y
CONFIG_WATCHDOG=y

# Sensors
CONFIG_SENSOR=y
CONFIG_SENSOR_ASYNC_API=y
CONFIG_SENSOR_INFO=y
CONFIG_TMP116=y
CONFIG_BMP388=y
CONFIG_LSM6DSL=y
CONFIG_ADXL375=y
CONFIG_MS5611=y
```

## boards/arm/sw_board/Kconfig.defconfig
```kconfig
if BOARD_SW_BOARD

config SPI_STM32_INTERRUPT
	default y
	depends on SPI

endif # BOARD_SW_BOARD
```

## boards/arm/sw_board/Kconfig.sw_board
```kconfig
# SPDX-License-Identifier: Apache-2.0

config BOARD_SW_BOARD
	select SOC_STM32F446XX
```

## boards/arm/sw_board/board.yml
```yaml
board:
  name: sw_board
  full_name: SW Board
  vendor: launch
  socs:
    - name: stm32f446xx
```

## boards/arm/sw_board/sw_board_defconfig
```kconfig
# Copyright (c) 2025 RIT Launch Initiative
# SPDX-License-Identifier: Apache-2.0

# System
CONFIG_CLOCK_CONTROL=y
CONFIG_ARM_MPU=y
CONFIG_HW_STACK_PROTECTION=y

CONFIG_CLOCK_CONTROL=y

# IO
CONFIG_GPIO=y
CONFIG_PINCTRL=y

CONFIG_LED_STRIP=y

CONFIG_SERIAL=y

CONFIG_I2C=y
CONFIG_I2C_STM32_BUS_RECOVERY=y

CONFIG_SPI=y
CONFIG_SPI_ASYNC=y

# Sensors
CONFIG_MS5607=y
CONFIG_INA219=y

# Quadspi Flash
CONFIG_FLASH_STM32_QSPI=y
CONFIG_USE_MICROCHIP_QSPI_FLASH_WITH_STM32=y
CONFIG_FLASH=y
CONFIG_FLASH_MAP=y
CONFIG_FLASH_PAGE_LAYOUT=y



CONFIG_USB_DEVICE_STACK_NEXT=y
# USB Serial
CONFIG_CDC_ACM_SERIAL_VID=0x181c
CONFIG_CDC_ACM_SERIAL_PID=0x0004
CONFIG_CDC_ACM_SERIAL_MANUFACTURER_STRING="Launch Initiative"
CONFIG_CDC_ACM_SERIAL_PRODUCT_STRING="Software Learning Board"

# USB Serial Console
CONFIG_USBD_CDC_ACM_CLASS=y
CONFIG_CDC_ACM_SERIAL_INITIALIZE_AT_BOOT=y
CONFIG_CONSOLE=y

CONFIG_SERIAL=y
CONFIG_CONSOLE=y
CONFIG_UART_CONSOLE=y
CONFIG_STDOUT_CONSOLE=y
CONFIG_UART_LINE_CTRL=y
```

## boards/shields/launch_mikroe/Kconfig.shield
```kconfig
# Copyright (c) 2023 Launch Initiative
# SPDX-License-Identifier: Apache-2.0

config LAUNCH_MIKROE_CLICK
	def_bool $(shields_list_contains,launch_mikroe)
```

## boards/tdeck/Kconfig
```kconfig
# Copyright (c) 2024 Espressif Systems (Shanghai) Co., Ltd.
# SPDX-License-Identifier: Apache-2.0

config HEAP_MEM_POOL_ADD_SIZE_BOARD
	int
	default 4096 if BOARD_TDECK_PROCPU
	default 256 if BOARD_TDECK_APPCPU
```

## boards/tdeck/Kconfig.tdeck
```kconfig
# Copyright (c) 2024 Espressif Systems (Shanghai) Co., Ltd.
# SPDX-License-Identifier: Apache-2.0

config BOARD_TDECK
	select SOC_ESP32S3_WROOM_N16R8
	select SOC_ESP32S3_PROCPU if BOARD_TDECK_ESP32S3_PROCPU
	select SOC_ESP32S3_APPCPU if BOARD_TDECK_ESP32S3_APPCPU
```

## boards/tdeck/board.yml
```yaml
board:
  name: tdeck
  full_name: TDeck
  vendor: espressif
  socs:
    - name: esp32s3
```

## boards/tdeck/tdeck_esp32s3_appcpu_defconfig
```kconfig
# SPDX-License-Identifier: Apache-2.0

CONFIG_MAIN_STACK_SIZE=2048
CONFIG_CLOCK_CONTROL=y
CONFIG_HEAP_MEM_POOL_SIZE=131072
CONFIG_ST7789V=y
```

## boards/tdeck/tdeck_esp32s3_procpu_defconfig
```kconfig
# SPDX-License-Identifier: Apache-2.0

CONFIG_MAIN_STACK_SIZE=2048
CONFIG_SHELL_STACK_SIZE=8192

CONFIG_CONSOLE=y
CONFIG_SERIAL=y
CONFIG_UART_CONSOLE=y
CONFIG_GPIO=y
CONFIG_CLOCK_CONTROL=y

CONFIG_HEAP_MEM_POOL_SIZE=65536
CONFIG_ST7789V=y
CONFIG_ST7789V_RGB565=y
CONFIG_LV_COLOR_16_SWAP=y

CONFIG_INPUT=y 
CONFIG_INPUT_GT911=y
CONFIG_INPUT_GT911_INTERRUPT=y

CONFIG_AW9364=y
CONFIG_LOG_MODE_IMMEDIATE=y
```

## drivers/Kconfig
```kconfig
# Copyright (c) 2024 Launch Initiative
# SPDX-License-Identifier: Apache-2.0

menu "RIT Launch Drivers"
    rsource "sensor/Kconfig"
    rsource "adc/Kconfig"
endmenu
```

## drivers/adc/Kconfig
```kconfig
# Copyright (c) 2024 Launch Initiative
# SPDX-License-Identifier: Apache-2.0

rsource "mcp356x/Kconfig"
```

## drivers/adc/mcp356x/Kconfig
```kconfig
# Copyright (c) 2021 Nordic Semiconductor ASA
# SPDX-License-Identifier: Apache-2.0

config MCP356X
	bool "Driver for the Microchip MCP356X ADC"
	default n
	depends on DT_HAS_MICROCHIP_MCP356X_ENABLED

	select SPI
	select ADC
	select ADC_CONFIGURABLE_INPUTS
	help
	  Enable MCP3561/MCP3562/MCP3564 ADC. 1, 2, and 4 bit adcs
```

## drivers/fs/gorbfs/Kconfig
```kconfig
menuconfig GORBFS
	bool "Gorbfs file system"
	default n
	select FLASH
	help
		enable gorbfs file system

module = GORBFS
module-str = GORBFS
source "subsys/logging/Kconfig.template.log_config"
```

## drivers/gnss/u_blox_m10/Kconfig
```kconfig
# UBLOX M10 receiver

# Copyright (c) 2024 Launch Initiative
# SPDX-License-Identifier: Apache-2.0

menuconfig U_BLOX_M10
	bool "U_BLOX M10 GNSS"
	default y
	depends on DT_HAS_U_BLOX_M10_ENABLED
	depends on GNSS_REFERENCE_FRAME_WGS84
	select MODEM_MODULES
	select MODEM_BACKEND_UART
	select MODEM_CHAT
	select GNSS_PARSE
	select GNSS_NMEA0183
	select GNSS_NMEA0183_MATCH
	help
	  Enable driver for UBLOX M10 modem.

if U_BLOX_M10

config U_BLOX_M10_SATELLITES_COUNT
	int "Maximum satellite count"
	depends on GNSS_SATELLITES
	default 24
	help
	  Maximum number of satellite that the driver that can be decoded from
	  the GNSS device. This does not affect the number of devices that the
	  device is actually tracking, just how many of those can be reported
	  in the satellites callback.

endif
```

## drivers/input/Kconfig
```kconfig
# Copyright (c) 2025 Nordic Semiconductor ASA
# SPDX-License-Identifier: Apache-2.0

if INPUT
rsource "lilygo_tdeck_keyboard/Kconfig"
endif # INPUT
```

## drivers/input/lilygo_tdeck_keyboard/Kconfig
```kconfig
# Copyright (c) 2025 Launch Initiative
# SPDX-License-Identifier: Apache-2.0

menuconfig TDECK_KEYBOARD
	bool "tdeck keyboard driver"
	default y
	depends on DT_HAS_LILYGO_TDECK_KEYBOARD_ENABLED
	select GPIO
	help
	  Enable driver for lilygo tdeck keyboard
```

## drivers/misc/aw9364/Kconfig
```kconfig
# Copyright (c) 2025 Launch Initiative
# SPDX-License-Identifier: Apache-2.0

menuconfig AW9364
	bool "aw9364 led driver"
	default y
	depends on DT_HAS_AWINIC_AW9364_ENABLED
	select GPIO
	help
	  Enable driver for aw9364 led driver
```
