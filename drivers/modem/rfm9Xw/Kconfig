## drivers/modem/rfm9Xw/Kconfig
```kconfig
# Copyright (c) 2024 Launch Initiative
# SPDX-License-Identifier: Apache-2.0

menuconfig RFM9XW
	bool "RFM9xW modem driver"
	depends on DT_HAS_HOPERF_RFM9XW_ENABLED
	select SPI
	help
	  Enable driver for RFM9xW family of radio modules.
```

## drivers/sensor/Kconfig
```kconfig
# Copyright (c) 2021 Nordic Semiconductor ASA
# SPDX-License-Identifier: Apache-2.0

if SENSOR
rsource "adxl375/Kconfig"
rsource "ms56xx/Kconfig"
rsource "ina260/Kconfig"
rsource "openrocket/Kconfig"
rsource "simshunt/Kconfig"
endif # SENSOR
```

## drivers/sensor/ina260/Kconfig
```kconfig
# Texas Instruments Bidirectional Current/Power Sensor

# Copyright (c) 2024 Richard Sommers
# SPDX-License-Identifier: Apache-2.0

menuconfig INA260
	bool "INA260 Current Power Sensor"
	default y
	depends on DT_HAS_TI_INA260_ENABLED
	select I2C
	help
	  Enable driver for INA260 Bidirectional Current/Power Sensor.
```

## drivers/sensor/mcp3561/Kconfig
```kconfig
# Copyright (c) 2021 Nordic Semiconductor ASA
# SPDX-License-Identifier: Apache-2.0

config MCP3561
	bool "MCP3561 ADC"
	default y
	depends on DT_HAS_MICROCHIP_MCP3561_ENABLED
	select GPIO
	help
	  Enable MCP3561 ADC
```

## drivers/sensor/mcp356x/Kconfig
```kconfig
# Copyright (c) 2021 Nordic Semiconductor ASA
# SPDX-License-Identifier: Apache-2.0

config MCP356X
	bool "MCP356X ADC"
	default y
	depends on DT_HAS_MICROCHIP_MCP356X_ENABLED
	select GPIO
	help
	  Enable MCP356X ADC
```

## drivers/sensor/ms5611/Kconfig
```kconfig
# Copyright (c) 2024, RIT Launch Initiative
# SPDX-License-Identifier: Apache-2.0

config MS5611
	bool "MS5611 Barometer"
	default y
	depends on DT_HAS_MEAS_MS5611_ENABLED
	select I2C
	help
		Enable MS5611 barometer driver.
```

## drivers/sensor/ms56xx/Kconfig
```kconfig
# MS56XX pressure sensor configuration options

# Copyright (c) 2019 Thomas Schmid <tom@lfence.de>
# SPDX-License-Identifier: Apache-2.0

menuconfig MS56XX
	bool "MS5607/MS5611 pressure and temperature sensor"
	default y
	depends on DT_HAS_LAUNCH_MS5611_ENABLED || DT_HAS_LAUNCH_MS5607_ENABLED

	select I2C if $(dt_compat_on_bus,$(DT_COMPAT_LAUNCH_MS5607),i2c) || \
		     	  $(dt_compat_on_bus,$(DT_COMPAT_LAUNCH_MS5611),i2c)
	select SPI if $(dt_compat_on_bus,$(DT_COMPAT_LAUNCH_MS5607),spi) || \
		          $(dt_compat_on_bus,$(DT_COMPAT_LAUNCH_MS5611),spi)
	help
	  Enable driver for the MS5607/MS5611 pressure and temperature sensor.

if MS56XX

choice
	prompt "Pressure oversampling."
	default MS56XX_PRES_OVER_2048X

config MS56XX_PRES_OVER_256X
	bool "x256"

config MS56XX_PRES_OVER_512X
	bool "x512"

config MS56XX_PRES_OVER_1024X
	bool "x1024"

config MS56XX_PRES_OVER_2048X
	bool "x2048"

config MS56XX_PRES_OVER_4096X
	bool "x4096"

endchoice


choice
	prompt "Temperature oversampling."
	default MS56XX_TEMP_OVER_2048X

config MS56XX_TEMP_OVER_256X
	bool "x256"

config MS56XX_TEMP_OVER_512X
	bool "x512"

config MS56XX_TEMP_OVER_1024X
	bool "x1024"

config MS56XX_TEMP_OVER_2048X
	bool "x2048"

config MS56XX_TEMP_OVER_4096X
	bool "x4096"

endchoice

endif # MS56XX
```

## drivers/sensor/openrocket/Kconfig
```kconfig
menuconfig OPENROCKET_SENSORS
	bool "OpenRocket Sensors"
	default n
	depends on (SENSOR && (DT_HAS_OPENROCKET_IMU_ENABLED || DT_HAS_OPENROCKET_BAROMETER_ENABLED || DT_HAS_OPENROCKET_MAGNETOMETER_ENABLED)) || (GNSS && DT_HAS_OPENROCKET_GNSS_ENABLED)
	help
	  Enable driver for openrocket simulation sensors


if OPENROCKET_SENSORS
    rsource "imu/Kconfig"
    rsource "barometer/Kconfig"
    rsource "gnss/Kconfig"
    rsource "magnetometer/Kconfig"

    config OPENROCKET_SCALAR_TYPE_DOUBLE
        bool "Openrocket Scalar Type Double"
        depends on OPENROCKET_SENSORS
        help
            If true, use doubles. Otherwise use floats. When using these sensors on a real 
            microcontroller, storing everything as doubles could lead to too large a size for the
            microcontroller flash. In these cases, using floats halves the memory requirements

    config OPENROCKET_EVENT_LOG
        bool "OpenRocket Event Log"
        depends on OPENROCKET_SENSORS
        help
            If true, log OpenRocket events as the flight goes on

    config OPENROCKET_DATA_FILE
        string "OpenRocket Data File"
        depends on OPENROCKET_SENSORS
        help
            Path to CSV file, exported from OpenRocket, that we should make our data from.
            This can be an absolute path or a relative path from the application directory.

    config OPENROCKET_MS_BEFORE_LAUNCH
        int "OpenRocket ms before launch"
        depends on OPENROCKET_SENSORS && !OPENROCKET_MANUAL_LAUNCH_TRIGGER
        default 1000
        help
            Milliseconds to delay the launch from the device booting.

    config OPENROCKET_MANUAL_LAUNCH_TRIGGER
        bool "OpenRocket Manual Launch Trigger"
        depends on OPENROCKET_SENSORS
        default n
        help
            When enabled, the simulation does not start on a fixed delay after boot.
            Instead, sensor reads return pad values until or_trigger_launch() is called
            (e.g. from a ground station command). The event log thread also waits for
            the trigger before beginning.

    config OPENROCKET_NOISE
        bool "OpenRocket Sensor Noise"
        depends on OPENROCKET_SENSORS
        default false
        help
            Enable to add noise to your sensor readings. If this is disabled (bc you dont have a random source, the openrocket random generator will always return 0)
    config OPENROCKET_NOISE_SEED
        int "OpenRocket Sensor Noise Noise"
        depends on OPENROCKET_NOISE
        default 0
        help
            Random seed for random sensor readings
endif
```

## drivers/sensor/openrocket/barometer/Kconfig
```kconfig
menuconfig OPENROCKET_BAROMETER
	bool "Open Rocket Barometer"
	default n
	depends on OPENROCKET_SENSORS
	depends on DT_HAS_OPENROCKET_BAROMETER_ENABLED
	help
	  Enable driver for openrocket barometer sensor
```

## drivers/sensor/openrocket/gnss/Kconfig
```kconfig
menuconfig OPENROCKET_GNSS
	bool "Open Rocket GNSS Device"
	default n
	depends on OPENROCKET_SENSORS && GNSS && RTC
	help
	  Enable driver for openrocket GNSS
```

## drivers/sensor/openrocket/imu/Kconfig
```kconfig
menuconfig OPENROCKET_IMU
	bool "Open Rocket Inertial Measurement Unit"
	default n
    depends on OPENROCKET_SENSORS
	depends on DT_HAS_OPENROCKET_IMU_ENABLED
	help
	  Enable driver for openrocket inertial measurement unit sensor
```

## drivers/sensor/openrocket/magnetometer/Kconfig
```kconfig
menuconfig OPENROCKET_MAGNETOMETER
	bool "Open Rocket Magnetometer"
	default n
    depends on OPENROCKET_SENSORS
	depends on DT_HAS_OPENROCKET_MAGNETOMETER_ENABLED
	help
	  Enable driver for openrocket magnetometer sensor
```

## drivers/sensor/simshunt/Kconfig
```kconfig
# Simulated Bidirectional Current/Voltage/Power Sensor

# Copyright (c) 2025 Launch Initiative
# SPDX-License-Identifier: Apache-2.0

menuconfig SIMSHUNT
	bool "SIMSHUNT Current Power Sensor"
	default y
	depends on DT_HAS_SIM_SIMSHUNT_ENABLED
	help
	  Enable driver for SIMSHUNT Bidirectional Current/Voltage/Power Sensor.
```

## dts/bindings/adc/microchip,mcp3561.yaml
```yaml
description: Microchip MCP3561 (1 Channel ADC)

compatible: "microchip,mcp3561"

include: microchip,mcp356x-base.yaml



properties:
  device-address:
    type: int
    required: true
    description: |
      Each MCP356X has a device address hardwired in the chip and printed on the package.
      The device address can be used to talk to multiple chips using 1 chip select line (like i2c)

  clock-selection:
    type: string
    required: true
    description: |
      Clock Selection
      - CLK_EXTERNAL: MCLK = clock on the analog master clock output pin
      - CLK_INTERNAL: MCLK = integrated clock. analog master clock output pin follows integrated clock
      - CLK_INTERNAL_NO_BROADCAST: MCLK = integrated clock. analog master clock output pin does NOT follow integrated clock
    enum:
      - "CLK_EXTERNAL"
      - "CLK_INTERNAL"
      - "CLK_INTERNAL_NO_BROADCAST"

  prescale:
    type: string
    required: true
    description: |
      Prescaler setting
      - PRE_8: AMCLK = MCLK/8
      - PRE_4: AMCLK = MCLK/4
      - PRE_2: AMCLK = MCLK/2
      - PRE_1: AMCLK = MCLK
    enum:
      - "PRE_8"
      - "PRE_4"
      - "PRE_2"
      - "PRE_1"
      
  # osr:
  #   type: string
  #   required: true
  #   description: |
  #     OSR selection:
  #     - OSR_32: OSR of 32
  #     - OSR_64: OSR of 64
  #     - OSR_128: OSR of 128
  #     - OSR_256: OSR of 256
  #     - OSR_512: OSR of 512
  #     - OSR_1024: OSR of 1024
  #     - OSR_2048: OSR of 2048
  #     - OSR_4096: OSR of 4096
  #     - OSR_8192: OSR of 8192
  #     - OSR_16384: OSR of 16384
  #     - OSR_20480: OSR of 20480
  #     - OSR_24576: OSR of 24576
  #     - OSR_40960: OSR of 40960
  #     - OSR_49152: OSR of 49152
  #     - OSR_81920: OSR of 81920
  #     - OSR_98304: OSR of 98304
  #   enum:
  #     - "OSR_32"
  #     - "OSR_64"
  #     - "OSR_128"
  #     - "OSR_256"
  #     - "OSR_512"
  #     - "OSR_1024"
  #     - "OSR_2048"
  #     - "OSR_4096"
  #     - "OSR_8192"
  #     - "OSR_16384"
  #     - "OSR_20480"
  #     - "OSR_24576"
  #     - "OSR_40960"
  #     - "OSR_49152"
  #     - "OSR_81920"
  #     - "OSR_98304"
```

## dts/bindings/adc/microchip,mcp3562.yaml
```yaml
description: Microchip MCP3562 (2 Channel ADC)

compatible: "microchip,mcp3562"

include: microchip,mcp356x-base.yaml
```

## dts/bindings/adc/microchip,mcp3564.yaml
```yaml
description: Microchip MCP3564 (4 Channel ADC)

compatible: "microchip,mcp3564"

include: microchip,mcp356x-base.yaml
```

## dts/bindings/adc/microchip,mcp356x-base.yaml
```yaml
# Common fields for microchip mcp356(1/2/4) ADCs


include: [adc-controller.yaml, spi-device.yaml]


properties:
  "#io-channel-cells":
    type: int
    required: true
  name:
    type: string



io-channel-cells:
  - input
 
```

## dts/bindings/adc/microchip,mcp356x.yaml
```yaml
# Common fields for microchip mcp356(1/2/4) ADCs
include: [adc-controller.yaml, spi-device.yaml]

description: Microchip MCP356X (1,2,4 Channel ADCs)

compatible: "microchip,mcp356x"


properties:
  "#io-channel-cells":
    type: int
    required: true
  name:
    type: string


  device-address:
    type: int
    required: true
    description: |
      Each MCP356X has a device address hardwired in the chip and printed on the package.
      The device address can be used to talk to multiple chips using 1 chip select line (sort of like i2c)

  clock-selection:
    type: string
    required: true
    description: |
      Clock Selection
      - CLK_EXTERNAL: MCLK = clock on the analog master clock output pin
      - CLK_INTERNAL: MCLK = integrated clock. analog master clock output pin follows integrated clock
      - CLK_INTERNAL_NO_BROADCAST: MCLK = integrated clock. analog master clock output pin does NOT follow integrated clock
    enum:
      - "CLK_EXTERNAL"
      - "CLK_INTERNAL"
      - "CLK_INTERNAL_NO_BROADCAST"

  prescale:
    type: string
    required: true
    description: |
      Prescaler setting
      - PRE_8: AMCLK = MCLK/8
      - PRE_4: AMCLK = MCLK/4
      - PRE_2: AMCLK = MCLK/2
      - PRE_1: AMCLK = MCLK
    enum:
      - "PRE_8"
      - "PRE_4"
      - "PRE_2"
      - "PRE_1"
      
io-channel-cells:
  - input
 
```

## dts/bindings/fs/zephyr,fstab,gorbfs.yaml
```yaml
description: Circular buffer simple flash filesystem for flight data partition

compatible: "zephyr,fstab,gorbfs"
include: "zephyr,fstab-common.yaml"

properties:
  ram-cache-blocks:
    type: int
    description: number of blocks worth of ram to buffer (can help keep it going if IO gets bogged down doing other things for a bit)
    required: true
  circle-size:
    type: int
    description: when end of circle is signalled, save this many pages back. (if i write a page every second, and my circle size is 4, when i mark end of circle, we are free to overwrite until 4 seconds of data ago)
    required: true
```

## dts/bindings/gnss/ublox_m10/u_blox_m10.yaml
```yaml
# Copyright 2025 Launch Initiative
# SPDX-License-Identifier: Apache-2.0

description: |
  Ublox M10s GNSS receiver
  &uart0 {
    current-speed = <9600>;
    ...
    gnss: gnss-nmea-generic {
      compatible = "gnss-nmea-generic";
    };
  };

compatible: "u-blox,m10"

include:
  - uart-device.yaml

properties:
  reset-on-boot:
    type: boolean
    description: whether or not to reset chip on boot
  reset-gpios:
    type: phandle-array
    required: true
    description: Reset Pin

  timepulse-gpios:
    type: phandle-array
    required: true
    description: Timepulse/Safeboot pin
```

## dts/bindings/input/lilygo,tdeck-keyboard.yaml
```yaml
# Copyright (c) 2025 who knows
# SPDX-License-Identifier: Apache-2.0
description: keyboard driver for tdeck (esp32c3)

compatible: lilygo,tdeck-keyboard

include: [base.yaml, i2c-device.yaml]

properties:
  interrupt-gpios:
    type: phandle-array
    description: |
      Interrupt gpio
  initial-brightness:
    type: int
    default: 127
    description: |
      The brightness when initialized
  default-brightness:
    type: int
    default: 255
    description: |
      the brightness setting to use when pressing Alt-B
      if brightness was set to 0 and Alt-B is pressed, this brightness will be used
      Range 30-255
```

## dts/bindings/misc/awinic,aw9364.yaml
```yaml
# Copyright (c) 2025 who knows
# SPDX-License-Identifier: Apache-2.0
include: [base.yaml]
compatible: awinic,aw9364
description: led driver on one wire
properties:
  one-wire-gpios:
    type: phandle-array
    description: |
      Single wire for communication
  initial-brightness:
    type: int
    default: 7
    description: |
      Initial brightness for the backlight 0-15
```
