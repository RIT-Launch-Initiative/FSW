## dts/bindings/sensor/launch,ms5611-i2c.yaml
```yaml
# Copyright (c) 2024, Aaron Chan
# SPDX-License-Identifier: Apache-2.0

description: |
    TE Connectivity MS5611 digital pressure and temperature sensor.
    The Datasheet is at https://www.te.com/usa-en/product-CAT-BLPS0035.html

compatible: "launch,ms5611"

include: ["i2c-device.yaml", "launch,ms56xx-common.yaml"]
```

## dts/bindings/sensor/meas,ms5607-spi.yaml
```yaml
# Copyright (c) 2024, Aaron Chan
# SPDX-License-Identifier: Apache-2.0

description: |
    TE Connectivity MS5607 digital pressure and temperature sensor.
    The Datasheet is at https://www.te.com/usa-en/product-CAT-BLPS0035.html

compatible: "meas,lms5607"

include: ["spi-device.yaml", "meas,ms56xx-common.yaml"]
```

## dts/bindings/sensor/meas,ms5611.yaml
```yaml
# Copyright (c) 2024, RIT Launch Initiative
# SPDX-License-Identifier: Apache-2.0

description: Measurement Specialties barometer

compatible: "meas,ms5611"

include: i2c-device.yaml
```

## dts/bindings/sensor/microchip,mcp3561.yaml
```yaml
description: "MCP356X ADC"

compatible: "microchip,mcp356x"

include: [adc-controller.yaml, spi-device.yaml]



properties:
  "#io-channel-cells":
    type: int
    required: true

io-channel-cells:
  - input
 
```

## dts/bindings/sensor/openrocket,barometer.yaml
```yaml
# Copyright (c) 2024 Launch Initiative
# SPDX-License-Identifier: Apache-2.0

description: Barometer that takes its inputs from an openrocket simulation CSV

compatible: "openrocket,barometer"

include: [openrocket-sensor-device.yaml]

properties:
  temp-noise:
    type: int
    default: 0
    description: |
      Magnitude of noise measured by this sensor * 1,000.
      As this is temperature (measured in celsius), that would be millicelsius.
      Device tree does not seem to support floating point values.
      Randomness is added by generating a number from -1 to 1 then multiplying by this value/1000 before adding on to the baseline value
  pressure-noise:
    type: int
    default: 0
    description: |
      Magnitude of noise measured by this sensor * 1,000.
      As this is pressure (measured in kPa), that would be pascals.
      Device tree does not seem to support floating point values.
      Randomness is added by generating a number from -1 to 1 then multiplying by this value/1000 before adding on to the baseline value
      
```

## dts/bindings/sensor/openrocket,gnss.yaml
```yaml
# Copyright (c) 2024 Launch Initiative
# SPDX-License-Identifier: Apache-2.0

description: GNSS device that takes its inputs from an openrocket simulation CSV

compatible: "openrocket,gnss"

include: [openrocket-sensor-device.yaml]

properties:
  rtc:
    type: phandle
    description: |
      GNSS devices usually give a highly accurate timestamp with their readings.
      In this case, we don't have one of those so we use a RTC to get the time
```

## dts/bindings/sensor/openrocket,imu.yaml
```yaml
# Copyright (c) 2024 Launch Initiative
# SPDX-License-Identifier: Apache-2.0

description: IMU that takes its inputs from an openrocket simulation CSV

compatible: "openrocket,imu"

include: [openrocket-sensor-device.yaml]

properties:
  vertical-axis:
    type: string
    required: true
    description: |
      Which axis is up (the direction the rocket goes)
      Options:
      - OPENROCKET_AXIS_X
      - OPENROCKET_AXIS_Y
      - OPENROCKET_AXIS_Z
    enum:
      - "OPENROCKET_AXIS_X"
      - "OPENROCKET_AXIS_Y"
      - "OPENROCKET_AXIS_Z"
      
  vertical-axis-invert:
    type: boolean
    description: |
      If set, invert the vertical axis (multiply by -1). 
      This is helpful if your actual IMU is upside down

  lateral-axis:
    type: string
    required: true
    description: |
      Which axis is sideways
      Options:
      - OPENROCKET_AXIS_X
      - OPENROCKET_AXIS_Y
      - OPENROCKET_AXIS_Z
    enum:
      - "OPENROCKET_AXIS_X"
      - "OPENROCKET_AXIS_Y"
      - "OPENROCKET_AXIS_Z"

  roll-axis:
    type: string
    required: true
    description: |
      Which axis is roll
      Options:
      - OPENROCKET_AXIS_X
      - OPENROCKET_AXIS_Y
      - OPENROCKET_AXIS_Z
    enum:
      - "OPENROCKET_AXIS_X"
      - "OPENROCKET_AXIS_Y"
      - "OPENROCKET_AXIS_Z"
  pitch-axis:
    type: string
    required: true
    description: |
      Which axis is pitch
      Options:
      - OPENROCKET_AXIS_X
      - OPENROCKET_AXIS_Y
      - OPENROCKET_AXIS_Z
    enum:
      - "OPENROCKET_AXIS_X"
      - "OPENROCKET_AXIS_Y"
      - "OPENROCKET_AXIS_Z"
  yaw-axis:
    type: string
    required: true
    description: |
      Which axis is yaw
      Options:
      - OPENROCKET_AXIS_X
      - OPENROCKET_AXIS_Y
      - OPENROCKET_AXIS_Z
    enum:
      - "OPENROCKET_AXIS_X"
      - "OPENROCKET_AXIS_Y"
      - "OPENROCKET_AXIS_Z"
  roll-axis-invert:
    type: boolean
    description: |
      If set, invert the roll axis (multiply by -1). 
  pitch-axis-invert:
    type: boolean
    description: |
      If set, invert the roll axis (multiply by -1). 
  yaw-axis-invert:
    type: boolean
    description: |
      If set, invert the roll axis (multiply by -1). 

  accel-noise:
    type: int
    default: 0
    description: |
      Magnitude of noise added to each axis of accelerometer readings * 1000 
      As device tree does not support floating point numbers, this value is in mm/s^2
      Randomness is added by generating a number from -1 to 1 then multiplying by this value/1000 before adding on to the baseline value for each component
  gyro-noise:
    type: int
    default: 0
    description: |
      Magnitude of noise added to each axis of gyro readings * 1000 
      As device tree does not support floating point numbers, this value is in milliradians/s
      Randomness is added by generating a number from -1 to 1 then multiplying by this value/1000 before adding on to the baseline value for each component
```

## dts/bindings/sensor/openrocket,magnetometer.yaml
```yaml
# Copyright (c) 2024 Launch Initiative
# SPDX-License-Identifier: Apache-2.0

description: Magnetometer that takes its inputs from an openrocket simulation CSV

compatible: "openrocket,magnetometer"

include: [openrocket-sensor-device.yaml]

properties:
  noise:
    type: int
    default: 0
    description: |
      Magnitude of noise measured by this sensor * 1,000.
      As this is a magnetometer (measured in gauss), that would be milligaus.
      Device tree does not seem to support floating point values.
      Randomness is added by generating a number from -1 to 1 then multiplying by this value/1000 before adding on to the baseline value
```

## dts/bindings/sensor/openrocket-sensor-device.yaml
```yaml
# Copyright (c) 2024 Launch Initiative
# SPDX-License-Identifier: Apache-2.0

description: Openrocket Device

include: [sensor-device.yaml]

properties:
  lag-time-us:
    type: int
    default: 0
    description: |
      Lag after the ground truth that this sensor measures.
      Some devices (like a barometer) don't update super fast. 
      Use this parameter to control that.
  sampling-period-us:
    type: int
    default: 0
    description: |
      What frequency does the sensor update at. The simulated sensor will 
      only update at this rate no matter how the underlying data changes 
      beneath it or how often the use calls `sensor_channel_fetch`.
      A value of 0 (the default) signifies the the value will interpolated 
      to read as fast as `sensor_channel_fetch` is called.
  measurement-us:
    type: int
    default: 1
    description: |
      How long does it take to measure this sensor in microseconds. 
      A call to sensor_sample_fetch on an openrocket sensor will take this long (+ a couple clock cycles) to complete
  broken:
    type: boolean
    description: |
      Sometimes, your sensors are broken. Use this to mimic that. If set,
      device_is_ready will return false and sensor fetchers will return
      -ENODEV and not do anything.
```

## dts/bindings/sensor/sim,simshunt.yaml
```yaml
# Copyright (c) 2025 Launch Initiative
# SPDX-License-Identifier: Apache-2.0

description: Simulated Bidirectional Current/Voltage/Power Sensor

compatible: "sim,simshunt"

include: [sensor-device.yaml]

properties:
  simulated-voltage:
    type: int
    required: true
    description: |
      The voltage that the simulated sensor will always read in mV (millivolts)

  simulated-current:
    type: int
    required: true
    description: |
      The current that the simulated sensor will always read in mA (milliamps)
```

## dts/bindings/sensor/ti,ina260.yaml
```yaml
# Copyright (c) 2024 Richard Sommers
# SPDX-License-Identifier: Apache-2.0
# datasheet: http://www.ti.com/lit/ds/symlink/ina260.pdf

description: Texas Instruments Bidirectional Current/Power Sensor

compatible: "ti,ina260"

include: [sensor-device.yaml, i2c-device.yaml]

properties:

  average:
    type: string
    required: true
    description: |
      Averaging Mode. 
      Determines the number of samples that are collected and averaged. 
      The following shows all the AVG bit settings and related number of averages for each bit setting
      - AVG_1: Average of 1 samples 
      - AVG_4: Average of 4 samples 
      - AVG_16: Average of 16 samples 
      - AVG_64: Average of 64 samples 
      - AVG_128: Average of 128 samples 
      - AVG_256: Average of 256 samples 
      - AVG_512: Average of 512 samples 
      - AVG_1024: Average of 1024 samples 

    enum:
      - "AVG_1"
      - "AVG_4"
      - "AVG_16"
      - "AVG_64"
      - "AVG_128"
      - "AVG_256"
      - "AVG_512"
      - "AVG_1024"

  mode:
    type: string
    description: |
      Operating Mode
      Selects continuous, triggered, or power-down mode of operation. These bits default to
      continuous shunt and bus measurement mode. The following shows mode settings
      - TRIG_OFF
      - TRIG_CURRENT
      - TRIG_VOLTAGE
      - TRIG_BOTH
      - CONT_OFF
      - CONT_CURRENT
      - CONT_VOLTAGE
      - CONT_BOTH
    default: "CONT_BOTH"
    enum:
      - "TRIG_OFF"
      - "TRIG_CURRENT"
      - "TRIG_VOLTAGE"
      - "TRIG_BOTH"
      - "CONT_OFF"
      - "CONT_CURRENT"
      - "CONT_VOLTAGE"
      - "CONT_BOTH"

  v-conv-time:
    type: string
    required: true
    description: |
      Bus Voltage Conversion Time 
      - CONV_TIME_140US
      - CONV_TIME_204US
      - CONV_TIME_332US
      - CONV_TIME_588US
      - CONV_TIME_1100US
      - CONV_TIME_2116US
      - CONV_TIME_4156US
      - CONV_TIME_8244US
    enum:
      - "CONV_TIME_140US"
      - "CONV_TIME_204US"
      - "CONV_TIME_332US"
      - "CONV_TIME_588US"
      - "CONV_TIME_1100US"
      - "CONV_TIME_2116US"
      - "CONV_TIME_4156US"
      - "CONV_TIME_8244US"
  i-conv-time:
    type: string
    required: true
    description: |
      Shunt Current Conversion Time 
      - CONV_TIME_140US
      - CONV_TIME_204US
      - CONV_TIME_332US
      - CONV_TIME_588US
      - CONV_TIME_1100US
      - CONV_TIME_2116US
      - CONV_TIME_4156US
      - CONV_TIME_8244US
    enum:
      - "CONV_TIME_140US"
      - "CONV_TIME_204US"
      - "CONV_TIME_332US"
      - "CONV_TIME_588US"
      - "CONV_TIME_1100US"
      - "CONV_TIME_2116US"
      - "CONV_TIME_4156US"
      - "CONV_TIME_8244US"
```

## lib/Kconfig
```kconfig
# Copyright (c) 2024 Launch Initiative
# SPDX-License-Identifier: Apache-2.0

menu "RIT Launch Libraries"
    rsource "launch_core_classic/Kconfig"
    rsource "f_core/Kconfig"
endmenu
```

## lib/f_core/Kconfig
```kconfig
# Copyright (c) 2024 RIT Launch Initiative
# SPDX-License-Identifier: Apache-2.0

config F_CORE
    bool "F-Core"
    help
      This option enables core functionality for all flight software

config F_CORE_DEVICE
    bool "Device"
    help
      This option enables basic device functionality for F-Core

config F_CORE_SENSOR
    bool "Sensor"
    help
      This option enables sensor functionality for F-Core

config F_CORE_NET
    bool "Network"
    help
      This option enables network functionality for F-Core
    select ENTROPY_GENERATOR
    select NETWORKING
    select NET_CONTEXT_RCVTIMEO
    select NET_DRIVERS
    select NET_IPV4
    select NET_IPV4_ACCEPT_ZERO_BROADCAST
    select NET_L2_ETHERNET
    select NET_L2_ETHERNET_MGMT
    select NET_SOCKETS
    select NET_SOCKETS_SERVICE
    select NET_STATISTICS
    select SNTP
    imply ZVFS_POLL_MAX_HINT
    imply NET_SOCKETS_SERVICE_STACK_SIZE_HINT

config F_CORE_RADIO
    bool "Radio"
    help
      This option enables radio functionality for F-Core

config F_CORE_STATE_MACHINE
    bool "State Machine"
    help
      This option enables state machine functionality for F-Core

config F_CORE_OS
    bool "OS"
    help
      This option enables OS functionality for F-Core

config F_CORE_UTILS
    bool "Utility"
    help
      This option enables utility functionality for F-Core

config F_CORE_PROTOCOLS
    bool "Protocols"
    depends on F_CORE
    help
      This option enables support for some protocols for F-Core


# The below is an internal config to suggest a default value for ZVFS_POLL_MAX
# for socket service support, since the original default is 3, which is low
config ZVFS_POLL_MAX_HINT
    bool
    help
      Internal signal to suggest default ZVFS_POLL_MAX=5 if not overridden

config ZVFS_POLL_MAX
    int
    default 5 if ZVFS_POLL_MAX_HINT
    help
      Max number of poll events in ZVFS


# Below is an internal config for increasing the socket service stack size to
# avoid stack overflow with the socket service that uses the most stack
config NET_SOCKETS_SERVICE_STACK_SIZE_HINT
    bool
    help
      Internal signal to suggest increasing NET_SOCKETS_SERVICE_STACK_SIZE

config NET_SOCKETS_SERVICE_STACK_SIZE
    int
    default 4096 if NET_SOCKETS_SERVICE_STACK_SIZE_HINT
    help
        Stack size for the network sockets service thread

rsource "radio/Kconfig"
```

## lib/f_core/device/sensor/Kconfig
```kconfig
config F_CORE_SENSOR
    bool "F Core Sensor APIs"
    
    select F_CORE
    select SENSOR
```

## lib/f_core/horus/Kconfig
```kconfig
config HORUSV2
    bool "HorusV2"
    help
      This option enables Horus V2 packet creation

if HORUSV2
    config HORUS_INTERLEAVER
        bool "Horus Interleaver"
        default y
        help
           Enable Horus V2 packet interleaver
    config HORUS_SCRAMBLER
        bool "Horus Scrambler"
        default y
        help
           Enable Horus V2 packet scrambler
    config HORUSV2_RX
        bool "Horus V2 RX"
        help
            Enable Horus V2 Decoding
          
endif
```

## lib/f_core/net/Kconfig
```kconfig
config F_CORE_NET
    bool "F Core Networking Libraries"
    
    select F_CORE
    # depends on ENTROPY_GENERATOR

    imply LORA
    
    select NETWORKING
    select NET_UDP
    select NET_SOCKETS
    select NET_IPV4
    select NET_L2_ETHERNET

    
    select NET_NATIVE if ARCH_POSIX
```

## lib/f_core/os/base64dump/Kconfig
```kconfig
config F_CORE_BASE64_DATA_DUMP_SHELL
    bool "F Core base 64 data dump shell"
    depends on FILE_SYSTEM
    select BASE64
    select SHELL
    select FILE_SYSTEM_SHELL
```

## lib/f_core/protocols/horus/Kconfig
```kconfig
config HORUSV2
    bool "HorusV2"
    select F_CORE_PROTOCOLS
    help
      This option enables Horus V2 packet creation

module = HORUS
module-str = Horus
source "subsys/logging/Kconfig.template.log_config"

if HORUSV2
    config HORUS_INTERLEAVER
        bool "Horus Interleaver"
        default y
        help
           Enable Horus V2 packet interleaver
    config HORUS_SCRAMBLER
        bool "Horus Scrambler"
        default y
        help
           Enable Horus V2 packet scrambler
    config HORUSV2_RX
        bool "Horus V2 RX"
        help
            Enable Horus V2 Decoding

          
endif
```
