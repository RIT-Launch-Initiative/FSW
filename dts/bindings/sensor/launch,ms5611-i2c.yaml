## lib/f_core/radio/Kconfig
```kconfig
config LICENSED_FREQUENCY
	bool "Use licensed LoRa frequency defaults"
	depends on F_CORE_RADIO
	default y
	help
	  Enable licensed-band defaults for LoRa settings.
	  When enabled, CLora starts at 433 MHz and licensed-band
	  frequency checks are used.

rsource "protocols/horus/Kconfig"
```

## lib/launch_core/Kconfig
```kconfig
# Copyright (c) 2024 Aaron Chan
# SPDX-License-Identifier: Apache-2.0

config LAUNCH_CORE
    bool "Launch Core"
    help
      This option enables core functionality for all flight software

config LAUNCH_CORE_DEVICE
    bool "Helper functionality for Device"
    depends on DEVICE
    help
      This option enables core functionality for device drivers

config LAUNCH_CORE_NET
    bool "Helper functionality for Networking"
    select CONFIG_SYS_HASH_MAP
    select CONFIG_SYS_HASH_FUNC32
    help
      This option enables core functionality for Networking.

config LAUNCH_CORE_LORA
	bool "Helper functionality for LoRa"
	select LORA
	select LORA_SX127X
	help
	  This option enables core functionality for LoRa.

config LAUNCH_CORE_FS
    bool "Helper functionality for File System"
    depends on FS_LITTLEFS
    help
      This option enables core functionality for the File System.
```

## sensor_module/boards/arm/sensor_module/sensor_module_defconfig
```kconfig
# CONFIG_NET_IPV6 is not set

# System
CONFIG_CLOCK_CONTROL=y
CONFIG_PINCTRL=y
CONFIG_GPIO=y
CONFIG_SOC_SERIES_STM32F4X=y
CONFIG_SOC_STM32F446XX=y
CONFIG_ARM_MPU=y
CONFIG_HW_STACK_PROTECTION=y


# console
CONFIG_SERIAL=y
CONFIG_CONSOLE=y
CONFIG_UART_CONSOLE=y
CONFIG_CBPRINTF_FP_SUPPORT=y

# Flash
CONFIG_FLASH=y

# I2C
CONFIG_I2C=y
# CONFIG_I2C_CALLBACK=y
# CONFIG_I2C_RTIO=y

# LED
CONFIG_LED=y


# PTP
CONFIG_PTP_CLOCK=y

# SENSORS
CONFIG_SENSOR=y
CONFIG_SENSOR_ASYNC_API=y

# SPI
# CONFIG_SPI_ASYNC=y
# CONFIG_SPI_RTIO=y

# File System
CONFIG_DISK_ACCESS=y
CONFIG_FILE_SYSTEM=y
CONFIG_FILE_SYSTEM_LITTLEFS=y
CONFIG_FS_LITTLEFS_BLK_DEV=y

# RNG
CONFIG_ENTROPY_GENERATOR=y
CONFIG_TEST_RANDOM_GENERATOR=y


# Networking
CONFIG_NETWORKING=y
CONFIG_NET_HOSTNAME_ENABLE=y
CONFIG_NET_HOSTNAME="sensor_module"
CONFIG_NET_IPV4=y
CONFIG_NET_DHCPV4=y
CONFIG_NET_DRIVERS=y
```

## tests/lib/f_core/protocols/horus/testcase.yaml
```yaml
common:
  tags:
    - lib
    - utilities
tests:
  protocols.horus:
    type: unit
    extra_configs:
      - CONFIG_F_CORE=y
      - CONFIG_qasdsadsada=y
```

## tests/utils/Kconfig
```kconfig
# Copyright (c) 2024 Launch Initiative
# SPDX-License-Identifier: Apache-2.0

source "Kconfig.zephyr"
```
