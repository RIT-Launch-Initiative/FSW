## west.yml
```yaml
# Copyright (c) 2024 RIT Launch Initiative
# SPDX-License-Identifier: Apache-2.0

manifest:
  self:
    west-commands: scripts/west-commands.yml

  remotes:
    - name: zephyrproject-rtos
      url-base: https://github.com/zephyrproject-rtos

  projects:
    - name: zephyr
      remote: zephyrproject-rtos
      revision: v4.2.0
      import:
        name-allowlist:
          - cmsis_6
          - hal_st
          - hal_stm32
          - hal_nxp
          - littlefs
          - loramac-node
          - lz4
          - segger
          - percepio
      clone-depth: 1
    - name: zscilib
      remote: zephyrproject-rtos
      revision: master
```
